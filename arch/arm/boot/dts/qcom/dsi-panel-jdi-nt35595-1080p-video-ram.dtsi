/* Copyright (c) 2015, The Linux Foundation. All rights reserved.
 * Copyright (C) 2016 XiaoMi, Inc.
 *
 * This program is free software; you can redistribute it and/or modify
 * it under the terms of the GNU General Public License version 2 and
 * only version 2 as published by the Free Software Foundation.
 *
 * This program is distributed in the hope that it will be useful,
 * but WITHOUT ANY WARRANTY; without even the implied warranty of
 * MERCHANTABILITY or FITNESS FOR A PARTICULAR PURPOSE.  See the
 * GNU General Public License for more details.
 */

 /*---------------------------------------------------------------------------
 * This file is autogenerated file using gcdb parser. Please do not edit it.
 * Update input XML file to add a new entry or update variable in this file
 * VERSION = "1.0"
 *---------------------------------------------------------------------------*/
&mdss_mdp {
	dsi_jdi_nt35595_1080_vid: qcom,mdss_dsi_jdi_nt35595_1080p_video {
		qcom,mdss-dsi-panel-name = "jdi nt35595 1080p video mode dsi panel";
		qcom,mdss-dsi-panel-id = <2>;
		qcom,mdss-dsi-panel-controller = <&mdss_dsi0>;
		qcom,mdss-dsi-panel-type = "dsi_video_mode";
		qcom,mdss-dsi-panel-destination = "display_1";
		qcom,mdss-dsi-panel-framerate = <60>;
		qcom,mdss-dsi-virtual-channel-id = <0>;
		qcom,mdss-dsi-stream = <0>;
		qcom,mdss-dsi-panel-width = <1080>;
		qcom,mdss-dsi-panel-height = <1920>;
		qcom,mdss-dsi-h-front-porch = <104>;
		qcom,mdss-dsi-h-back-porch = <24>;
		qcom,mdss-dsi-h-pulse-width = <8>;
		qcom,mdss-dsi-h-sync-skew = <0>;
		qcom,mdss-dsi-v-back-porch = <3>;
		qcom,mdss-dsi-v-front-porch = <4>;
		qcom,mdss-dsi-v-pulse-width = <2>;
		qcom,mdss-dsi-h-left-border = <0>;
		qcom,mdss-dsi-h-right-border = <0>;
		qcom,mdss-dsi-v-top-border = <0>;
		qcom,mdss-dsi-v-bottom-border = <0>;
		qcom,mdss-dsi-bpp = <24>;
		qcom,mdss-dsi-underflow-color = <0xff>;
		qcom,mdss-dsi-border-color = <0>;
		qcom,mdss-dsi-pixel-packing = "tight";
		qcom,mdss-dsi-pan-enable-dynamic-fps;
		qcom,mdss-dsi-pan-fps-update = "dfps_immediate_porch_mode_vfp";
		qcom,mdss-dsi-min-refresh-rate = <45>;
		qcom,mdss-dsi-max-refresh-rate = <60>;
		qcom,mdss-dsi-on-command = [
		15 00 00 00 01 00 02 FF F0
		15 00 00 00 01 00 02 13 01
		15 00 00 00 01 00 02 FB 01

		15 01 00 00 01 00 02 FF 22
		15 00 00 00 01 00 02 FB 01
		15 00 00 00 01 00 02 1A 00
		15 00 00 00 01 00 02 53 02
		15 01 00 00 01 00 02 54 01
		15 00 00 00 01 00 02 56 00
		15 00 00 00 01 00 02 68 00

		15 00 00 00 01 00 02 FF 10
		15 00 00 00 01 00 02 BB 03
		39 00 00 00 01 00 06 3B 03 04 04 10 10
		15 00 00 00 01 00 02 50 00

		15 01 00 00 01 00 02 34 00
		15 00 00 00 01 00 02 51 ff
		15 00 00 00 01 00 02 53 2c
		15 00 00 00 01 00 02 55 81
		05 01 00 00 78 00 02 11 00
		05 01 00 00 14 00 02 29 00
		];
		qcom,mdss-dsi-off-command = [
		15 01 00 00 00 00 02 FF 00
		05 01 00 00 20 00 02 28 00
		05 01 00 00 40 00 02 10 00
		23 01 00 00 00 00 02 4F 01
		];
		qcom,mdss-dsi-on-command-state = "dsi_lp_mode";
		qcom,mdss-dsi-off-command-state = "dsi_hs_mode";
		qcom,mdss-dsi-h-sync-pulse = <0>;
		qcom,mdss-dsi-traffic-mode = "non_burst_sync_pulse";
		qcom,mdss-dsi-bllp-eof-power-mode;
		qcom,mdss-dsi-bllp-power-mode;
		qcom,mdss-dsi-lane-0-state;
		qcom,mdss-dsi-lane-1-state;
		qcom,mdss-dsi-lane-2-state;
		qcom,mdss-dsi-lane-3-state;
		qcom,mdss-dsi-lp11-init;
		qcom,mdss-dsi-panel-timings = [E1 4B 37 00 A9 AB 2A 4F 3D 03 04 00];//844.44M
		qcom,mdss-dsi-t-clk-post = <0x19>;
		qcom,mdss-dsi-t-clk-pre = <0x2f>;
		qcom,mdss-dsi-bl-min-level = <1>;
		qcom,mdss-dsi-bl-max-level = <4095>;
		qcom,mdss-dsi-dma-trigger = "trigger_sw";
		qcom,mdss-dsi-mdp-trigger = "none";
		qcom,mdss-dsi-bl-pmic-control-type = "bl_ctrl_wled";
		qcom,mdss-dsi-reset-sequence = <1 5>, <0 5>, <1 10>;
		qcom,mdss-pan-physical-width-dimension = <61>;
		qcom,mdss-pan-physical-height-dimension = <109>;
		qcom,cont-splash-enabled;
		qcom,dispparam-enabled;
		qcom,mdss-night-brightness = <0xb 0x10 0x14 0x1a>;
		qcom,mdss-dsi-dispparam-ceon-command;
		qcom,mdss-dsi-dispparam-ceon-command-state = "dsi_hs_mode";
		qcom,mdss-dsi-dispparam-ceoff-command;
		qcom,mdss-dsi-dispparam-ceoff-command-state = "dsi_hs_mode";
		qcom,mdss-dsi-dispparam-warm-command = <0x15000000 0x10002ff 0x1150000 0x10002 0xfb011500 0x100 0x2750015 0x1 0x2767a 0x15000000 0x1000277 0x150000 0x10002 0x78891500 0x100 0x2790015 0x1 0x27aa1 0x15000000 0x100027b 0x150000 0x10002 0x7cb51500 0x100 0x27d0015 0x1 0x27ec7 0x15000000 0x100027f 0x150000 0x10002 0x80d61500 0x100 0x2810015 0x1 0x282e4 0x15000000 0x1000283 0x150000 0x10002 0x84f11500 0x100 0x2850015 0x1 0x286fd 0x15000000 0x1000287 0x1150000 0x10002 0x88261500 0x100 0x2890115 0x1 0x28a48 0x15000000 0x100028b 0x1150000 0x10002 0x8c7f1500 0x100 0x28d0115 0x1 0x28eac 0x15000000 0x100028f 0x1150000 0x10002 0x90f11500 0x100 0x2910215 0x1 0x29228 0x15000000 0x1000293 0x2150000 0x10002 0x94291500 0x100 0x2950215 0x1 0x2965b 0x15000000 0x1000297 0x2150000 0x10002 0x98921500 0x100 0x2990215 0x1000001 0x29ab6 0x15000000 0x100029b 0x2150000 0x10002 0x9ce71500 0x100 0x29d0315 0x1 0x29e08 0x15000000 0x100029f 0x3150000 0x10002 0xa02e1500 0x100 0x2a20315 0x1 0x2a33b 0x15000000 0x10002a4 0x3150000 0x10002 0xa54b1500 0x100 0x2a60315 0x1 0x2a762 0x15000000 0x10002a9 0x3150000 0x10002 0xaa7a1500 0x100 0x2ab0315 0x1 0x2aca0 0x15000000 0x10002ad 0x3150000 0x10002 0xaeb61500 0x100 0x2af0315 0x1 0x2b0c9 0x15000000 0x10002b1 0x3150000 0x10002 0xb2cb1500 0x100 0x2b30015 0x1 0x2b47a 0x15000000 0x10002b5 0x150000 0x10002 0xb6891500 0x100 0x2b70015 0x1 0x2b8a1 0x15000000 0x10002b9 0x150000 0x10002 0xbab51500 0x100 0x2bb0015 0x1 0x2bcc7 0x15000000 0x10002bd 0x150000 0x10002 0xbed61500 0x100 0x2bf0015 0x1 0x2c0e4 0x15000000 0x10002c1 0x150000 0x10002 0xc2f11500 0x100 0x2c30015 0x1000001 0x2c4fd 0x15000000 0x10002c5 0x1150000 0x10002 0xc6261500 0x100 0x2c70115 0x1 0x2c848 0x15000000 0x10002c9 0x1150000 0x10002 0xca7f1500 0x100 0x2cb0115 0x1 0x2ccac 0x15000000 0x10002cd 0x1150000 0x10002 0xcef11500 0x100 0x2cf0215 0x1 0x2d028 0x15000000 0x10002d1 0x2150000 0x10002 0xd2291500 0x100 0x2d30215 0x1 0x2d45b 0x15000000 0x10002d5 0x2150000 0x10002 0xd6921500 0x100 0x2d70215 0x1 0x2d8b6 0x15000000 0x10002d9 0x2150000 0x10002 0xdae71500 0x100 0x2db0315 0x1 0x2dc08 0x15000000 0x10002dd 0x3150000 0x10002 0xde2e1500 0x100 0x2df0315 0x1 0x2e03b 0x15000000 0x10002e1 0x3150000 0x10002 0xe24b1500 0x100 0x2e30315 0x1 0x2e462 0x15000000 0x10002e5 0x3150000 0x10002 0xe67a1500 0x100 0x2e70315 0x1 0x2e8a0 0x15000000 0x10002e9 0x3150000 0x10002 0xeab61500 0x100 0x2eb0315 0x1000001 0x2ecc9 0x15000000 0x10002ed 0x3150000 0x10002 0xeecb1500 0x100 0x2ef0015 0x1 0x2f0fa 0x15000000 0x10002f1 0x1150000 0x10002 0xf2001500 0x100 0x2f30115 0x1 0x2f40a 0x15000000 0x10002f5 0x1150000 0x10002 0xf6151500 0x100 0x2f70115 0x1 0x2f81e 0x15000000 0x10002f9 0x1150000 0x10002 0xfa271500 0x1000 0x2ff0215 0x1 0x2fb01 0x15000000 0x1000200 0x1150000 0x10002 0x1301500 0x100 0x2020115 0x1 0x20338 0x15000000 0x1000204 0x1150000 0x10002 0x5401500 0x100 0x2060115 0x1 0x2075d 0x15000000 0x1000208 0x1150000 0x10002 0x9771500 0x100 0x20a0115 0x1 0x20ba2 0x15000000 0x100020c 0x1150100 0x10002 0xdc81500 0x100 0x20e0215 0x1 0x20f03 0x15000000 0x1000210 0x2150000 0x10002 0x11351500 0x100 0x2120215 0x1 0x21336 0x15000000 0x1000214 0x2150000 0x10002 0x15671500 0x100 0x2160215 0x1 0x2179e 0x15000000 0x1000218 0x2150000 0x10002 0x19c01500 0x100 0x21a0215 0x1 0x21bf3 0x15000000 0x100021c 0x3150000 0x10002 0x1d141500 0x100 0x21e0315 0x1 0x21f40 0x15000000 0x1000220 0x3150000 0x10002 0x214d1500 0x100 0x2220315 0x1 0x2235b 0x15000000 0x1000224 0x3150000 0x10002 0x256b1500 0x100 0x2260315 0x1 0x2277d 0x15000000 0x1000228 0x3150000 0x10002 0x29941500 0x100 0x22a0315 0x1 0x22bb0 0x15000000 0x100022d 0x3150000 0x10002 0x2fc81500 0x100 0x2300315 0x1 0x231cb 0x15000000 0x1000232 0x150000 0x10002 0x33fa1500 0x100 0x2340115 0x1 0x23500 0x15000000 0x1000236 0x1150100 0x10002 0x370a1500 0x100 0x2380115 0x1 0x23915 0x15000000 0x100023a 0x1150000 0x10002 0x3b1e1500 0x100 0x23d0115 0x1 0x23f27 0x15000000 0x1000240 0x1150000 0x10002 0x41301500 0x100 0x2420115 0x1 0x24338 0x15000000 0x1000244 0x1150000 0x10002 0x45401500 0x100 0x2460115 0x1 0x2475d 0x15000000 0x1000248 0x1150000 0x10002 0x49771500 0x100 0x24a0115 0x1 0x24ba2 0x15000000 0x100024c 0x1150000 0x10002 0x4dc81500 0x100 0x24e0215 0x1 0x24f03 0x15000000 0x1000250 0x2150000 0x10002 0x51351500 0x100 0x2520215 0x1 0x25336 0x15000000 0x1000254 0x2150000 0x10002 0x55671500 0x100 0x2560215 0x1 0x2589e 0x15000000 0x1000259 0x2150000 0x10002 0x5ac01500 0x100 0x25b0215 0x1 0x25cf3 0x15000000 0x100025d 0x3150000 0x10002 0x5e141500 0x100 0x25f0315 0x1 0x26040 0x15000000 0x1000261 0x3150100 0x10002 0x624d1500 0x100 0x2630315 0x1 0x2645b 0x15000000 0x1000265 0x3150000 0x10002 0x666b1500 0x100 0x2670315 0x1 0x2687d 0x15000000 0x1000269 0x3150000 0x10002 0x6a941500 0x100 0x26b0315 0x1 0x26cb0 0x15000000 0x100026d 0x3150000 0x10002 0x6ec81500 0x100 0x26f0315 0x1 0x270cb 0x15000000 0x1000271 0x1150000 0x10002 0x72311500 0x100 0x2730115 0x1 0x27435 0x15000000 0x1000275 0x1150000 0x10002 0x763c1500 0x100 0x2770115 0x1 0x27844 0x15000000 0x1000279 0x1150000 0x10002 0x7a4b1500 0x100 0x27b0115 0x1 0x27c52 0x15000000 0x100027d 0x1150000 0x10002 0x7e591500 0x100 0x27f0115 0x1 0x2805f 0x15000000 0x1000281 0x1150000 0x10002 0x82651500 0x100 0x2830115 0x1 0x2847d 0x15000000 0x1000285 0x1150000 0x10002 0x86921500 0x100 0x2870115 0x1 0x288b7 0x15010000 0x1000289 0x1150000 0x10002 0x8ad81500 0x100 0x28b0215 0x1 0x28c0d 0x15000000 0x100028d 0x2150000 0x10002 0x8e3c1500 0x100 0x28f0215 0x1 0x2903d 0x15000000 0x1000291 0x2150000 0x10002 0x926b1500 0x100 0x2930215 0x1 0x294a0 0x15000000 0x1000295 0x2150000 0x10002 0x96c41500 0x100 0x2970215 0x1 0x298f7 0x15000000 0x1000299 0x3150000 0x10002 0x9a1e1500 0x100 0x29b0315 0x1 0x29c59 0x15000000 0x100029d 0x3150000 0x10002 0x9e801500 0x100 0x29f0315 0x1 0x2a09f 0x15000000 0x10002a2 0x3150000 0x10002 0xa3a61500 0x100 0x2a40315 0x1 0x2a5a7 0x15000000 0x10002a6 0x3150000 0x10002 0xa7a81500 0x100 0x2a90315 0x10 0x2aab1 0x15000000 0x10002ab 0x3150000 0x10002 0xacc91500 0x100 0x2ad0315 0x1 0x2aecb 0x15000000 0x10002af 0x1150000 0x10002 0xb0311500 0x100 0x2b10115 0x1 0x2b235 0x15000000 0x10002b3 0x1150100 0x10002 0xb43c1500 0x100 0x2b50115 0x1 0x2b644 0x15000000 0x10002b7 0x1150000 0x10002 0xb84b1500 0x100 0x2b90115 0x1 0x2ba52 0x15000000 0x10002bb 0x1150000 0x10002 0xbc591500 0x100 0x2bd0115 0x1 0x2be5f 0x15000000 0x10002bf 0x1150000 0x10002 0xc0651500 0x100 0x2c10115 0x1 0x2c27d 0x15000000 0x10002c3 0x1150000 0x10002 0xc4921500 0x100 0x2c50115 0x1 0x2c6b7 0x15000000 0x10002c7 0x1150100 0x10002 0xc8d81500 0x100 0x2c90215 0x1 0x2ca0d 0x15000000 0x10002cb 0x2150000 0x10002 0xcc3c1500 0x100 0x2cd0215 0x1 0x2ce3d 0x15000000 0x10002cf 0x2150000 0x10002 0xd06b1500 0x100 0x2d10215 0x1 0x2d2a0 0x15000000 0x10002d3 0x2150000 0x10002 0xd4c41500 0x100 0x2d50215 0x1 0x2d6f7 0x15000000 0x10002d7 0x3150000 0x10002 0xd81e1500 0x100 0x2d90315 0x1 0x2da59 0x15000000 0x10002db 0x3150000 0x10002 0xdc801500 0x100 0x2dd0315 0x1 0x2de9f 0x15000000 0x10002df 0x3150000 0x10002 0xe0a61500 0x100 0x2e10315 0x1 0x2e2a7 0x15000000 0x10002e3 0x3150000 0x10002 0xe4a81500 0x100 0x2e50315 0x1 0x2e6b1 0x15000000 0x10002e7 0x3150000 0x10002 0xe8c91500 0x100 0x2e90315 0x1000001 0x2eacb>;
		qcom,mdss-dsi-dispparam-warm-command-state = "dsi_hs_mode";
		qcom,mdss-dsi-dispparam-default-command = [15 01 00 00 01 00 02 ff 20 15 00 00 00 01 00 02 fb 00 15 01 00 00 01 00 02 ff 21 15 00 00 00 01 00 02 fb 00 15 01 00 00 01 00 02 ff 10 05 01 00 00 10 00 02 11 00];
		qcom,mdss-dsi-dispparam-default-command-state = "dsi_hs_mode";
		qcom,mdss-dsi-dispparam-cold-command = <0x15000000 0x10002ff 0x1150000 0x10002 0xfb011500 0x100 0x2750015 0x1 0x276bc 0x15000000 0x1000277 0x150000 0x10002 0x78c51500 0x100 0x2790015 0x1 0x27ad4 0x15000000 0x100027b 0x150000 0x10002 0x7ce21500 0x100 0x27d0015 0x1 0x27eef 0x15000000 0x100027f 0x150000 0x10002 0x80fb1500 0x100 0x2810115 0x1 0x28206 0x15000000 0x1000283 0x1150000 0x10002 0x84101500 0x100 0x2850115 0x1 0x2861b 0x15000000 0x1000287 0x1150000 0x10002 0x883d1500 0x100 0x2890115 0x1 0x28a5b 0x15000000 0x100028b 0x1150000 0x10002 0x8c8e1500 0x100 0x28d0115 0x1 0x28eb7 0x15000000 0x100028f 0x1150000 0x10002 0x90f71500 0x100 0x2910215 0x1 0x2922d 0x15000000 0x1000293 0x2150000 0x10002 0x942e1500 0x100 0x2950215 0x1 0x2965f 0x15000000 0x1000297 0x2150000 0x10002 0x98961500 0x100 0x2990215 0x1000001 0x29ab9 0x15000000 0x100029b 0x2150000 0x10002 0x9ceb1500 0x100 0x29d0315 0x1 0x29e0f 0x15000000 0x100029f 0x3150000 0x10002 0xa0351500 0x100 0x2a20315 0x1 0x2a342 0x15000000 0x10002a4 0x3150000 0x10002 0xa5521500 0x100 0x2a60315 0x1 0x2a766 0x15000000 0x10002a9 0x3150000 0x10002 0xaa7c1500 0x100 0x2ab0315 0x1 0x2ac9c 0x15000000 0x10002ad 0x3150000 0x10002 0xaeb71500 0x100 0x2af0315 0x1 0x2b0cc 0x15000000 0x10002b1 0x3150000 0x10002 0xb2cf1500 0x100 0x2b30015 0x1 0x2b4bc 0x15000000 0x10002b5 0x150000 0x10002 0xb6c51500 0x100 0x2b70015 0x1 0x2b8d4 0x15000000 0x10002b9 0x150000 0x10002 0xbae21500 0x100 0x2bb0015 0x1 0x2bcef 0x15000000 0x10002bd 0x150000 0x10002 0xbefb1500 0x100 0x2bf0115 0x1 0x2c006 0x15000000 0x10002c1 0x1150000 0x10002 0xc2101500 0x100 0x2c30115 0x1000001 0x2c41b 0x15000000 0x10002c5 0x1150000 0x10002 0xc63d1500 0x100 0x2c70115 0x1 0x2c85b 0x15000000 0x10002c9 0x1150000 0x10002 0xca8e1500 0x100 0x2cb0115 0x1 0x2ccb7 0x15000000 0x10002cd 0x1150000 0x10002 0xcef71500 0x100 0x2cf0215 0x1 0x2d02d 0x15000000 0x10002d1 0x2150000 0x10002 0xd22e1500 0x100 0x2d30215 0x1 0x2d45f 0x15000000 0x10002d5 0x2150000 0x10002 0xd6961500 0x100 0x2d70215 0x1 0x2d8b9 0x15000000 0x10002d9 0x2150000 0x10002 0xdaeb1500 0x100 0x2db0315 0x1 0x2dc0f 0x15000000 0x10002dd 0x3150000 0x10002 0xde351500 0x100 0x2df0315 0x1 0x2e042 0x15000000 0x10002e1 0x3150000 0x10002 0xe2521500 0x100 0x2e30315 0x1 0x2e466 0x15000000 0x10002e5 0x3150000 0x10002 0xe67c1500 0x100 0x2e70315 0x1 0x2e89c 0x15000000 0x10002e9 0x3150000 0x10002 0xeab71500 0x100 0x2eb0315 0x1000001 0x2eccc 0x15000000 0x10002ed 0x3150000 0x10002 0xeecf1500 0x100 0x2ef0015 0x1 0x2f0f1 0x15000000 0x10002f1 0x150000 0x10002 0xf2f71500 0x100 0x2f30115 0x1 0x2f402 0x15000000 0x10002f5 0x1150000 0x10002 0xf60d1500 0x100 0x2f70115 0x1 0x2f817 0x15000000 0x10002f9 0x1150000 0x10002 0xfa201500 0x1000 0x2ff0215 0x1 0x2fb01 0x15000000 0x1000200 0x1150000 0x10002 0x1291500 0x100 0x2020115 0x1 0x20332 0x15000000 0x1000204 0x1150000 0x10002 0x53a1500 0x100 0x2060115 0x1 0x20758 0x15000000 0x1000208 0x1150000 0x10002 0x9721500 0x100 0x20a0115 0x1 0x20b9f 0x15000000 0x100020c 0x1150000 0x10002 0xdc51500 0x100 0x20e0215 0x1 0x20f01 0x15000000 0x1000210 0x2150000 0x10002 0x11341500 0x100 0x2120215 0x1 0x21335 0x15000000 0x1000214 0x2150000 0x10002 0x15651500 0x100 0x2160215 0x1000001 0x2179c 0x15000000 0x1000218 0x2150000 0x10002 0x19bf1500 0x100 0x21a0215 0x1 0x21bf2 0x15000000 0x100021c 0x3150000 0x10002 0x1d131500 0x100 0x21e0315 0x1 0x21f3f 0x15000000 0x1000220 0x3150000 0x10002 0x214c1500 0x100 0x2220315 0x1 0x2235b 0x15000000 0x1000224 0x3150000 0x10002 0x256b1500 0x100 0x2260315 0x1 0x2277d 0x15000000 0x1000228 0x3150000 0x10002 0x29941500 0x100 0x22a0315 0x1 0x22bb1 0x15000000 0x100022d 0x3150000 0x10002 0x2fcb1500 0x100 0x2300315 0x1 0x231cf 0x15000000 0x1000232 0x150000 0x10002 0x33f11500 0x100 0x2340015 0x1 0x235f7 0x15000000 0x1000236 0x1150000 0x10002 0x37021500 0x100 0x2380115 0x1 0x2390d 0x15000000 0x100023a 0x1150000 0x10002 0x3b171500 0x100 0x23d0115 0x1 0x23f20 0x15000000 0x1000240 0x1150000 0x10002 0x41291500 0x100 0x2420115 0x1000001 0x24332 0x15000000 0x1000244 0x1150000 0x10002 0x453a1500 0x100 0x2460115 0x1 0x24758 0x15000000 0x1000248 0x1150000 0x10002 0x49721500 0x100 0x24a0115 0x1 0x24b9f 0x15000000 0x100024c 0x1150000 0x10002 0x4dc51500 0x100 0x24e0215 0x1 0x24f01 0x15000000 0x1000250 0x2150000 0x10002 0x51341500 0x100 0x2520215 0x1 0x25335 0x15000000 0x1000254 0x2150000 0x10002 0x55651500 0x100 0x2560215 0x1 0x2589c 0x15000000 0x1000259 0x2150000 0x10002 0x5abf1500 0x100 0x25b0215 0x1 0x25cf2 0x15000000 0x100025d 0x3150000 0x10002 0x5e131500 0x100 0x25f0315 0x1 0x2603f 0x15000000 0x1000261 0x3150000 0x10002 0x624c1500 0x100 0x2630315 0x1 0x2645b 0x15000000 0x1000265 0x3150000 0x10002 0x666b1500 0x100 0x2670315 0x1 0x2687d 0x15000000 0x1000269 0x3150000 0x10002 0x6a941500 0x100 0x26b0315 0x1000001 0x26cb1 0x15000000 0x100026d 0x3150000 0x10002 0x6ecb1500 0x100 0x26f0315 0x1 0x270cf 0x15000000 0x1000271 0x150000 0x10002 0x727a1500 0x100 0x2730015 0x1 0x27488 0x15000000 0x1000275 0x150000 0x10002 0x769f1500 0x100 0x2770015 0x1 0x278b3 0x15000000 0x1000279 0x150000 0x10002 0x7ac51500 0x100 0x27b0015 0x1 0x27cd4 0x15000000 0x100027d 0x150000 0x10002 0x7ee21500 0x100 0x27f0015 0x1 0x280ee 0x15000000 0x1000281 0x150000 0x10002 0x82fc1500 0x100 0x2830115 0x1 0x28423 0x15000000 0x1000285 0x1150000 0x10002 0x86451500 0x100 0x2870115 0x1 0x2887e 0x15000000 0x1000289 0x1150000 0x10002 0x8aaa1500 0x100 0x28b0115 0x1 0x28cf0 0x15000000 0x100028d 0x2150000 0x10002 0x8e271500 0x100 0x28f0215 0x1 0x29028 0x15000000 0x1000291 0x2150000 0x10002 0x925b1500 0x100 0x2930215 0x1000001 0x29491 0x15000000 0x1000295 0x2150000 0x10002 0x96b51500 0x100 0x2970215 0x1 0x298e8 0x15000000 0x1000299 0x3150000 0x10002 0x9a0d1500 0x100 0x29b0315 0x1 0x29c40 0x15000000 0x100029d 0x3150000 0x10002 0x9e551500 0x100 0x29f0315 0x1 0x2a07a 0x15000000 0x10002a2 0x3150000 0x10002 0xa39c1500 0x100 0x2a40315 0x1 0x2a5a5 0x15000000 0x10002a6 0x3150000 0x10002 0xa7af1500 0x100 0x2a90315 0x10 0x2aab8 0x15000000 0x10002ab 0x3150000 0x10002 0xacce1500 0x100 0x2ad0315 0x1 0x2aecf 0x15000000 0x10002af 0x150000 0x10002 0xb07a1500 0x100 0x2b10015 0x1 0x2b288 0x15000000 0x10002b3 0x150000 0x10002 0xb49f1500 0x100 0x2b50015 0x1 0x2b6b3 0x15000000 0x10002b7 0x150000 0x10002 0xb8c51500 0x100 0x2b90015 0x1 0x2bad4 0x15000000 0x10002bb 0x150000 0x10002 0xbce21500 0x100 0x2bd0015 0x1000001 0x2beee 0x15000000 0x10002bf 0x150000 0x10002 0xc0fc1500 0x100 0x2c10115 0x1 0x2c223 0x15000000 0x10002c3 0x1150000 0x10002 0xc4451500 0x100 0x2c50115 0x1 0x2c67e 0x15000000 0x10002c7 0x1150000 0x10002 0xc8aa1500 0x100 0x2c90115 0x1 0x2caf0 0x15000000 0x10002cb 0x2150000 0x10002 0xcc271500 0x100 0x2cd0215 0x1 0x2ce28 0x15000000 0x10002cf 0x2150000 0x10002 0xd05b1500 0x100 0x2d10215 0x1 0x2d291 0x15000000 0x10002d3 0x2150000 0x10002 0xd4b51500 0x100 0x2d50215 0x1 0x2d6e8 0x15000000 0x10002d7 0x3150000 0x10002 0xd80d1500 0x100 0x2d90315 0x1 0x2da40 0x15000000 0x10002db 0x3150000 0x10002 0xdc551500 0x100 0x2dd0315 0x1 0x2de7a 0x15000000 0x10002df 0x3150000 0x10002 0xe09c1500 0x100 0x2e10315 0x1 0x2e2a5 0x15000000 0x10002e3 0x3150000 0x10002 0xe4af1500 0x100 0x2e50315 0x1 0x2e6b8 0x15000000 0x10002e7 0x3150000 0x10002 0xe8ce1500 0x100 0x2e90315 0x1000001 0x2eacf>;
		qcom,mdss-dsi-dispparam-cold-command-state = "dsi_hs_mode";
		qcom,mdss-dsi-dispparam-cabcon-command = [15 00 00 00 01 00 02 ff 10 15 01 00 00 01 00 02 55 01];
		qcom,mdss-dsi-dispparam-cabcon-command-state = "dsi_hs_mode";
		qcom,mdss-dsi-dispparam-cabcguion-command = [15 00 00 00 01 00 02 ff 10 15 01 00 00 01 00 02 55 01];
		qcom,mdss-dsi-dispparam-cabcguion-command-state = "dsi_hs_mode";
		qcom,mdss-dsi-dispparam-cabcstillon-command = [15 00 00 00 01 00 02 ff 10 15 01 00 00 01 00 02 55 02];
		qcom,mdss-dsi-dispparam-cabcstillon-command-state = "dsi_hs_mode";
		qcom,mdss-dsi-dispparam-cabcmovieon-command = [15 00 00 00 01 00 02 ff 10 15 01 00 00 01 00 02 55 03];
		qcom,mdss-dsi-dispparam-cabcmovieon-command-state = "dsi_hs_mode";
		qcom,mdss-dsi-dispparam-cabcoff-command = [15 00 00 00 01 00 02 ff 10 15 01 00 00 01 00 02 55 00];
		qcom,mdss-dsi-dispparam-cabcoff-command-state = "dsi_hs_mode";
		qcom,mdss-dsi-dispparam-nightmode1-command = <0x15000000 0x10002ff 0x1150000 0x10002 0xfb011500 0x100 0x2750115 0x1 0x2765c 0x15000000 0x1000277 0x1150000 0x10002 0x785f1500 0x100 0x2790115 0x1 0x27a65 0x15000000 0x100027b 0x1150000 0x10002 0x7c6b1500 0x100 0x27d0115 0x1 0x27e71 0x15000000 0x100027f 0x1150000 0x10002 0x80761500 0x100 0x2810115 0x1 0x2827c 0x15000000 0x1000283 0x1150000 0x10002 0x84811500 0x100 0x2850115 0x1 0x28686 0x15000000 0x1000287 0x1150000 0x10002 0x889a1500 0x100 0x2890115 0x1 0x28aac 0x15000000 0x100028b 0x1150000 0x10002 0x8ccc1500 0x100 0x28d0115 0x1 0x28ee9 0x15000000 0x100028f 0x2150000 0x10002 0x90191500 0x100 0x2910215 0x1 0x29244 0x15000000 0x1000293 0x2150000 0x10002 0x94451500 0x100 0x2950215 0x1 0x29670 0x15000000 0x1000297 0x2150000 0x10002 0x98a31500 0x100 0x2990215 0x1000001 0x29ac6 0x15000000 0x100029b 0x2150000 0x10002 0x9cf61500 0x100 0x29d0315 0x1 0x29e16 0x15000000 0x100029f 0x3150000 0x10002 0xa03f1500 0x100 0x2a20315 0x1 0x2a34c 0x15000000 0x10002a4 0x3150000 0x10002 0xa55a1500 0x100 0x2a60315 0x1 0x2a76c 0x15000000 0x10002a9 0x3150000 0x10002 0xaa821500 0x100 0x2ab0315 0x1 0x2aca1 0x15000000 0x10002ad 0x3150000 0x10002 0xaebe1500 0x100 0x2af0315 0x1 0x2b0cd 0x15000000 0x10002b1 0x3150000 0x10002 0xb2cf1500 0x100 0x2b30115 0x1 0x2b45c 0x15000000 0x10002b5 0x1150000 0x10002 0xb65f1500 0x100 0x2b70115 0x1 0x2b865 0x15000000 0x10002b9 0x1150000 0x10002 0xba6b1500 0x100 0x2bb0115 0x1 0x2bc71 0x15000000 0x10002bd 0x1150000 0x10002 0xbe761500 0x100 0x2bf0115 0x1 0x2c07c 0x15000000 0x10002c1 0x1150000 0x10002 0xc2811500 0x100 0x2c30115 0x1000001 0x2c486 0x15000000 0x10002c5 0x1150000 0x10002 0xc69a1500 0x100 0x2c70115 0x1 0x2c8ac 0x15000000 0x10002c9 0x1150000 0x10002 0xcacc1500 0x100 0x2cb0115 0x1 0x2cce9 0x15000000 0x10002cd 0x2150000 0x10002 0xce191500 0x100 0x2cf0215 0x1 0x2d044 0x15000000 0x10002d1 0x2150000 0x10002 0xd2451500 0x100 0x2d30215 0x1 0x2d470 0x15000000 0x10002d5 0x2150000 0x10002 0xd6a31500 0x100 0x2d70215 0x1 0x2d8c6 0x15000000 0x10002d9 0x2150000 0x10002 0xdaf61500 0x100 0x2db0315 0x1 0x2dc16 0x15000000 0x10002dd 0x3150000 0x10002 0xde3f1500 0x100 0x2df0315 0x1 0x2e04c 0x15000000 0x10002e1 0x3150000 0x10002 0xe25a1500 0x100 0x2e30315 0x1 0x2e46c 0x15000000 0x10002e5 0x3150000 0x10002 0xe6821500 0x100 0x2e70315 0x1 0x2e8a1 0x15000000 0x10002e9 0x3150000 0x10002 0xeabe1500 0x100 0x2eb0315 0x1000001 0x2eccd 0x15000000 0x10002ed 0x3150000 0x10002 0xeecf1500 0x100 0x2ef0115 0x1 0x2f064 0x15000000 0x10002f1 0x1150000 0x10002 0xf2671500 0x100 0x2f30115 0x1 0x2f46d 0x15000000 0x10002f5 0x1150000 0x10002 0xf6731500 0x100 0x2f70115 0x1 0x2f878 0x15000000 0x10002f9 0x1150000 0x10002 0xfa7e1500 0x1000 0x2ff0215 0x1 0x2fb01 0x15000000 0x1000200 0x1150000 0x10002 0x1831500 0x100 0x2020115 0x1 0x20388 0x15000000 0x1000204 0x1150000 0x10002 0x58d1500 0x100 0x2060115 0x1 0x207a0 0x15000000 0x1000208 0x1150000 0x10002 0x9b21500 0x100 0x20a0115 0x1 0x20bd2 0x15000000 0x100020c 0x1150100 0x10002 0xded1500 0x100 0x20e0215 0x1 0x20f1d 0x15000000 0x1000210 0x2150000 0x10002 0x11481500 0x100 0x2120215 0x1 0x21349 0x15000000 0x1000214 0x2150000 0x10002 0x15741500 0x100 0x2160215 0x1 0x217a7 0x15000000 0x1000218 0x2150000 0x10002 0x19cd1500 0x100 0x21a0215 0x1 0x21bfe 0x15000000 0x100021c 0x3150000 0x10002 0x1d1e1500 0x100 0x21e0315 0x1 0x21f47 0x15000000 0x1000220 0x3150000 0x10002 0x21541500 0x100 0x2220315 0x1 0x22363 0x15000000 0x1000224 0x3150000 0x10002 0x25741500 0x100 0x2260315 0x1 0x2278a 0x15000000 0x1000228 0x3150000 0x10002 0x29a61500 0x100 0x22a0315 0x1 0x22bbf 0x15000000 0x100022d 0x3150000 0x10002 0x2fcd1500 0x100 0x2300315 0x1 0x231cf 0x15000000 0x1000232 0x1150000 0x10002 0x33641500 0x100 0x2340115 0x1 0x23567 0x15000000 0x1000236 0x1150100 0x10002 0x376d1500 0x100 0x2380115 0x1 0x23973 0x15000000 0x100023a 0x1150000 0x10002 0x3b781500 0x100 0x23d0115 0x1 0x23f7e 0x15000000 0x1000240 0x1150000 0x10002 0x41831500 0x100 0x2420115 0x1 0x24388 0x15000000 0x1000244 0x1150000 0x10002 0x458d1500 0x100 0x2460115 0x1 0x247a0 0x15000000 0x1000248 0x1150000 0x10002 0x49b21500 0x100 0x24a0115 0x1 0x24bd2 0x15000000 0x100024c 0x1150000 0x10002 0x4ded1500 0x100 0x24e0215 0x1 0x24f1d 0x15000000 0x1000250 0x2150000 0x10002 0x51481500 0x100 0x2520215 0x1 0x25349 0x15000000 0x1000254 0x2150000 0x10002 0x55741500 0x100 0x2560215 0x1 0x258a7 0x15000000 0x1000259 0x2150000 0x10002 0x5acd1500 0x100 0x25b0215 0x1 0x25cfe 0x15000000 0x100025d 0x3150000 0x10002 0x5e1e1500 0x100 0x25f0315 0x1 0x26047 0x15000000 0x1000261 0x3150100 0x10002 0x62541500 0x100 0x2630315 0x1 0x26463 0x15000000 0x1000265 0x3150000 0x10002 0x66741500 0x100 0x2670315 0x1 0x2688a 0x15000000 0x1000269 0x3150000 0x10002 0x6aa61500 0x100 0x26b0315 0x1 0x26cbf 0x15000000 0x100026d 0x3150000 0x10002 0x6ecd1500 0x100 0x26f0315 0x1 0x270cf 0x15000000 0x1000271 0x1150000 0x10002 0x72691500 0x100 0x2730115 0x1 0x2746c 0x15000000 0x1000275 0x1150000 0x10002 0x76711500 0x100 0x2770115 0x1 0x27877 0x15000000 0x1000279 0x1150000 0x10002 0x7a7c1500 0x100 0x27b0115 0x1 0x27c81 0x15000000 0x100027d 0x1150000 0x10002 0x7e861500 0x100 0x27f0115 0x1 0x2808b 0x15000000 0x1000281 0x1150000 0x10002 0x82901500 0x100 0x2830115 0x1 0x284a3 0x15000000 0x1000285 0x1150000 0x10002 0x86b41500 0x100 0x2870115 0x1 0x288d3 0x15010000 0x1000289 0x1150000 0x10002 0x8aee1500 0x100 0x28b0215 0x1 0x28c1d 0x15000000 0x100028d 0x2150000 0x10002 0x8e471500 0x100 0x28f0215 0x1 0x29048 0x15000000 0x1000291 0x2150000 0x10002 0x92731500 0x100 0x2930215 0x1 0x294a5 0x15000000 0x1000295 0x2150000 0x10002 0x96c81500 0x100 0x2970215 0x1 0x298f8 0x15000000 0x1000299 0x3150000 0x10002 0x9a191500 0x100 0x29b0315 0x1 0x29c41 0x15000000 0x100029d 0x3150000 0x10002 0x9e4d1500 0x100 0x29f0315 0x1 0x2a05a 0x15000000 0x10002a2 0x3150000 0x10002 0xa36a1500 0x100 0x2a40315 0x1 0x2a57f 0x15000000 0x10002a6 0x3150000 0x10002 0xa79a1500 0x100 0x2a90315 0x10 0x2aab9 0x15000000 0x10002ab 0x3150000 0x10002 0xaccd1500 0x100 0x2ad0315 0x1 0x2aecf 0x15000000 0x10002af 0x1150000 0x10002 0xb0691500 0x100 0x2b10115 0x1 0x2b26c 0x15000000 0x10002b3 0x1150100 0x10002 0xb4711500 0x100 0x2b50115 0x1 0x2b677 0x15000000 0x10002b7 0x1150000 0x10002 0xb87c1500 0x100 0x2b90115 0x1 0x2ba81 0x15000000 0x10002bb 0x1150000 0x10002 0xbc861500 0x100 0x2bd0115 0x1 0x2be8b 0x15000000 0x10002bf 0x1150000 0x10002 0xc0901500 0x100 0x2c10115 0x1 0x2c2a3 0x15000000 0x10002c3 0x1150000 0x10002 0xc4b41500 0x100 0x2c50115 0x1 0x2c6d3 0x15000000 0x10002c7 0x1150000 0x10002 0xc8ee1500 0x100 0x2c90215 0x1 0x2ca1d 0x15000000 0x10002cb 0x2150000 0x10002 0xcc471500 0x100 0x2cd0215 0x1 0x2ce48 0x15000000 0x10002cf 0x2150000 0x10002 0xd0731500 0x100 0x2d10215 0x1 0x2d2a5 0x15000000 0x10002d3 0x2150000 0x10002 0xd4c81500 0x100 0x2d50215 0x1 0x2d6f8 0x15000000 0x10002d7 0x3150000 0x10002 0xd8191500 0x100 0x2d90315 0x1 0x2da41 0x15000000 0x10002db 0x3150100 0x10002 0xdc4d1500 0x100 0x2dd0315 0x1 0x2de5a 0x15000000 0x10002df 0x3150000 0x10002 0xe06a1500 0x100 0x2e10315 0x1 0x2e27f 0x15000000 0x10002e3 0x3150000 0x10002 0xe49a1500 0x100 0x2e50315 0x1 0x2e6b9 0x15000000 0x10002e7 0x3150000 0x10002 0xe8cd1500 0x100 0x2e90315 0x1000001 0x2eacf>;
		qcom,mdss-dsi-dispparam-nightmode1-command-state = "dsi_hs_mode";
		qcom,mdss-dsi-dispparam-nightmode2-command = <0x15000000 0x10002ff 0x1150000 0x10002 0xfb011500 0x100 0x2750115 0x1 0x276c7 0x15000000 0x1000277 0x1150000 0x10002 0x78c91500 0x100 0x2790115 0x1 0x27acc 0x15000000 0x100027b 0x1150000 0x10002 0x7ccf1500 0x100 0x27d0115 0x1 0x27ed2 0x15000000 0x100027f 0x1150000 0x10002 0x80d51500 0x100 0x2810115 0x1 0x282d8 0x15000000 0x1000283 0x1150000 0x10002 0x84db1500 0x100 0x2850115 0x1 0x286de 0x15000000 0x1000287 0x1150000 0x10002 0x88e91500 0x100 0x2890115 0x1 0x28af3 0x15000000 0x100028b 0x2150000 0x10002 0x8c081500 0x100 0x28d0215 0x1 0x28e1b 0x15000000 0x100028f 0x2150000 0x10002 0x903e1500 0x100 0x2910215 0x1 0x29261 0x15000000 0x1000293 0x2150000 0x10002 0x94631500 0x100 0x2950215 0x1 0x29689 0x15000000 0x1000297 0x2150000 0x10002 0x98b91500 0x100 0x2990215 0x1 0x29ade 0x15010000 0x100029b 0x3150000 0x10002 0x9c0b1500 0x100 0x29d0315 0x1 0x29e29 0x15000000 0x100029f 0x3150000 0x10002 0xa0501500 0x100 0x2a20315 0x1 0x2a35c 0x15000000 0x10002a4 0x3150000 0x10002 0xa56b1500 0x100 0x2a60315 0x1 0x2a77d 0x15000000 0x10002a9 0x3150000 0x10002 0xaa941500 0x100 0x2ab0315 0x1 0x2acaf 0x15000000 0x10002ad 0x3150000 0x10002 0xaec31500 0x100 0x2af0315 0x1 0x2b0ce 0x15000000 0x10002b1 0x3150000 0x10002 0xb2cf1500 0x100 0x2b30115 0x1 0x2b4c7 0x15000000 0x10002b5 0x1150000 0x10002 0xb6c91500 0x100 0x2b70115 0x1 0x2b8cc 0x15000000 0x10002b9 0x1150000 0x10002 0xbacf1500 0x100 0x2bb0115 0x1 0x2bcd2 0x15000000 0x10002bd 0x1150000 0x10002 0xbed51500 0x100 0x2bf0115 0x1 0x2c0d8 0x15000000 0x10002c1 0x1150000 0x10002 0xc2db1500 0x100 0x2c30115 0x1 0x2c4de 0x15010000 0x10002c5 0x1150000 0x10002 0xc6e91500 0x100 0x2c70115 0x1 0x2c8f3 0x15000000 0x10002c9 0x2150000 0x10002 0xca081500 0x100 0x2cb0215 0x1 0x2cc1b 0x15000000 0x10002cd 0x2150000 0x10002 0xce3e1500 0x100 0x2cf0215 0x1 0x2d061 0x15000000 0x10002d1 0x2150000 0x10002 0xd2631500 0x100 0x2d30215 0x1 0x2d489 0x15000000 0x10002d5 0x2150000 0x10002 0xd6b91500 0x100 0x2d70215 0x1 0x2d8de 0x15000000 0x10002d9 0x3150000 0x10002 0xda0b1500 0x100 0x2db0315 0x1 0x2dc29 0x15000000 0x10002dd 0x3150000 0x10002 0xde501500 0x100 0x2df0315 0x1 0x2e05c 0x15000000 0x10002e1 0x3150000 0x10002 0xe26b1500 0x100 0x2e30315 0x1 0x2e47d 0x15000000 0x10002e5 0x3150000 0x10002 0xe6941500 0x100 0x2e70315 0x1 0x2e8af 0x15000000 0x10002e9 0x3150000 0x10002 0xeac31500 0x100 0x2eb0315 0x1 0x2ecce 0x15010000 0x10002ed 0x3150000 0x10002 0xeecf1500 0x100 0x2ef0115 0x1 0x2f0cb 0x15000000 0x10002f1 0x1150000 0x10002 0xf2cd1500 0x100 0x2f30115 0x1 0x2f4d0 0x15000000 0x10002f5 0x1150000 0x10002 0xf6d31500 0x100 0x2f70115 0x1 0x2f8d6 0x15000000 0x10002f9 0x1150000 0x10002 0xfad91500 0x100 0x2ff0215 0x1 0x2fb01 0x15000000 0x10000200 0x1150000 0x10002 0x1dc1500 0x100 0x2020115 0x1 0x203df 0x15000000 0x1000204 0x1150000 0x10002 0x5e21500 0x100 0x2060115 0x1 0x207ed 0x15000000 0x1000208 0x1150000 0x10002 0x9f71500 0x100 0x20a0215 0x1 0x20b0b 0x15000000 0x100020c 0x2150000 0x10002 0xd1e1500 0x100 0x20e0215 0x1000001 0x20f42 0x15000000 0x1000210 0x2150000 0x10002 0x11651500 0x100 0x2120215 0x1 0x21366 0x15000000 0x1000214 0x2150000 0x10002 0x158c1500 0x100 0x2160215 0x1 0x217bf 0x15000000 0x1000218 0x2150000 0x10002 0x19e41500 0x100 0x21a0315 0x1 0x21b13 0x15000000 0x100021c 0x3150000 0x10002 0x1d311500 0x100 0x21e0315 0x1 0x21f58 0x15000000 0x1000220 0x3150000 0x10002 0x21641500 0x100 0x2220315 0x1 0x22373 0x15000000 0x1000224 0x3150000 0x10002 0x25851500 0x100 0x2260315 0x1 0x2279b 0x15000000 0x1000228 0x3150000 0x10002 0x29b11500 0x100 0x22a0315 0x1 0x22bc4 0x15000000 0x100022d 0x3150000 0x10002 0x2fce1500 0x100 0x2300315 0x1 0x231cf 0x15000000 0x1000232 0x1150000 0x10002 0x33cb1500 0x100 0x2340115 0x1 0x235cd 0x15000000 0x1000236 0x1150000 0x10002 0x37d01500 0x100 0x2380115 0x1000001 0x239d3 0x15000000 0x100023a 0x1150000 0x10002 0x3bd61500 0x100 0x23d0115 0x1 0x23fd9 0x15000000 0x1000240 0x1150000 0x10002 0x41dc1500 0x100 0x2420115 0x1 0x243df 0x15000000 0x1000244 0x1150000 0x10002 0x45e21500 0x100 0x2460115 0x1 0x247ed 0x15000000 0x1000248 0x1150000 0x10002 0x49f71500 0x100 0x24a0215 0x1 0x24b0b 0x15000000 0x100024c 0x2150000 0x10002 0x4d1e1500 0x100 0x24e0215 0x1 0x24f42 0x15000000 0x1000250 0x2150000 0x10002 0x51651500 0x100 0x2520215 0x1 0x25366 0x15000000 0x1000254 0x2150000 0x10002 0x558c1500 0x100 0x2560215 0x1 0x258bf 0x15000000 0x1000259 0x2150000 0x10002 0x5ae41500 0x100 0x25b0315 0x1 0x25c13 0x15000000 0x100025d 0x3150000 0x10002 0x5e311500 0x100 0x25f0315 0x1 0x26058 0x15000000 0x1000261 0x3150000 0x10002 0x62641500 0x100 0x2630315 0x1000001 0x26473 0x15000000 0x1000265 0x3150000 0x10002 0x66851500 0x100 0x2670315 0x1 0x2689b 0x15000000 0x1000269 0x3150000 0x10002 0x6ab11500 0x100 0x26b0315 0x1 0x26cc4 0x15000000 0x100026d 0x3150000 0x10002 0x6ece1500 0x100 0x26f0315 0x1 0x270cf 0x15000000 0x1000271 0x1150000 0x10002 0x72cd1500 0x100 0x2730115 0x1 0x274cf 0x15000000 0x1000275 0x1150000 0x10002 0x76d21500 0x100 0x2770115 0x1 0x278d5 0x15000000 0x1000279 0x1150000 0x10002 0x7ad71500 0x100 0x27b0115 0x1 0x27cda 0x15000000 0x100027d 0x1150000 0x10002 0x7edd1500 0x100 0x27f0115 0x1 0x280e0 0x15000000 0x1000281 0x1150000 0x10002 0x82e31500 0x100 0x2830115 0x1 0x284ee 0x15000000 0x1000285 0x1150000 0x10002 0x86f71500 0x100 0x2870215 0x1 0x2880c 0x15000000 0x1000289 0x2150000 0x10002 0x8a1e1501 0x100 0x28b0215 0x1 0x28c41 0x15000000 0x100028d 0x2150000 0x10002 0x8e641500 0x100 0x28f0215 0x1 0x29065 0x15000000 0x1000291 0x2150000 0x10002 0x928b1500 0x100 0x2930215 0x1 0x294bb 0x15000000 0x1000295 0x2150000 0x10002 0x96df1500 0x100 0x2970315 0x1 0x2980d 0x15000000 0x1000299 0x3150000 0x10002 0x9a2b1500 0x100 0x29b0315 0x1 0x29c51 0x15000000 0x100029d 0x3150000 0x10002 0x9e5c1500 0x100 0x29f0315 0x1 0x2a06a 0x15000000 0x10002a2 0x3150000 0x10002 0xa37a1500 0x100 0x2a40315 0x1 0x2a58e 0x15000000 0x10002a6 0x3150000 0x10002 0xa7a81500 0x100 0x2a90315 0x1 0x2aac0 0x15000000 0x10002ab 0x3150000 0x100002 0xaccd1500 0x100 0x2ad0315 0x1 0x2aecf 0x15000000 0x10002af 0x1150000 0x10002 0xb0cd1500 0x100 0x2b10115 0x1 0x2b2cf 0x15000000 0x10002b3 0x1150000 0x10002 0xb4d21500 0x100 0x2b50115 0x1000001 0x2b6d5 0x15000000 0x10002b7 0x1150000 0x10002 0xb8d71500 0x100 0x2b90115 0x1 0x2bada 0x15000000 0x10002bb 0x1150000 0x10002 0xbcdd1500 0x100 0x2bd0115 0x1 0x2bee0 0x15000000 0x10002bf 0x1150000 0x10002 0xc0e31500 0x100 0x2c10115 0x1 0x2c2ee 0x15000000 0x10002c3 0x1150000 0x10002 0xc4f71500 0x100 0x2c50215 0x1 0x2c60c 0x15000000 0x10002c7 0x2150000 0x10002 0xc81e1500 0x100 0x2c90215 0x1 0x2ca41 0x15000000 0x10002cb 0x2150000 0x10002 0xcc641500 0x100 0x2cd0215 0x1 0x2ce65 0x15000000 0x10002cf 0x2150000 0x10002 0xd08b1500 0x100 0x2d10215 0x1 0x2d2bb 0x15000000 0x10002d3 0x2150000 0x10002 0xd4df1500 0x100 0x2d50315 0x1 0x2d60d 0x15000000 0x10002d7 0x3150000 0x10002 0xd82b1500 0x100 0x2d90315 0x1 0x2da51 0x15000000 0x10002db 0x3150000 0x10002 0xdc5c1500 0x100 0x2dd0315 0x1000001 0x2de6a 0x15000000 0x10002df 0x3150000 0x10002 0xe07a1500 0x100 0x2e10315 0x1 0x2e28e 0x15000000 0x10002e3 0x3150000 0x10002 0xe4a81500 0x100 0x2e50315 0x1 0x2e6c0 0x15000000 0x10002e7 0x3150000 0x10002 0xe8cd1500 0x100 0x2e90315 0x1 0x2eacf>;
		qcom,mdss-dsi-dispparam-nightmode2-command-state = "dsi_hs_mode";
		qcom,mdss-dsi-dispparam-nightmode3-command = <0x15000000 0x10002ff 0x1150000 0x10002 0xfb011500 0x100 0x2750215 0x1 0x27610 0x15000000 0x1000277 0x2150000 0x10002 0x78111500 0x100 0x2790215 0x1 0x27a13 0x15000000 0x100027b 0x2150000 0x10002 0x7c151500 0x100 0x27d0215 0x1 0x27e17 0x15000000 0x100027f 0x2150000 0x10002 0x80181500 0x100 0x2810215 0x1 0x2821a 0x15000000 0x1000283 0x2150000 0x10002 0x841c1500 0x100 0x2850215 0x1000001 0x2861e 0x15000000 0x1000287 0x2150000 0x10002 0x88251500 0x100 0x2890215 0x1 0x28a2c 0x15000000 0x100028b 0x2150000 0x10002 0x8c3a1500 0x100 0x28d0215 0x1 0x28e48 0x15000000 0x100028f 0x2150000 0x10002 0x90631500 0x100 0x2910215 0x1 0x29281 0x15000000 0x1000293 0x2150000 0x10002 0x94821500 0x100 0x2950215 0x1 0x296a5 0x15000000 0x1000297 0x2150000 0x10002 0x98d71500 0x100 0x2990215 0x1 0x29af7 0x15000000 0x100029b 0x3150000 0x10002 0x9c231500 0x100 0x29d0315 0x1 0x29e3f 0x15000000 0x100029f 0x3150000 0x10002 0xa0641500 0x100 0x2a20315 0x1 0x2a371 0x15000000 0x10002a4 0x3150000 0x10002 0xa5801500 0x100 0x2a60315 0x1 0x2a793 0x15000000 0x10002a9 0x3150000 0x10002 0xaaa81500 0x100 0x2ab0315 0x1 0x2acba 0x15000000 0x10002ad 0x3150000 0x10002 0xaec81500 0x100 0x2af0315 0x1000001 0x2b0ce 0x15000000 0x10002b1 0x3150000 0x10002 0xb2cf1500 0x100 0x2b30215 0x1 0x2b410 0x15000000 0x10002b5 0x2150000 0x10002 0xb6111500 0x100 0x2b70215 0x1 0x2b813 0x15000000 0x10002b9 0x2150000 0x10002 0xba151500 0x100 0x2bb0215 0x1 0x2bc17 0x15000000 0x10002bd 0x2150000 0x10002 0xbe181500 0x100 0x2bf0215 0x1 0x2c01a 0x15000000 0x10002c1 0x2150000 0x10002 0xc21c1500 0x100 0x2c30215 0x1 0x2c41e 0x15000000 0x10002c5 0x2150000 0x10002 0xc6251500 0x100 0x2c70215 0x1 0x2c82c 0x15000000 0x10002c9 0x2150000 0x10002 0xca3a1500 0x100 0x2cb0215 0x1 0x2cc48 0x15000000 0x10002cd 0x2150000 0x10002 0xce631500 0x100 0x2cf0215 0x1 0x2d081 0x15000000 0x10002d1 0x2150000 0x10002 0xd2821500 0x100 0x2d30215 0x1 0x2d4a5 0x15000000 0x10002d5 0x2150000 0x10002 0xd6d71500 0x100 0x2d70215 0x1000001 0x2d8f7 0x15000000 0x10002d9 0x3150000 0x10002 0xda231500 0x100 0x2db0315 0x1 0x2dc3f 0x15000000 0x10002dd 0x3150000 0x10002 0xde641500 0x100 0x2df0315 0x1 0x2e071 0x15000000 0x10002e1 0x3150000 0x10002 0xe2801500 0x100 0x2e30315 0x1 0x2e493 0x15000000 0x10002e5 0x3150000 0x10002 0xe6a81500 0x100 0x2e70315 0x1 0x2e8ba 0x15000000 0x10002e9 0x3150000 0x10002 0xeac81500 0x100 0x2eb0315 0x1 0x2ecce 0x15000000 0x10002ed 0x3150000 0x10002 0xeecf1500 0x100 0x2ef0215 0x1 0x2f017 0x15000000 0x10002f1 0x2150000 0x10002 0xf2181500 0x100 0x2f30215 0x1 0x2f41a 0x15000000 0x10002f5 0x2150000 0x10002 0xf61c1500 0x100 0x2f70215 0x1 0x2f81d 0x15000000 0x10002f9 0x2150100 0x100002 0xfa1f1500 0x100 0x2ff0215 0x1 0x2fb01 0x15000000 0x1000200 0x2150000 0x10002 0x1211500 0x100 0x2020215 0x1 0x20323 0x15000000 0x1000204 0x2150000 0x10002 0x5241500 0x100 0x2060215 0x1 0x2072b 0x15000000 0x1000208 0x2150000 0x10002 0x9321500 0x100 0x20a0215 0x1 0x20b40 0x15000000 0x100020c 0x2150000 0x10002 0xd4d1500 0x100 0x20e0215 0x1 0x20f69 0x15000000 0x1000210 0x2150000 0x10002 0x11871500 0x100 0x2120215 0x1 0x21388 0x15000000 0x1000214 0x2150000 0x10002 0x15ab1500 0x100 0x2160215 0x1 0x217e0 0x15000000 0x1000218 0x3150000 0x10002 0x19001500 0x100 0x21a0315 0x1 0x21b2c 0x15000000 0x100021c 0x3150000 0x10002 0x1d481500 0x100 0x21e0315 0x1 0x21f6e 0x15010000 0x1000220 0x3150000 0x10002 0x217b1500 0x100 0x2220315 0x1 0x22389 0x15000000 0x1000224 0x3150000 0x10002 0x259b1500 0x100 0x2260315 0x1 0x227ad 0x15000000 0x1000228 0x3150000 0x10002 0x29bd1500 0x100 0x22a0315 0x1 0x22bc8 0x15000000 0x100022d 0x3150000 0x10002 0x2fce1500 0x100 0x2300315 0x1 0x231cf 0x15000000 0x1000232 0x2150000 0x10002 0x33171500 0x100 0x2340215 0x1 0x23518 0x15000000 0x1000236 0x2150000 0x10002 0x371a1500 0x100 0x2380215 0x1 0x2391c 0x15000000 0x100023a 0x2150000 0x10002 0x3b1d1500 0x100 0x23d0215 0x1 0x23f1f 0x15000000 0x1000240 0x2150000 0x10002 0x41211500 0x100 0x2420215 0x1 0x24323 0x15000000 0x1000244 0x2150000 0x10002 0x45241500 0x100 0x2460215 0x1 0x2472b 0x15000000 0x1000248 0x2150000 0x10002 0x49321500 0x100 0x24a0215 0x1 0x24b40 0x15000000 0x100024c 0x2150100 0x10002 0x4d4d1500 0x100 0x24e0215 0x1 0x24f69 0x15000000 0x1000250 0x2150000 0x10002 0x51871500 0x100 0x2520215 0x1 0x25388 0x15000000 0x1000254 0x2150000 0x10002 0x55ab1500 0x100 0x2560215 0x1 0x258e0 0x15000000 0x1000259 0x3150000 0x10002 0x5a001500 0x100 0x25b0315 0x1 0x25c2c 0x15000000 0x100025d 0x3150000 0x10002 0x5e481500 0x100 0x25f0315 0x1 0x2606e 0x15000000 0x1000261 0x3150000 0x10002 0x627b1500 0x100 0x2630315 0x1 0x26489 0x15000000 0x1000265 0x3150000 0x10002 0x669b1500 0x100 0x2670315 0x1 0x268ad 0x15000000 0x1000269 0x3150000 0x10002 0x6abd1500 0x100 0x26b0315 0x1 0x26cc8 0x15000000 0x100026d 0x3150000 0x10002 0x6ece1500 0x100 0x26f0315 0x1 0x270cf 0x15000000 0x1000271 0x2150000 0x10002 0x72171500 0x100 0x2730215 0x1 0x27418 0x15000000 0x1000275 0x2150100 0x10002 0x761a1500 0x100 0x2770215 0x1 0x2781b 0x15000000 0x1000279 0x2150000 0x10002 0x7a1d1500 0x100 0x27b0215 0x1 0x27c1f 0x15000000 0x100027d 0x2150000 0x10002 0x7e211500 0x100 0x27f0215 0x1 0x28022 0x15000000 0x1000281 0x2150000 0x10002 0x82241500 0x100 0x2830215 0x1 0x2842b 0x15000000 0x1000285 0x2150000 0x10002 0x86321500 0x100 0x2870215 0x1 0x2883f 0x15000000 0x1000289 0x2150000 0x10002 0x8a4d1500 0x100 0x28b0215 0x1 0x28c68 0x15000000 0x100028d 0x2150000 0x10002 0x8e851500 0x100 0x28f0215 0x1 0x29086 0x15000000 0x1000291 0x2150000 0x10002 0x92a91500 0x100 0x2930215 0x1 0x294da 0x15000000 0x1000295 0x2150000 0x10002 0x96fb1500 0x100 0x2970315 0x1 0x29827 0x15000000 0x1000299 0x3150000 0x10002 0x9a421500 0x100 0x29b0315 0x1 0x29c65 0x15000000 0x100029d 0x3150100 0x10002 0x9e701500 0x100 0x29f0315 0x1 0x2a07e 0x15000000 0x10002a2 0x3150000 0x10002 0xa38e1500 0x100 0x2a40315 0x1 0x2a5a2 0x15000000 0x10002a6 0x3150000 0x10002 0xa7b61500 0x100 0x2a90315 0x10 0x2aac6 0x15000000 0x10002ab 0x3150000 0x10002 0xacce1500 0x100 0x2ad0315 0x1 0x2aecf 0x15000000 0x10002af 0x2150000 0x10002 0xb0171500 0x100 0x2b10215 0x1 0x2b218 0x15000000 0x10002b3 0x2150000 0x10002 0xb41a1500 0x100 0x2b50215 0x1 0x2b61b 0x15000000 0x10002b7 0x2150000 0x10002 0xb81d1500 0x100 0x2b90215 0x1 0x2ba1f 0x15000000 0x10002bb 0x2150000 0x10002 0xbc211500 0x100 0x2bd0215 0x1 0x2be22 0x15000000 0x10002bf 0x2150000 0x10002 0xc0241500 0x100 0x2c10215 0x1 0x2c22b 0x15000000 0x10002c3 0x2150000 0x10002 0xc4321500 0x100 0x2c50215 0x1 0x2c63f 0x15000000 0x10002c7 0x2150100 0x10002 0xc84d1500 0x100 0x2c90215 0x1 0x2ca68 0x15000000 0x10002cb 0x2150000 0x10002 0xcc851500 0x100 0x2cd0215 0x1 0x2ce86 0x15000000 0x10002cf 0x2150000 0x10002 0xd0a91500 0x100 0x2d10215 0x1 0x2d2da 0x15000000 0x10002d3 0x2150000 0x10002 0xd4fb1500 0x100 0x2d50315 0x1 0x2d627 0x15000000 0x10002d7 0x3150000 0x10002 0xd8421500 0x100 0x2d90315 0x1 0x2da65 0x15000000 0x10002db 0x3150000 0x10002 0xdc701500 0x100 0x2dd0315 0x1 0x2de7e 0x15000000 0x10002df 0x3150000 0x10002 0xe08e1500 0x100 0x2e10315 0x1 0x2e2a2 0x15000000 0x10002e3 0x3150000 0x10002 0xe4b61500 0x100 0x2e50315 0x1 0x2e6c6 0x15000000 0x10002e7 0x3150000 0x10002 0xe8ce1500 0x100 0x2e90315 0x1000001 0x2eacf>;
		qcom,mdss-dsi-dispparam-nightmode3-command-state = "dsi_hs_mode";
		qcom,mdss-dsi-dispparam-nightmode4-command = <0x15000000 0x10002ff 0x1150000 0x10002 0xfb011500 0x100 0x2750215 0x1 0x27651 0x15000000 0x1000277 0x2150000 0x10002 0x78521500 0x100 0x2790215 0x1 0x27a53 0x15000000 0x100027b 0x2150000 0x10002 0x7c541500 0x100 0x27d0215 0x1 0x27e55 0x15000000 0x100027f 0x2150000 0x10002 0x80571500 0x100 0x2810215 0x1 0x28258 0x15000000 0x1000283 0x2150000 0x10002 0x84591500 0x100 0x2850215 0x1 0x2865a 0x15000000 0x1000287 0x2150000 0x10002 0x885f1500 0x100 0x2890215 0x1 0x28a64 0x15000000 0x100028b 0x2150000 0x10002 0x8c6e1500 0x100 0x28d0215 0x1 0x28e79 0x15000000 0x100028f 0x2150000 0x10002 0x90901500 0x100 0x2910215 0x1 0x292aa 0x15000000 0x1000293 0x2150000 0x10002 0x94ab1500 0x100 0x2950215 0x1 0x296cf 0x15000000 0x1000297 0x2150000 0x10002 0x98fd1500 0x100 0x2990315 0x1000001 0x29a1c 0x15000000 0x100029b 0x3150000 0x10002 0x9c431500 0x100 0x29d0315 0x1 0x29e5d 0x15000000 0x100029f 0x3150000 0x10002 0xa0831500 0x100 0x2a20315 0x1 0x2a391 0x15000000 0x10002a4 0x3150000 0x10002 0xa5a01500 0x100 0x2a60315 0x1 0x2a7ae 0x15000000 0x10002a9 0x3150000 0x10002 0xaabb1500 0x100 0x2ab0315 0x1 0x2acc4 0x15000000 0x10002ad 0x3150000 0x10002 0xaecb1500 0x100 0x2af0315 0x1 0x2b0cf 0x15000000 0x10002b1 0x3150000 0x10002 0xb2d01500 0x100 0x2b30215 0x1 0x2b451 0x15000000 0x10002b5 0x2150000 0x10002 0xb6521500 0x100 0x2b70215 0x1 0x2b853 0x15000000 0x10002b9 0x2150000 0x10002 0xba541500 0x100 0x2bb0215 0x1 0x2bc55 0x15000000 0x10002bd 0x2150000 0x10002 0xbe571500 0x100 0x2bf0215 0x1 0x2c058 0x15000000 0x10002c1 0x2150000 0x10002 0xc2591500 0x100 0x2c30215 0x1000001 0x2c45a 0x15000000 0x10002c5 0x2150000 0x10002 0xc65f1500 0x100 0x2c70215 0x1 0x2c864 0x15000000 0x10002c9 0x2150000 0x10002 0xca6e1500 0x100 0x2cb0215 0x1 0x2cc79 0x15000000 0x10002cd 0x2150000 0x10002 0xce901500 0x100 0x2cf0215 0x1 0x2d0aa 0x15000000 0x10002d1 0x2150000 0x10002 0xd2ab1500 0x100 0x2d30215 0x1 0x2d4cf 0x15000000 0x10002d5 0x2150000 0x10002 0xd6fd1500 0x100 0x2d70315 0x1 0x2d81c 0x15000000 0x10002d9 0x3150000 0x10002 0xda431500 0x100 0x2db0315 0x1 0x2dc5d 0x15000000 0x10002dd 0x3150000 0x10002 0xde831500 0x100 0x2df0315 0x1 0x2e091 0x15000000 0x10002e1 0x3150000 0x10002 0xe2a01500 0x100 0x2e30315 0x1 0x2e4ae 0x15000000 0x10002e5 0x3150000 0x10002 0xe6bb1500 0x100 0x2e70315 0x1 0x2e8c4 0x15000000 0x10002e9 0x3150000 0x10002 0xeacb1500 0x100 0x2eb0315 0x1000001 0x2eccf 0x15000000 0x10002ed 0x3150000 0x10002 0xeed01500 0x100 0x2ef0215 0x1 0x2f056 0x15000000 0x10002f1 0x2150000 0x10002 0xf2571500 0x100 0x2f30215 0x1 0x2f458 0x15000000 0x10002f5 0x2150000 0x10002 0xf6591500 0x100 0x2f70215 0x1 0x2f85a 0x15000000 0x10002f9 0x2150000 0x10002 0xfa5c1500 0x1000 0x2ff0215 0x1 0x2fb01 0x15000000 0x1000200 0x2150000 0x10002 0x15d1500 0x100 0x2020215 0x1 0x2035e 0x15000000 0x1000204 0x2150000 0x10002 0x55f1500 0x100 0x2060215 0x1 0x20764 0x15000000 0x1000208 0x2150000 0x10002 0x9691500 0x100 0x20a0215 0x1 0x20b73 0x15000000 0x100020c 0x2150100 0x10002 0xd7e1500 0x100 0x20e0215 0x1 0x20f95 0x15000000 0x1000210 0x2150000 0x10002 0x11b01500 0x100 0x2120215 0x1 0x213b1 0x15000000 0x1000214 0x2150000 0x10002 0x15d71500 0x100 0x2160315 0x1 0x21706 0x15000000 0x1000218 0x3150000 0x10002 0x19251500 0x100 0x21a0315 0x1 0x21b4c 0x15000000 0x100021c 0x3150000 0x10002 0x1d661500 0x100 0x21e0315 0x1 0x21f8c 0x15000000 0x1000220 0x3150000 0x10002 0x21981500 0x100 0x2220315 0x1 0x223a5 0x15000000 0x1000224 0x3150000 0x10002 0x25b21500 0x100 0x2260315 0x1 0x227bd 0x15000000 0x1000228 0x3150000 0x10002 0x29c51500 0x100 0x22a0315 0x1 0x22bcc 0x15000000 0x100022d 0x3150000 0x10002 0x2fcf1500 0x100 0x2300315 0x1 0x231d0 0x15000000 0x1000232 0x2150000 0x10002 0x33561500 0x100 0x2340215 0x1 0x23557 0x15000000 0x1000236 0x2150100 0x10002 0x37581500 0x100 0x2380215 0x1 0x23959 0x15000000 0x100023a 0x2150000 0x10002 0x3b5a1500 0x100 0x23d0215 0x1 0x23f5c 0x15000000 0x1000240 0x2150000 0x10002 0x415d1500 0x100 0x2420215 0x1 0x2435e 0x15000000 0x1000244 0x2150000 0x10002 0x455f1500 0x100 0x2460215 0x1 0x24764 0x15000000 0x1000248 0x2150000 0x10002 0x49691500 0x100 0x24a0215 0x1 0x24b73 0x15000000 0x100024c 0x2150000 0x10002 0x4d7e1500 0x100 0x24e0215 0x1 0x24f95 0x15000000 0x1000250 0x2150000 0x10002 0x51b01500 0x100 0x2520215 0x1 0x253b1 0x15000000 0x1000254 0x2150000 0x10002 0x55d71500 0x100 0x2560315 0x1 0x25806 0x15000000 0x1000259 0x3150000 0x10002 0x5a251500 0x100 0x25b0315 0x1 0x25c4c 0x15000000 0x100025d 0x3150000 0x10002 0x5e661500 0x100 0x25f0315 0x1 0x2608c 0x15000000 0x1000261 0x3150100 0x10002 0x62981500 0x100 0x2630315 0x1 0x264a5 0x15000000 0x1000265 0x3150000 0x10002 0x66b21500 0x100 0x2670315 0x1 0x268bd 0x15000000 0x1000269 0x3150000 0x10002 0x6ac51500 0x100 0x26b0315 0x1 0x26ccc 0x15000000 0x100026d 0x3150000 0x10002 0x6ecf1500 0x100 0x26f0315 0x1 0x270d0 0x15000000 0x1000271 0x2150000 0x10002 0x72551500 0x100 0x2730215 0x1 0x27456 0x15000000 0x1000275 0x2150000 0x10002 0x76571500 0x100 0x2770215 0x1 0x27858 0x15000000 0x1000279 0x2150000 0x10002 0x7a591500 0x100 0x27b0215 0x1 0x27c5a 0x15000000 0x100027d 0x2150000 0x10002 0x7e5c1500 0x100 0x27f0215 0x1 0x2805d 0x15000000 0x1000281 0x2150000 0x10002 0x825e1500 0x100 0x2830215 0x1 0x28463 0x15000000 0x1000285 0x2150000 0x10002 0x86681500 0x100 0x2870215 0x1 0x28872 0x15010000 0x1000289 0x2150000 0x10002 0x8a7c1500 0x100 0x28b0215 0x1 0x28c93 0x15000000 0x100028d 0x2150000 0x10002 0x8ead1500 0x100 0x28f0215 0x1 0x290ae 0x15000000 0x1000291 0x2150000 0x10002 0x92d11500 0x100 0x2930315 0x1 0x29400 0x15000000 0x1000295 0x3150000 0x10002 0x961f1500 0x100 0x2970315 0x1 0x29845 0x15000000 0x1000299 0x3150000 0x10002 0x9a5e1500 0x100 0x29b0315 0x1 0x29c80 0x15000000 0x100029d 0x3150000 0x10002 0x9e8b1500 0x100 0x29f0315 0x1 0x2a099 0x15000000 0x10002a2 0x3150000 0x10002 0xa3a81500 0x100 0x2a40315 0x1 0x2a5b6 0x15000000 0x10002a6 0x3150000 0x10002 0xa7c21500 0x100 0x2a90315 0x10 0x2aaca 0x15000000 0x10002ab 0x3150000 0x10002 0xaccf1500 0x100 0x2ad0315 0x1 0x2aed0 0x15000000 0x10002af 0x2150000 0x10002 0xb0551500 0x100 0x2b10215 0x1 0x2b256 0x15000000 0x10002b3 0x2150100 0x10002 0xb4571500 0x100 0x2b50215 0x1 0x2b658 0x15000000 0x10002b7 0x2150000 0x10002 0xb8591500 0x100 0x2b90215 0x1 0x2ba5a 0x15000000 0x10002bb 0x2150000 0x10002 0xbc5c1500 0x100 0x2bd0215 0x1 0x2be5d 0x15000000 0x10002bf 0x2150000 0x10002 0xc05e1500 0x100 0x2c10215 0x1 0x2c263 0x15000000 0x10002c3 0x2150000 0x10002 0xc4681500 0x100 0x2c50215 0x1 0x2c672 0x15000000 0x10002c7 0x2150000 0x10002 0xc87c1500 0x100 0x2c90215 0x1 0x2ca93 0x15000000 0x10002cb 0x2150000 0x10002 0xccad1500 0x100 0x2cd0215 0x1 0x2ceae 0x15000000 0x10002cf 0x2150000 0x10002 0xd0d11500 0x100 0x2d10315 0x1 0x2d200 0x15000000 0x10002d3 0x3150000 0x10002 0xd41f1500 0x100 0x2d50315 0x1 0x2d645 0x15000000 0x10002d7 0x3150000 0x10002 0xd85e1500 0x100 0x2d90315 0x1 0x2da80 0x15000000 0x10002db 0x3150100 0x10002 0xdc8b1500 0x100 0x2dd0315 0x1 0x2de99 0x15000000 0x10002df 0x3150000 0x10002 0xe0a81500 0x100 0x2e10315 0x1 0x2e2b6 0x15000000 0x10002e3 0x3150000 0x10002 0xe4c21500 0x100 0x2e50315 0x1 0x2e6ca 0x15000000 0x10002e7 0x3150000 0x10002 0xe8cf1500 0x100 0x2e90315 0x1000001 0x2ead0>;
		qcom,mdss-dsi-dispparam-nightmode4-command-state = "dsi_hs_mode";
		qcom,mdss-dsi-dispparam-nightmode5-command = <0x15000000 0x10002ff 0x1150000 0x10002 0xfb011500 0x100 0x2750215 0x1 0x2768f 0x15000000 0x1000277 0x2150000 0x10002 0x78901500 0x100 0x2790215 0x1 0x27a91 0x15000000 0x100027b 0x2150000 0x10002 0x7c921500 0x100 0x27d0215 0x1 0x27e93 0x15000000 0x100027f 0x2150000 0x10002 0x80941500 0x100 0x2810215 0x1 0x28295 0x15000000 0x1000283 0x2150000 0x10002 0x84961500 0x100 0x2850215 0x1 0x28697 0x15000000 0x1000287 0x2150000 0x10002 0x889a1500 0x100 0x2890215 0x1 0x28a9e 0x15000000 0x100028b 0x2150000 0x10002 0x8ca71500 0x100 0x28d0215 0x1 0x28eb1 0x15000000 0x100028f 0x2150000 0x10002 0x90c71500 0x100 0x2910215 0x1 0x292e2 0x15000000 0x1000293 0x2150000 0x10002 0x94e31500 0x100 0x2950315 0x1 0x29603 0x15000000 0x1000297 0x3150000 0x10002 0x982c1500 0x100 0x2990315 0x1000001 0x29a47 0x15000000 0x100029b 0x3150000 0x10002 0x9c6b1500 0x100 0x29d0315 0x1 0x29e86 0x15000000 0x100029f 0x3150000 0x10002 0xa0ab1500 0x100 0x2a20315 0x1 0x2a3b4 0x15000000 0x10002a4 0x3150000 0x10002 0xa5bb1500 0x100 0x2a60315 0x1 0x2a7c2 0x15000000 0x10002a9 0x3150000 0x10002 0xaac71500 0x100 0x2ab0315 0x1 0x2accb 0x15000000 0x10002ad 0x3150000 0x10002 0xaece1500 0x100 0x2af0315 0x1 0x2b0cf 0x15000000 0x10002b1 0x3150000 0x10002 0xb2d01500 0x100 0x2b30215 0x1 0x2b48f 0x15000000 0x10002b5 0x2150000 0x10002 0xb6901500 0x100 0x2b70215 0x1 0x2b891 0x15000000 0x10002b9 0x2150000 0x10002 0xba921500 0x100 0x2bb0215 0x1 0x2bc93 0x15000000 0x10002bd 0x2150000 0x10002 0xbe941500 0x100 0x2bf0215 0x1 0x2c095 0x15000000 0x10002c1 0x2150000 0x10002 0xc2961500 0x100 0x2c30215 0x1000001 0x2c497 0x15000000 0x10002c5 0x2150000 0x10002 0xc69a1500 0x100 0x2c70215 0x1 0x2c89e 0x15000000 0x10002c9 0x2150000 0x10002 0xcaa71500 0x100 0x2cb0215 0x1 0x2ccb1 0x15000000 0x10002cd 0x2150000 0x10002 0xcec71500 0x100 0x2cf0215 0x1 0x2d0e2 0x15000000 0x10002d1 0x2150000 0x10002 0xd2e31500 0x100 0x2d30315 0x1 0x2d403 0x15000000 0x10002d5 0x3150000 0x10002 0xd62c1500 0x100 0x2d70315 0x1 0x2d847 0x15000000 0x10002d9 0x3150000 0x10002 0xda6b1500 0x100 0x2db0315 0x1 0x2dc86 0x15000000 0x10002dd 0x3150000 0x10002 0xdeab1500 0x100 0x2df0315 0x1 0x2e0b4 0x15000000 0x10002e1 0x3150000 0x10002 0xe2bb1500 0x100 0x2e30315 0x1 0x2e4c2 0x15000000 0x10002e5 0x3150000 0x10002 0xe6c71500 0x100 0x2e70315 0x1 0x2e8cb 0x15000000 0x10002e9 0x3150000 0x10002 0xeace1500 0x100 0x2eb0315 0x1000001 0x2eccf 0x15000000 0x10002ed 0x3150000 0x10002 0xeed01500 0x100 0x2ef0215 0x1 0x2f094 0x15000000 0x10002f1 0x2150000 0x10002 0xf2951500 0x100 0x2f30215 0x1 0x2f496 0x15000000 0x10002f5 0x2150000 0x10002 0xf6971500 0x100 0x2f70215 0x1 0x2f898 0x15000000 0x10002f9 0x2150000 0x10002 0xfa991500 0x1000 0x2ff0215 0x1 0x2fb01 0x15000000 0x1000200 0x2150000 0x10002 0x19a1500 0x100 0x2020215 0x1 0x2039b 0x15000000 0x1000204 0x2150000 0x10002 0x59c1500 0x100 0x2060215 0x1 0x2079f 0x15000000 0x1000208 0x2150000 0x10002 0x9a41500 0x100 0x20a0215 0x1 0x20bad 0x15000000 0x100020c 0x2150100 0x10002 0xdb71500 0x100 0x20e0215 0x1 0x20fcf 0x15000000 0x1000210 0x2150000 0x10002 0x11e91500 0x100 0x2120215 0x1 0x213ea 0x15000000 0x1000214 0x3150000 0x10002 0x150b1500 0x100 0x2160315 0x1 0x21735 0x15000000 0x1000218 0x3150000 0x10002 0x19501500 0x100 0x21a0315 0x1 0x21b74 0x15000000 0x100021c 0x3150000 0x10002 0x1d8f1500 0x100 0x21e0315 0x1 0x21faf 0x15000000 0x1000220 0x3150000 0x10002 0x21b61500 0x100 0x2220315 0x1 0x223bd 0x15000000 0x1000224 0x3150000 0x10002 0x25c31500 0x100 0x2260315 0x1 0x227c7 0x15000000 0x1000228 0x3150000 0x10002 0x29cb1500 0x100 0x22a0315 0x1 0x22bce 0x15000000 0x100022d 0x3150000 0x10002 0x2fcf1500 0x100 0x2300315 0x1 0x231d0 0x15000000 0x1000232 0x2150000 0x10002 0x33941500 0x100 0x2340215 0x1 0x23595 0x15000000 0x1000236 0x2150100 0x10002 0x37961500 0x100 0x2380215 0x1 0x23997 0x15000000 0x100023a 0x2150000 0x10002 0x3b981500 0x100 0x23d0215 0x1 0x23f99 0x15000000 0x1000240 0x2150000 0x10002 0x419a1500 0x100 0x2420215 0x1 0x2439b 0x15000000 0x1000244 0x2150000 0x10002 0x459c1500 0x100 0x2460215 0x1 0x2479f 0x15000000 0x1000248 0x2150000 0x10002 0x49a41500 0x100 0x24a0215 0x1 0x24bad 0x15000000 0x100024c 0x2150000 0x10002 0x4db71500 0x100 0x24e0215 0x1 0x24fcf 0x15000000 0x1000250 0x2150000 0x10002 0x51e91500 0x100 0x2520215 0x1 0x253ea 0x15000000 0x1000254 0x3150000 0x10002 0x550b1500 0x100 0x2560315 0x1 0x25835 0x15000000 0x1000259 0x3150000 0x10002 0x5a501500 0x100 0x25b0315 0x1 0x25c74 0x15000000 0x100025d 0x3150000 0x10002 0x5e8f1500 0x100 0x25f0315 0x1 0x260af 0x15000000 0x1000261 0x3150100 0x10002 0x62b61500 0x100 0x2630315 0x1 0x264bd 0x15000000 0x1000265 0x3150000 0x10002 0x66c31500 0x100 0x2670315 0x1 0x268c7 0x15000000 0x1000269 0x3150000 0x10002 0x6acb1500 0x100 0x26b0315 0x1 0x26cce 0x15000000 0x100026d 0x3150000 0x10002 0x6ecf1500 0x100 0x26f0315 0x1 0x270d0 0x15000000 0x1000271 0x2150000 0x10002 0x72931500 0x100 0x2730215 0x1 0x27494 0x15000000 0x1000275 0x2150000 0x10002 0x76951500 0x100 0x2770215 0x1 0x27896 0x15000000 0x1000279 0x2150000 0x10002 0x7a971500 0x100 0x27b0215 0x1 0x27c98 0x15000000 0x100027d 0x2150000 0x10002 0x7e991500 0x100 0x27f0215 0x1 0x2809a 0x15000000 0x1000281 0x2150000 0x10002 0x829b1500 0x100 0x2830215 0x1 0x2849e 0x15000000 0x1000285 0x2150000 0x10002 0x86a21500 0x100 0x2870215 0x1 0x288ab 0x15010000 0x1000289 0x2150000 0x10002 0x8ab41500 0x100 0x28b0215 0x1 0x28cca 0x15000000 0x100028d 0x2150000 0x10002 0x8ee51500 0x100 0x28f0215 0x1 0x290e6 0x15000000 0x1000291 0x3150000 0x10002 0x92061500 0x100 0x2930315 0x1 0x29430 0x15000000 0x1000295 0x3150000 0x10002 0x96491500 0x100 0x2970315 0x1 0x2986b 0x15000000 0x1000299 0x3150000 0x10002 0x9a831500 0x100 0x29b0315 0x1 0x29ca5 0x15000000 0x100029d 0x3150000 0x10002 0x9eae1500 0x100 0x29f0315 0x1 0x2a0b7 0x15000000 0x10002a2 0x3150000 0x10002 0xa3bf1500 0x100 0x2a40315 0x1 0x2a5c5 0x15000000 0x10002a6 0x3150000 0x10002 0xa7ca1500 0x100 0x2a90315 0x10 0x2aacd 0x15000000 0x10002ab 0x3150000 0x10002 0xaccf1500 0x100 0x2ad0315 0x1 0x2aed0 0x15000000 0x10002af 0x2150000 0x10002 0xb0931500 0x100 0x2b10215 0x1 0x2b294 0x15000000 0x10002b3 0x2150100 0x10002 0xb4951500 0x100 0x2b50215 0x1 0x2b696 0x15000000 0x10002b7 0x2150000 0x10002 0xb8971500 0x100 0x2b90215 0x1 0x2ba98 0x15000000 0x10002bb 0x2150000 0x10002 0xbc991500 0x100 0x2bd0215 0x1 0x2be9a 0x15000000 0x10002bf 0x2150000 0x10002 0xc09b1500 0x100 0x2c10215 0x1 0x2c29e 0x15000000 0x10002c3 0x2150000 0x10002 0xc4a21500 0x100 0x2c50215 0x1 0x2c6ab 0x15000000 0x10002c7 0x2150000 0x10002 0xc8b41500 0x100 0x2c90215 0x1 0x2caca 0x15000000 0x10002cb 0x2150000 0x10002 0xcce51500 0x100 0x2cd0215 0x1 0x2cee6 0x15000000 0x10002cf 0x3150000 0x10002 0xd0061500 0x100 0x2d10315 0x1 0x2d230 0x15000000 0x10002d3 0x3150000 0x10002 0xd4491500 0x100 0x2d50315 0x1 0x2d66b 0x15000000 0x10002d7 0x3150000 0x10002 0xd8831500 0x100 0x2d90315 0x1 0x2daa5 0x15000000 0x10002db 0x3150100 0x10002 0xdcae1500 0x100 0x2dd0315 0x1 0x2deb7 0x15000000 0x10002df 0x3150000 0x10002 0xe0bf1500 0x100 0x2e10315 0x1 0x2e2c5 0x15000000 0x10002e3 0x3150000 0x10002 0xe4ca1500 0x100 0x2e50315 0x1 0x2e6cd 0x15000000 0x10002e7 0x3150000 0x10002 0xe8cf1500 0x100 0x2e90315 0x1000001 0x2ead0>;
		qcom,mdss-dsi-dispparam-nightmode5-command-state = "dsi_hs_mode";
		qcom,mdss-dsi-dispparam-papermode-command = [15 00 00 00 01 00 02 ff 20 15 00 00 00 01 00 02 fb 01 15 00 00 00 01 00 02 75 01 15 00 00 00 01 00 02 76 60 15 00 00 00 01 00 02 77 01 15 00 00 00 01 00 02 78 63 15 00 00 00 01 00 02 79 01 15 00 00 00 01 00 02 7a 68 15 00 00 00 01 00 02 7b 01 15 00 00 00 01 00 02 7c 6e 15 00 00 00 01 00 02 7d 01 15 00 00 00 01 00 02 7e 73 15 00 00 00 01 00 02 7f 01 15 00 00 00 01 00 02 80 78 15 00 00 00 01 00 02 81 01 15 00 00 00 01 00 02 82 7d 15 00 00 00 01 00 02 83 01 15 00 00 00 01 00 02 84 82 15 00 00 00 01 00 02 85 01 15 00 00 00 01 00 02 86 87 15 00 00 00 01 00 02 87 01 15 00 00 00 01 00 02 88 99 15 00 00 00 01 00 02 89 01 15 00 00 00 01 00 02 8a aa 15 00 00 00 01 00 02 8b 01 15 00 00 00 01 00 02 8c c9 15 00 00 00 01 00 02 8d 01 15 00 00 00 01 00 02 8e e5 15 00 00 00 01 00 02 8f 02 15 00 00 00 01 00 02 90 0c 15 00 00 00 01 00 02 91 02 15 00 00 00 01 00 02 92 31 15 00 00 00 01 00 02 93 02 15 00 00 00 01 00 02 94 33 15 00 00 00 01 00 02 95 02 15 00 00 00 01 00 02 96 60 15 00 00 00 01 00 02 97 02 15 00 00 00 01 00 02 98 9b 15 01 00 00 01 00 02 99 02 15 00 00 00 01 00 02 9a c4 15 00 00 00 01 00 02 9b 02 15 00 00 00 01 00 02 9c fa 15 00 00 00 01 00 02 9d 03 15 00 00 00 01 00 02 9e 17 15 00 00 00 01 00 02 9f 03 15 00 00 00 01 00 02 a0 4e 15 00 00 00 01 00 02 a2 03 15 00 00 00 01 00 02 a3 60 15 00 00 00 01 00 02 a4 03 15 00 00 00 01 00 02 a5 73 15 00 00 00 01 00 02 a6 03 15 00 00 00 01 00 02 a7 86 15 00 00 00 01 00 02 a9 03 15 00 00 00 01 00 02 aa 98 15 00 00 00 01 00 02 ab 03 15 00 00 00 01 00 02 ac a7 15 00 00 00 01 00 02 ad 03 15 00 00 00 01 00 02 ae b1 15 00 00 00 01 00 02 af 03 15 00 00 00 01 00 02 b0 b6 15 00 00 00 01 00 02 b1 03 15 00 00 00 01 00 02 b2 ff 15 00 00 00 01 00 02 b3 01 15 00 00 00 01 00 02 b4 60 15 00 00 00 01 00 02 b5 01 15 00 00 00 01 00 02 b6 63 15 00 00 00 01 00 02 b7 01 15 00 00 00 01 00 02 b8 68 15 00 00 00 01 00 02 b9 01 15 00 00 00 01 00 02 ba 6e 15 00 00 00 01 00 02 bb 01 15 00 00 00 01 00 02 bc 73 15 00 00 00 01 00 02 bd 01 15 00 00 00 01 00 02 be 78 15 00 00 00 01 00 02 bf 01 15 00 00 00 01 00 02 c0 7d 15 00 00 00 01 00 02 c1 01 15 00 00 00 01 00 02 c2 82 15 00 00 00 01 00 02 c3 01 15 01 00 00 01 00 02 c4 87 15 00 00 00 01 00 02 c5 01 15 00 00 00 01 00 02 c6 99 15 00 00 00 01 00 02 c7 01 15 00 00 00 01 00 02 c8 aa 15 00 00 00 01 00 02 c9 01 15 00 00 00 01 00 02 ca c9 15 00 00 00 01 00 02 cb 01 15 00 00 00 01 00 02 cc e5 15 00 00 00 01 00 02 cd 02 15 00 00 00 01 00 02 ce 0c 15 00 00 00 01 00 02 cf 02 15 00 00 00 01 00 02 d0 31 15 00 00 00 01 00 02 d1 02 15 00 00 00 01 00 02 d2 33 15 00 00 00 01 00 02 d3 02 15 00 00 00 01 00 02 d4 60 15 00 00 00 01 00 02 d5 02 15 00 00 00 01 00 02 d6 9b 15 00 00 00 01 00 02 d7 02 15 00 00 00 01 00 02 d8 c4 15 00 00 00 01 00 02 d9 02 15 00 00 00 01 00 02 da fa 15 00 00 00 01 00 02 db 03 15 00 00 00 01 00 02 dc 17 15 00 00 00 01 00 02 dd 03 15 00 00 00 01 00 02 de 4e 15 00 00 00 01 00 02 df 03 15 00 00 00 01 00 02 e0 60 15 00 00 00 01 00 02 e1 03 15 00 00 00 01 00 02 e2 73 15 00 00 00 01 00 02 e3 03 15 00 00 00 01 00 02 e4 86 15 00 00 00 01 00 02 e5 03 15 00 00 00 01 00 02 e6 98 15 00 00 00 01 00 02 e7 03 15 00 00 00 01 00 02 e8 a7 15 00 00 00 01 00 02 e9 03 15 00 00 00 01 00 02 ea b1 15 01 00 00 01 00 02 eb 03 15 00 00 00 01 00 02 ec b6 15 00 00 00 01 00 02 ed 03 15 00 00 00 01 00 02 ee ff 15 00 00 00 01 00 02 ef 01 15 00 00 00 01 00 02 f0 6a 15 00 00 00 01 00 02 f1 01 15 00 00 00 01 00 02 f2 6d 15 00 00 00 01 00 02 f3 01 15 00 00 00 01 00 02 f4 72 15 00 00 00 01 00 02 f5 01 15 00 00 00 01 00 02 f6 77 15 00 00 00 01 00 02 f7 01 15 00 00 00 01 00 02 f8 7c 15 00 00 00 01 00 02 f9 01 15 00 00 00 01 00 02 fa 81 15 00 00 00 01 00 02 ff 21 15 00 00 00 01 00 02 fb 01 15 00 00 00 01 00 02 00 01 15 00 00 00 01 00 02 01 86 15 00 00 00 01 00 02 02 01 15 00 00 00 01 00 02 03 8a 15 00 00 00 01 00 02 04 01 15 00 00 00 01 00 02 05 8f 15 00 00 00 01 00 02 06 01 15 00 00 00 01 00 02 07 a0 15 00 00 00 01 00 02 08 01 15 00 00 00 01 00 02 09 b0 15 00 00 00 01 00 02 0a 01 15 00 00 00 01 00 02 0b ce 15 00 00 00 01 00 02 0c 01 15 00 00 00 01 00 02 0d ea 15 00 00 00 01 00 02 0e 02 15 00 00 00 01 00 02 0f 0f 15 00 00 00 01 00 02 10 02 15 00 00 00 01 00 02 11 34 15 00 00 00 01 00 02 12 02 15 00 00 00 01 00 02 13 35 15 00 00 00 01 00 02 14 02 15 00 00 00 01 00 02 15 62 15 01 00 00 01 00 02 16 02 15 00 00 00 01 00 02 17 9e 15 00 00 00 01 00 02 18 02 15 00 00 00 01 00 02 19 c6 15 00 00 00 01 00 02 1a 02 15 00 00 00 01 00 02 1b fa 15 00 00 00 01 00 02 1c 03 15 00 00 00 01 00 02 1d 16 15 00 00 00 01 00 02 1e 03 15 00 00 00 01 00 02 1f 48 15 00 00 00 01 00 02 20 03 15 00 00 00 01 00 02 21 57 15 00 00 00 01 00 02 22 03 15 00 00 00 01 00 02 23 68 15 00 00 00 01 00 02 24 03 15 00 00 00 01 00 02 25 7b 15 00 00 00 01 00 02 26 03 15 00 00 00 01 00 02 27 91 15 00 00 00 01 00 02 28 03 15 00 00 00 01 00 02 29 a9 15 00 00 00 01 00 02 2a 03 15 00 00 00 01 00 02 2b bf 15 00 00 00 01 00 02 2d 03 15 00 00 00 01 00 02 2f cc 15 00 00 00 01 00 02 30 03 15 00 00 00 01 00 02 31 ff 15 00 00 00 01 00 02 32 01 15 00 00 00 01 00 02 33 6a 15 00 00 00 01 00 02 34 01 15 00 00 00 01 00 02 35 6d 15 00 00 00 01 00 02 36 01 15 00 00 00 01 00 02 37 72 15 00 00 00 01 00 02 38 01 15 00 00 00 01 00 02 39 77 15 00 00 00 01 00 02 3a 01 15 00 00 00 01 00 02 3b 7c 15 00 00 00 01 00 02 3d 01 15 00 00 00 01 00 02 3f 81 15 00 00 00 01 00 02 40 01 15 00 00 00 01 00 02 41 86 15 01 00 00 01 00 02 42 01 15 00 00 00 01 00 02 43 8a 15 00 00 00 01 00 02 44 01 15 00 00 00 01 00 02 45 8f 15 00 00 00 01 00 02 46 01 15 00 00 00 01 00 02 47 a0 15 00 00 00 01 00 02 48 01 15 00 00 00 01 00 02 49 b0 15 00 00 00 01 00 02 4a 01 15 00 00 00 01 00 02 4b ce 15 00 00 00 01 00 02 4c 01 15 00 00 00 01 00 02 4d ea 15 00 00 00 01 00 02 4e 02 15 00 00 00 01 00 02 4f 0f 15 00 00 00 01 00 02 50 02 15 00 00 00 01 00 02 51 34 15 00 00 00 01 00 02 52 02 15 00 00 00 01 00 02 53 35 15 00 00 00 01 00 02 54 02 15 00 00 00 01 00 02 55 62 15 00 00 00 01 00 02 56 02 15 00 00 00 01 00 02 58 9e 15 00 00 00 01 00 02 59 02 15 00 00 00 01 00 02 5a c6 15 00 00 00 01 00 02 5b 02 15 00 00 00 01 00 02 5c fa 15 00 00 00 01 00 02 5d 03 15 00 00 00 01 00 02 5e 16 15 00 00 00 01 00 02 5f 03 15 00 00 00 01 00 02 60 48 15 00 00 00 01 00 02 61 03 15 00 00 00 01 00 02 62 57 15 00 00 00 01 00 02 63 03 15 00 00 00 01 00 02 64 68 15 00 00 00 01 00 02 65 03 15 00 00 00 01 00 02 66 7b 15 00 00 00 01 00 02 67 03 15 00 00 00 01 00 02 68 91 15 00 00 00 01 00 02 69 03 15 00 00 00 01 00 02 6a a9 15 01 00 00 01 00 02 6b 03 15 00 00 00 01 00 02 6c bf 15 00 00 00 01 00 02 6d 03 15 00 00 00 01 00 02 6e cc 15 00 00 00 01 00 02 6f 03 15 00 00 00 01 00 02 70 ff 15 00 00 00 01 00 02 71 02 15 00 00 00 01 00 02 72 15 15 00 00 00 01 00 02 73 02 15 00 00 00 01 00 02 74 16 15 00 00 00 01 00 02 75 02 15 00 00 00 01 00 02 76 17 15 00 00 00 01 00 02 77 02 15 00 00 00 01 00 02 78 18 15 00 00 00 01 00 02 79 02 15 00 00 00 01 00 02 7a 1a 15 00 00 00 01 00 02 7b 02 15 00 00 00 01 00 02 7c 1b 15 00 00 00 01 00 02 7d 02 15 00 00 00 01 00 02 7e 1c 15 00 00 00 01 00 02 7f 02 15 00 00 00 01 00 02 80 1e 15 00 00 00 01 00 02 81 02 15 00 00 00 01 00 02 82 1f 15 00 00 00 01 00 02 83 02 15 00 00 00 01 00 02 84 25 15 00 00 00 01 00 02 85 02 15 00 00 00 01 00 02 86 2b 15 00 00 00 01 00 02 87 02 15 00 00 00 01 00 02 88 37 15 00 00 00 01 00 02 89 02 15 00 00 00 01 00 02 8a 43 15 00 00 00 01 00 02 8b 02 15 00 00 00 01 00 02 8c 5f 15 00 00 00 01 00 02 8d 02 15 00 00 00 01 00 02 8e 7f 15 00 00 00 01 00 02 8f 02 15 00 00 00 01 00 02 90 80 15 00 00 00 01 00 02 91 02 15 00 00 00 01 00 02 92 a9 15 00 00 00 01 00 02 93 02 15 01 00 00 01 00 02 94 e0 15 00 00 00 01 00 02 95 03 15 00 00 00 01 00 02 96 03 15 00 00 00 01 00 02 97 03 15 00 00 00 01 00 02 98 35 15 00 00 00 01 00 02 99 03 15 00 00 00 01 00 02 9a 5d 15 00 00 00 01 00 02 9b 03 15 00 00 00 01 00 02 9c 89 15 00 00 00 01 00 02 9d 03 15 00 00 00 01 00 02 9e 93 15 00 00 00 01 00 02 9f 03 15 00 00 00 01 00 02 a0 9d 15 00 00 00 01 00 02 a2 03 15 00 00 00 01 00 02 a3 a5 15 00 00 00 01 00 02 a4 03 15 00 00 00 01 00 02 a5 ac 15 00 00 00 01 00 02 a6 03 15 00 00 00 01 00 02 a7 b1 15 00 00 00 01 00 02 a9 03 15 00 00 00 01 00 02 aa b5 15 00 00 00 01 00 02 ab 03 15 00 00 00 01 00 02 ac b6 15 00 00 00 01 00 02 ad 03 15 00 00 00 01 00 02 ae ff 15 00 00 00 01 00 02 af 02 15 00 00 00 01 00 02 b0 15 15 00 00 00 01 00 02 b1 02 15 00 00 00 01 00 02 b2 16 15 00 00 00 01 00 02 b3 02 15 00 00 00 01 00 02 b4 17 15 00 00 00 01 00 02 b5 02 15 00 00 00 01 00 02 b6 18 15 00 00 00 01 00 02 b7 02 15 00 00 00 01 00 02 b8 1a 15 00 00 00 01 00 02 b9 02 15 00 00 00 01 00 02 ba 1b 15 00 00 00 01 00 02 bb 02 15 00 00 00 01 00 02 bc 1c 15 00 00 00 01 00 02 bd 02 15 01 00 00 01 00 02 be 1e 15 00 00 00 01 00 02 bf 02 15 00 00 00 01 00 02 c0 1f 15 00 00 00 01 00 02 c1 02 15 00 00 00 01 00 02 c2 25 15 00 00 00 01 00 02 c3 02 15 00 00 00 01 00 02 c4 2b 15 00 00 00 01 00 02 c5 02 15 00 00 00 01 00 02 c6 37 15 00 00 00 01 00 02 c7 02 15 00 00 00 01 00 02 c8 43 15 00 00 00 01 00 02 c9 02 15 00 00 00 01 00 02 ca 5f 15 00 00 00 01 00 02 cb 02 15 00 00 00 01 00 02 cc 7f 15 00 00 00 01 00 02 cd 02 15 00 00 00 01 00 02 ce 80 15 00 00 00 01 00 02 cf 02 15 00 00 00 01 00 02 d0 a9 15 00 00 00 01 00 02 d1 02 15 00 00 00 01 00 02 d2 e0 15 00 00 00 01 00 02 d3 03 15 00 00 00 01 00 02 d4 03 15 00 00 00 01 00 02 d5 03 15 00 00 00 01 00 02 d6 35 15 00 00 00 01 00 02 d7 03 15 00 00 00 01 00 02 d8 5d 15 00 00 00 01 00 02 d9 03 15 00 00 00 01 00 02 da 89 15 00 00 00 01 00 02 db 03 15 00 00 00 01 00 02 dc 93 15 00 00 00 01 00 02 dd 03 15 00 00 00 01 00 02 de 9d 15 00 00 00 01 00 02 df 03 15 00 00 00 01 00 02 e0 a5 15 00 00 00 01 00 02 e1 03 15 00 00 00 01 00 02 e2 ac 15 00 00 00 01 00 02 e3 03 15 00 00 00 01 00 02 e4 b1 15 01 00 00 01 00 02 e5 03 15 00 00 00 01 00 02 e6 b5 15 00 00 00 01 00 02 e7 03 15 00 00 00 01 00 02 e8 b6 15 00 00 00 01 00 02 e9 03 15 00 00 00 01 00 02 ea ff 15 00 00 00 01 00 02 fb 01 15 01 00 00 01 00 02 ff 10];
		qcom,mdss-dsi-dispparam-papermode-command-state = "dsi_hs_mode";
		qcom,mdss-dsi-dispparam-papermode1-command = [15 00 00 00 01 00 02 ff 20 15 00 00 00 01 00 02 fb 01 15 00 00 00 01 00 02 75 00 15 00 00 00 01 00 02 76 df 15 00 00 00 01 00 02 77 00 15 00 00 00 01 00 02 78 e0 15 00 00 00 01 00 02 79 00 15 00 00 00 01 00 02 7a ed 15 00 00 00 01 00 02 7b 00 15 00 00 00 01 00 02 7c f8 15 00 00 00 01 00 02 7d 01 15 00 00 00 01 00 02 7e 03 15 00 00 00 01 00 02 7f 01 15 00 00 00 01 00 02 80 0d 15 00 00 00 01 00 02 81 01 15 00 00 00 01 00 02 82 17 15 00 00 00 01 00 02 83 01 15 00 00 00 01 00 02 84 20 15 00 00 00 01 00 02 85 01 15 00 00 00 01 00 02 86 29 15 00 00 00 01 00 02 87 01 15 00 00 00 01 00 02 88 49 15 00 00 00 01 00 02 89 01 15 00 00 00 01 00 02 8a 65 15 00 00 00 01 00 02 8b 01 15 00 00 00 01 00 02 8c 92 15 00 00 00 01 00 02 8d 01 15 00 00 00 01 00 02 8e b8 15 00 00 00 01 00 02 8f 01 15 00 00 00 01 00 02 90 f6 15 00 00 00 01 00 02 91 02 15 00 00 00 01 00 02 92 1d 15 00 00 00 01 00 02 93 02 15 00 00 00 01 00 02 94 1f 15 00 00 00 01 00 02 95 02 15 00 00 00 01 00 02 96 4d 15 00 00 00 01 00 02 97 02 15 00 00 00 01 00 02 98 8a 15 00 00 00 01 00 02 99 02 15 00 00 00 01 00 02 9a b3 15 00 00 00 01 00 02 9b 02 15 00 00 00 01 00 02 9c eb 15 01 00 00 01 00 02 9d 03 15 00 00 00 01 00 02 9e 0c 15 00 00 00 01 00 02 9f 03 15 00 00 00 01 00 02 a0 3e 15 00 00 00 01 00 02 a2 03 15 00 00 00 01 00 02 a3 51 15 00 00 00 01 00 02 a4 03 15 00 00 00 01 00 02 a5 65 15 00 00 00 01 00 02 a6 03 15 00 00 00 01 00 02 a7 7a 15 00 00 00 01 00 02 a9 03 15 00 00 00 01 00 02 aa 90 15 00 00 00 01 00 02 ab 03 15 00 00 00 01 00 02 ac a3 15 00 00 00 01 00 02 ad 03 15 00 00 00 01 00 02 ae b0 15 00 00 00 01 00 02 af 03 15 00 00 00 01 00 02 b0 b6 15 00 00 00 01 00 02 b1 03 15 00 00 00 01 00 02 b2 ff 15 00 00 00 01 00 02 b3 00 15 00 00 00 01 00 02 b4 df 15 00 00 00 01 00 02 b5 00 15 00 00 00 01 00 02 b6 e0 15 00 00 00 01 00 02 b7 00 15 00 00 00 01 00 02 b8 ed 15 00 00 00 01 00 02 b9 00 15 00 00 00 01 00 02 ba f8 15 00 00 00 01 00 02 bb 01 15 00 00 00 01 00 02 bc 03 15 00 00 00 01 00 02 bd 01 15 00 00 00 01 00 02 be 0d 15 00 00 00 01 00 02 bf 01 15 00 00 00 01 00 02 c0 17 15 00 00 00 01 00 02 c1 01 15 00 00 00 01 00 02 c2 20 15 00 00 00 01 00 02 c3 01 15 00 00 00 01 00 02 c4 29 15 00 00 00 01 00 02 c5 01 15 00 00 00 01 00 02 c6 49 15 00 00 00 01 00 02 c7 01 15 00 00 00 01 00 02 c8 65 15 01 00 00 01 00 02 c9 01 15 00 00 00 01 00 02 ca 92 15 00 00 00 01 00 02 cb 01 15 00 00 00 01 00 02 cc b8 15 00 00 00 01 00 02 cd 01 15 00 00 00 01 00 02 ce f6 15 00 00 00 01 00 02 cf 02 15 00 00 00 01 00 02 d0 1d 15 00 00 00 01 00 02 d1 02 15 00 00 00 01 00 02 d2 1f 15 00 00 00 01 00 02 d3 02 15 00 00 00 01 00 02 d4 4d 15 00 00 00 01 00 02 d5 02 15 00 00 00 01 00 02 d6 8a 15 00 00 00 01 00 02 d7 02 15 00 00 00 01 00 02 d8 b3 15 00 00 00 01 00 02 d9 02 15 00 00 00 01 00 02 da eb 15 00 00 00 01 00 02 db 03 15 00 00 00 01 00 02 dc 0c 15 00 00 00 01 00 02 dd 03 15 00 00 00 01 00 02 de 3e 15 00 00 00 01 00 02 df 03 15 00 00 00 01 00 02 e0 51 15 00 00 00 01 00 02 e1 03 15 00 00 00 01 00 02 e2 65 15 00 00 00 01 00 02 e3 03 15 00 00 00 01 00 02 e4 7a 15 00 00 00 01 00 02 e5 03 15 00 00 00 01 00 02 e6 90 15 00 00 00 01 00 02 e7 03 15 00 00 00 01 00 02 e8 a3 15 00 00 00 01 00 02 e9 03 15 00 00 00 01 00 02 ea b0 15 00 00 00 01 00 02 eb 03 15 00 00 00 01 00 02 ec b6 15 00 00 00 01 00 02 ed 03 15 00 00 00 01 00 02 ee ff 15 00 00 00 01 00 02 ef 00 15 00 00 00 01 00 02 f0 df 15 00 00 00 01 00 02 f1 00 15 00 00 00 01 00 02 f2 e0 15 01 00 00 01 00 02 f3 00 15 00 00 00 01 00 02 f4 ed 15 00 00 00 01 00 02 f5 00 15 00 00 00 01 00 02 f6 f9 15 00 00 00 01 00 02 f7 01 15 00 00 00 01 00 02 f8 03 15 00 00 00 01 00 02 f9 01 15 00 00 00 01 00 02 fa 0e 15 00 00 00 01 00 02 ff 21 15 00 00 00 01 00 02 fb 01 15 00 00 00 01 00 02 00 01 15 00 00 00 01 00 02 01 17 15 00 00 00 01 00 02 02 01 15 00 00 00 01 00 02 03 21 15 00 00 00 01 00 02 04 01 15 00 00 00 01 00 02 05 2a 15 00 00 00 01 00 02 06 01 15 00 00 00 01 00 02 07 4a 15 00 00 00 01 00 02 08 01 15 00 00 00 01 00 02 09 65 15 00 00 00 01 00 02 0a 01 15 00 00 00 01 00 02 0b 92 15 00 00 00 01 00 02 0c 01 15 00 00 00 01 00 02 0d b8 15 00 00 00 01 00 02 0e 01 15 00 00 00 01 00 02 0f f7 15 00 00 00 01 00 02 10 02 15 00 00 00 01 00 02 11 1e 15 00 00 00 01 00 02 12 02 15 00 00 00 01 00 02 13 1f 15 00 00 00 01 00 02 14 02 15 00 00 00 01 00 02 15 4e 15 00 00 00 01 00 02 16 02 15 00 00 00 01 00 02 17 8a 15 00 00 00 01 00 02 18 02 15 00 00 00 01 00 02 19 b4 15 00 00 00 01 00 02 1a 02 15 00 00 00 01 00 02 1b ea 15 00 00 00 01 00 02 1c 03 15 00 00 00 01 00 02 1d 0a 15 01 00 00 01 00 02 1e 03 15 00 00 00 01 00 02 1f 39 15 00 00 00 01 00 02 20 03 15 00 00 00 01 00 02 21 49 15 00 00 00 01 00 02 22 03 15 00 00 00 01 00 02 23 5b 15 00 00 00 01 00 02 24 03 15 00 00 00 01 00 02 25 6e 15 00 00 00 01 00 02 26 03 15 00 00 00 01 00 02 27 85 15 00 00 00 01 00 02 28 03 15 00 00 00 01 00 02 29 a0 15 00 00 00 01 00 02 2a 03 15 00 00 00 01 00 02 2b ba 15 00 00 00 01 00 02 2d 03 15 00 00 00 01 00 02 2f cb 15 00 00 00 01 00 02 30 03 15 00 00 00 01 00 02 31 ff 15 00 00 00 01 00 02 32 00 15 00 00 00 01 00 02 33 df 15 00 00 00 01 00 02 34 00 15 00 00 00 01 00 02 35 e0 15 00 00 00 01 00 02 36 00 15 00 00 00 01 00 02 37 ed 15 00 00 00 01 00 02 38 00 15 00 00 00 01 00 02 39 f9 15 00 00 00 01 00 02 3a 01 15 00 00 00 01 00 02 3b 03 15 00 00 00 01 00 02 3d 01 15 00 00 00 01 00 02 3f 0e 15 00 00 00 01 00 02 40 01 15 00 00 00 01 00 02 41 17 15 00 00 00 01 00 02 42 01 15 00 00 00 01 00 02 43 21 15 00 00 00 01 00 02 44 01 15 00 00 00 01 00 02 45 2a 15 00 00 00 01 00 02 46 01 15 00 00 00 01 00 02 47 4a 15 00 00 00 01 00 02 48 01 15 00 00 00 01 00 02 49 65 15 01 00 00 01 00 02 4a 01 15 00 00 00 01 00 02 4b 92 15 00 00 00 01 00 02 4c 01 15 00 00 00 01 00 02 4d b8 15 00 00 00 01 00 02 4e 01 15 00 00 00 01 00 02 4f f7 15 00 00 00 01 00 02 50 02 15 00 00 00 01 00 02 51 1e 15 00 00 00 01 00 02 52 02 15 00 00 00 01 00 02 53 1f 15 00 00 00 01 00 02 54 02 15 00 00 00 01 00 02 55 4e 15 00 00 00 01 00 02 56 02 15 00 00 00 01 00 02 58 8a 15 00 00 00 01 00 02 59 02 15 00 00 00 01 00 02 5a b4 15 00 00 00 01 00 02 5b 02 15 00 00 00 01 00 02 5c ea 15 00 00 00 01 00 02 5d 03 15 00 00 00 01 00 02 5e 0a 15 00 00 00 01 00 02 5f 03 15 00 00 00 01 00 02 60 39 15 00 00 00 01 00 02 61 03 15 00 00 00 01 00 02 62 49 15 00 00 00 01 00 02 63 03 15 00 00 00 01 00 02 64 5b 15 00 00 00 01 00 02 65 03 15 00 00 00 01 00 02 66 6e 15 00 00 00 01 00 02 67 03 15 00 00 00 01 00 02 68 85 15 00 00 00 01 00 02 69 03 15 00 00 00 01 00 02 6a a0 15 00 00 00 01 00 02 6b 03 15 00 00 00 01 00 02 6c ba 15 00 00 00 01 00 02 6d 03 15 00 00 00 01 00 02 6e cb 15 00 00 00 01 00 02 6f 03 15 00 00 00 01 00 02 70 ff 15 00 00 00 01 00 02 71 01 15 00 00 00 01 00 02 72 4e 15 00 00 00 01 00 02 73 01 15 01 00 00 01 00 02 74 4f 15 00 00 00 01 00 02 75 01 15 00 00 00 01 00 02 76 50 15 00 00 00 01 00 02 77 01 15 00 00 00 01 00 02 78 53 15 00 00 00 01 00 02 79 01 15 00 00 00 01 00 02 7a 59 15 00 00 00 01 00 02 7b 01 15 00 00 00 01 00 02 7c 5f 15 00 00 00 01 00 02 7d 01 15 00 00 00 01 00 02 7e 65 15 00 00 00 01 00 02 7f 01 15 00 00 00 01 00 02 80 6b 15 00 00 00 01 00 02 81 01 15 00 00 00 01 00 02 82 70 15 00 00 00 01 00 02 83 01 15 00 00 00 01 00 02 84 85 15 00 00 00 01 00 02 85 01 15 00 00 00 01 00 02 86 98 15 00 00 00 01 00 02 87 01 15 00 00 00 01 00 02 88 ba 15 00 00 00 01 00 02 89 01 15 00 00 00 01 00 02 8a d9 15 00 00 00 01 00 02 8b 02 15 00 00 00 01 00 02 8c 06 15 00 00 00 01 00 02 8d 02 15 00 00 00 01 00 02 8e 2b 15 00 00 00 01 00 02 8f 02 15 00 00 00 01 00 02 90 2d 15 00 00 00 01 00 02 91 02 15 00 00 00 01 00 02 92 5a 15 00 00 00 01 00 02 93 02 15 00 00 00 01 00 02 94 95 15 00 00 00 01 00 02 95 02 15 00 00 00 01 00 02 96 bd 15 00 00 00 01 00 02 97 02 15 00 00 00 01 00 02 98 f4 15 00 00 00 01 00 02 99 03 15 00 00 00 01 00 02 9a 13 15 00 00 00 01 00 02 9b 03 15 00 00 00 01 00 02 9c 4d 15 01 00 00 01 00 02 9d 03 15 00 00 00 01 00 02 9e 5f 15 00 00 00 01 00 02 9f 03 15 00 00 00 01 00 02 a0 72 15 00 00 00 01 00 02 a2 03 15 00 00 00 01 00 02 a3 85 15 00 00 00 01 00 02 a4 03 15 00 00 00 01 00 02 a5 97 15 00 00 00 01 00 02 a6 03 15 00 00 00 01 00 02 a7 a6 15 00 00 00 01 00 02 a9 03 15 00 00 00 01 00 02 aa b1 15 00 00 00 01 00 02 ab 03 15 00 00 00 01 00 02 ac b6 15 00 00 00 01 00 02 ad 03 15 00 00 00 01 00 02 ae ff 15 00 00 00 01 00 02 af 01 15 00 00 00 01 00 02 b0 4e 15 00 00 00 01 00 02 b1 01 15 00 00 00 01 00 02 b2 4f 15 00 00 00 01 00 02 b3 01 15 00 00 00 01 00 02 b4 50 15 00 00 00 01 00 02 b5 01 15 00 00 00 01 00 02 b6 53 15 00 00 00 01 00 02 b7 01 15 00 00 00 01 00 02 b8 59 15 00 00 00 01 00 02 b9 01 15 00 00 00 01 00 02 ba 5f 15 00 00 00 01 00 02 bb 01 15 00 00 00 01 00 02 bc 65 15 00 00 00 01 00 02 bd 01 15 00 00 00 01 00 02 be 6b 15 00 00 00 01 00 02 bf 01 15 00 00 00 01 00 02 c0 70 15 00 00 00 01 00 02 c1 01 15 00 00 00 01 00 02 c2 85 15 00 00 00 01 00 02 c3 01 15 00 00 00 01 00 02 c4 98 15 00 00 00 01 00 02 c5 01 15 00 00 00 01 00 02 c6 ba 15 00 00 00 01 00 02 c7 01 15 01 00 00 01 00 02 c8 d9 15 00 00 00 01 00 02 c9 02 15 00 00 00 01 00 02 ca 06 15 00 00 00 01 00 02 cb 02 15 00 00 00 01 00 02 cc 2b 15 00 00 00 01 00 02 cd 02 15 00 00 00 01 00 02 ce 2d 15 00 00 00 01 00 02 cf 02 15 00 00 00 01 00 02 d0 5a 15 00 00 00 01 00 02 d1 02 15 00 00 00 01 00 02 d2 95 15 00 00 00 01 00 02 d3 02 15 00 00 00 01 00 02 d4 bd 15 00 00 00 01 00 02 d5 02 15 00 00 00 01 00 02 d6 f4 15 00 00 00 01 00 02 d7 03 15 00 00 00 01 00 02 d8 13 15 00 00 00 01 00 02 d9 03 15 00 00 00 01 00 02 da 4d 15 00 00 00 01 00 02 db 03 15 00 00 00 01 00 02 dc 5f 15 00 00 00 01 00 02 dd 03 15 00 00 00 01 00 02 de 72 15 00 00 00 01 00 02 df 03 15 00 00 00 01 00 02 e0 85 15 00 00 00 01 00 02 e1 03 15 00 00 00 01 00 02 e2 97 15 00 00 00 01 00 02 e3 03 15 00 00 00 01 00 02 e4 a6 15 00 00 00 01 00 02 e5 03 15 00 00 00 01 00 02 e6 b1 15 00 00 00 01 00 02 e7 03 15 00 00 00 01 00 02 e8 b6 15 00 00 00 01 00 02 e9 03 15 00 00 00 01 00 02 ea ff 15 00 00 00 01 00 02 fb 01 15 01 00 00 01 00 02 ff 10];
		qcom,mdss-dsi-dispparam-papermode1-command-state = "dsi_hs_mode";
		qcom,mdss-dsi-dispparam-papermode2-command = [15 00 00 00 01 00 02 ff 20 15 00 00 00 01 00 02 fb 01 15 00 00 00 01 00 02 75 01 15 00 00 00 01 00 02 76 13 15 00 00 00 01 00 02 77 01 15 00 00 00 01 00 02 78 18 15 00 00 00 01 00 02 79 01 15 00 00 00 01 00 02 7a 21 15 00 00 00 01 00 02 7b 01 15 00 00 00 01 00 02 7c 29 15 00 00 00 01 00 02 7d 01 15 00 00 00 01 00 02 7e 31 15 00 00 00 01 00 02 7f 01 15 00 00 00 01 00 02 80 39 15 00 00 00 01 00 02 81 01 15 00 00 00 01 00 02 82 41 15 00 00 00 01 00 02 83 01 15 00 00 00 01 00 02 84 48 15 00 00 00 01 00 02 85 01 15 00 00 00 01 00 02 86 4f 15 00 00 00 01 00 02 87 01 15 00 00 00 01 00 02 88 68 15 00 00 00 01 00 02 89 01 15 00 00 00 01 00 02 8a 7f 15 00 00 00 01 00 02 8b 01 15 00 00 00 01 00 02 8c a6 15 00 00 00 01 00 02 8d 01 15 00 00 00 01 00 02 8e c8 15 00 00 00 01 00 02 8f 01 15 00 00 00 01 00 02 90 fe 15 00 00 00 01 00 02 91 02 15 00 00 00 01 00 02 92 24 15 00 00 00 01 00 02 93 02 15 00 00 00 01 00 02 94 25 15 00 00 00 01 00 02 95 02 15 00 00 00 01 00 02 96 53 15 00 00 00 01 00 02 97 02 15 00 00 00 01 00 02 98 8f 15 00 00 00 01 00 02 99 02 15 00 00 00 01 00 02 9a b9 15 00 00 00 01 00 02 9b 02 15 01 00 00 01 00 02 9c f0 15 00 00 00 01 00 02 9d 03 15 00 00 00 01 00 02 9e 10 15 00 00 00 01 00 02 9f 03 15 00 00 00 01 00 02 a0 44 15 00 00 00 01 00 02 a2 03 15 00 00 00 01 00 02 a3 56 15 00 00 00 01 00 02 a4 03 15 00 00 00 01 00 02 a5 69 15 00 00 00 01 00 02 a6 03 15 00 00 00 01 00 02 a7 7e 15 00 00 00 01 00 02 a9 03 15 00 00 00 01 00 02 aa 93 15 00 00 00 01 00 02 ab 03 15 00 00 00 01 00 02 ac a4 15 00 00 00 01 00 02 ad 03 15 00 00 00 01 00 02 ae b0 15 00 00 00 01 00 02 af 03 15 00 00 00 01 00 02 b0 b6 15 00 00 00 01 00 02 b1 03 15 00 00 00 01 00 02 b2 ff 15 00 00 00 01 00 02 b3 01 15 00 00 00 01 00 02 b4 13 15 00 00 00 01 00 02 b5 01 15 00 00 00 01 00 02 b6 18 15 00 00 00 01 00 02 b7 01 15 00 00 00 01 00 02 b8 21 15 00 00 00 01 00 02 b9 01 15 00 00 00 01 00 02 ba 29 15 00 00 00 01 00 02 bb 01 15 00 00 00 01 00 02 bc 31 15 00 00 00 01 00 02 bd 01 15 00 00 00 01 00 02 be 39 15 00 00 00 01 00 02 bf 01 15 00 00 00 01 00 02 c0 41 15 00 00 00 01 00 02 c1 01 15 00 00 00 01 00 02 c2 48 15 00 00 00 01 00 02 c3 01 15 00 00 00 01 00 02 c4 4f 15 00 00 00 01 00 02 c5 01 15 00 00 00 01 00 02 c6 68 15 01 00 00 01 00 02 c7 01 15 00 00 00 01 00 02 c8 7f 15 00 00 00 01 00 02 c9 01 15 00 00 00 01 00 02 ca a6 15 00 00 00 01 00 02 cb 01 15 00 00 00 01 00 02 cc c8 15 00 00 00 01 00 02 cd 01 15 00 00 00 01 00 02 ce fe 15 00 00 00 01 00 02 cf 02 15 00 00 00 01 00 02 d0 24 15 00 00 00 01 00 02 d1 02 15 00 00 00 01 00 02 d2 25 15 00 00 00 01 00 02 d3 02 15 00 00 00 01 00 02 d4 53 15 00 00 00 01 00 02 d5 02 15 00 00 00 01 00 02 d6 8f 15 00 00 00 01 00 02 d7 02 15 00 00 00 01 00 02 d8 b9 15 00 00 00 01 00 02 d9 02 15 00 00 00 01 00 02 da f0 15 00 00 00 01 00 02 db 03 15 00 00 00 01 00 02 dc 10 15 00 00 00 01 00 02 dd 03 15 00 00 00 01 00 02 de 44 15 00 00 00 01 00 02 df 03 15 00 00 00 01 00 02 e0 56 15 00 00 00 01 00 02 e1 03 15 00 00 00 01 00 02 e2 69 15 00 00 00 01 00 02 e3 03 15 00 00 00 01 00 02 e4 7e 15 00 00 00 01 00 02 e5 03 15 00 00 00 01 00 02 e6 93 15 00 00 00 01 00 02 e7 03 15 00 00 00 01 00 02 e8 a4 15 00 00 00 01 00 02 e9 03 15 00 00 00 01 00 02 ea b0 15 00 00 00 01 00 02 eb 03 15 00 00 00 01 00 02 ec b6 15 00 00 00 01 00 02 ed 03 15 00 00 00 01 00 02 ee ff 15 00 00 00 01 00 02 ef 01 15 01 00 00 01 00 02 f0 13 15 00 00 00 01 00 02 f1 01 15 00 00 00 01 00 02 f2 18 15 00 00 00 01 00 02 f3 01 15 00 00 00 01 00 02 f4 21 15 00 00 00 01 00 02 f5 01 15 00 00 00 01 00 02 f6 29 15 00 00 00 01 00 02 f7 01 15 00 00 00 01 00 02 f8 31 15 00 00 00 01 00 02 f9 01 15 00 00 00 01 00 02 fa 39 15 00 00 00 01 00 02 ff 21 15 00 00 00 01 00 02 fb 01 15 00 00 00 01 00 02 00 01 15 00 00 00 01 00 02 01 41 15 00 00 00 01 00 02 02 01 15 00 00 00 01 00 02 03 48 15 00 00 00 01 00 02 04 01 15 00 00 00 01 00 02 05 4f 15 00 00 00 01 00 02 06 01 15 00 00 00 01 00 02 07 69 15 00 00 00 01 00 02 08 01 15 00 00 00 01 00 02 09 7f 15 00 00 00 01 00 02 0a 01 15 00 00 00 01 00 02 0b a6 15 00 00 00 01 00 02 0c 01 15 00 00 00 01 00 02 0d c8 15 00 00 00 01 00 02 0e 01 15 00 00 00 01 00 02 0f fe 15 00 00 00 01 00 02 10 02 15 00 00 00 01 00 02 11 24 15 00 00 00 01 00 02 12 02 15 00 00 00 01 00 02 13 26 15 00 00 00 01 00 02 14 02 15 00 00 00 01 00 02 15 54 15 00 00 00 01 00 02 16 02 15 00 00 00 01 00 02 17 90 15 00 00 00 01 00 02 18 02 15 00 00 00 01 00 02 19 b9 15 00 00 00 01 00 02 1a 02 15 00 00 00 01 00 02 1b ef 15 01 00 00 01 00 02 1c 03 15 00 00 00 01 00 02 1d 0e 15 00 00 00 01 00 02 1e 03 15 00 00 00 01 00 02 1f 3e 15 00 00 00 01 00 02 20 03 15 00 00 00 01 00 02 21 4d 15 00 00 00 01 00 02 22 03 15 00 00 00 01 00 02 23 5f 15 00 00 00 01 00 02 24 03 15 00 00 00 01 00 02 25 72 15 00 00 00 01 00 02 26 03 15 00 00 00 01 00 02 27 89 15 00 00 00 01 00 02 28 03 15 00 00 00 01 00 02 29 a2 15 00 00 00 01 00 02 2a 03 15 00 00 00 01 00 02 2b bc 15 00 00 00 01 00 02 2d 03 15 00 00 00 01 00 02 2f cb 15 00 00 00 01 00 02 30 03 15 00 00 00 01 00 02 31 ff 15 00 00 00 01 00 02 32 01 15 00 00 00 01 00 02 33 13 15 00 00 00 01 00 02 34 01 15 00 00 00 01 00 02 35 18 15 00 00 00 01 00 02 36 01 15 00 00 00 01 00 02 37 21 15 00 00 00 01 00 02 38 01 15 00 00 00 01 00 02 39 29 15 00 00 00 01 00 02 3a 01 15 00 00 00 01 00 02 3b 31 15 00 00 00 01 00 02 3d 01 15 00 00 00 01 00 02 3f 39 15 00 00 00 01 00 02 40 01 15 00 00 00 01 00 02 41 41 15 00 00 00 01 00 02 42 01 15 00 00 00 01 00 02 43 48 15 00 00 00 01 00 02 44 01 15 00 00 00 01 00 02 45 4f 15 00 00 00 01 00 02 46 01 15 00 00 00 01 00 02 47 69 15 00 00 00 01 00 02 48 01 15 01 00 00 01 00 02 49 7f 15 00 00 00 01 00 02 4a 01 15 00 00 00 01 00 02 4b a6 15 00 00 00 01 00 02 4c 01 15 00 00 00 01 00 02 4d c8 15 00 00 00 01 00 02 4e 01 15 00 00 00 01 00 02 4f fe 15 00 00 00 01 00 02 50 02 15 00 00 00 01 00 02 51 24 15 00 00 00 01 00 02 52 02 15 00 00 00 01 00 02 53 26 15 00 00 00 01 00 02 54 02 15 00 00 00 01 00 02 55 54 15 00 00 00 01 00 02 56 02 15 00 00 00 01 00 02 58 90 15 00 00 00 01 00 02 59 02 15 00 00 00 01 00 02 5a b9 15 00 00 00 01 00 02 5b 02 15 00 00 00 01 00 02 5c ef 15 00 00 00 01 00 02 5d 03 15 00 00 00 01 00 02 5e 0e 15 00 00 00 01 00 02 5f 03 15 00 00 00 01 00 02 60 3e 15 00 00 00 01 00 02 61 03 15 00 00 00 01 00 02 62 4d 15 00 00 00 01 00 02 63 03 15 00 00 00 01 00 02 64 5f 15 00 00 00 01 00 02 65 03 15 00 00 00 01 00 02 66 72 15 00 00 00 01 00 02 67 03 15 00 00 00 01 00 02 68 89 15 00 00 00 01 00 02 69 03 15 00 00 00 01 00 02 6a a2 15 00 00 00 01 00 02 6b 03 15 00 00 00 01 00 02 6c bc 15 00 00 00 01 00 02 6d 03 15 00 00 00 01 00 02 6e cb 15 00 00 00 01 00 02 6f 03 15 00 00 00 01 00 02 70 ff 15 00 00 00 01 00 02 71 01 15 00 00 00 01 00 02 72 83 15 01 00 00 01 00 02 73 01 15 00 00 00 01 00 02 74 85 15 00 00 00 01 00 02 75 01 15 00 00 00 01 00 02 76 8a 15 00 00 00 01 00 02 77 01 15 00 00 00 01 00 02 78 8e 15 00 00 00 01 00 02 79 01 15 00 00 00 01 00 02 7a 92 15 00 00 00 01 00 02 7b 01 15 00 00 00 01 00 02 7c 97 15 00 00 00 01 00 02 7d 01 15 00 00 00 01 00 02 7e 9b 15 00 00 00 01 00 02 7f 01 15 00 00 00 01 00 02 80 9f 15 00 00 00 01 00 02 81 01 15 00 00 00 01 00 02 82 a3 15 00 00 00 01 00 02 83 01 15 00 00 00 01 00 02 84 b2 15 00 00 00 01 00 02 85 01 15 00 00 00 01 00 02 86 c1 15 00 00 00 01 00 02 87 01 15 00 00 00 01 00 02 88 dc 15 00 00 00 01 00 02 89 01 15 00 00 00 01 00 02 8a f5 15 00 00 00 01 00 02 8b 02 15 00 00 00 01 00 02 8c 15 15 00 00 00 01 00 02 8d 02 15 00 00 00 01 00 02 8e 3a 15 00 00 00 01 00 02 8f 02 15 00 00 00 01 00 02 90 3b 15 00 00 00 01 00 02 91 02 15 00 00 00 01 00 02 92 67 15 00 00 00 01 00 02 93 02 15 00 00 00 01 00 02 94 a2 15 00 00 00 01 00 02 95 02 15 00 00 00 01 00 02 96 ca 15 00 00 00 01 00 02 97 02 15 00 00 00 01 00 02 98 fe 15 00 00 00 01 00 02 99 03 15 00 00 00 01 00 02 9a 1b 15 00 00 00 01 00 02 9b 03 15 01 00 00 01 00 02 9c 58 15 00 00 00 01 00 02 9d 03 15 00 00 00 01 00 02 9e 6a 15 00 00 00 01 00 02 9f 03 15 00 00 00 01 00 02 a0 7b 15 00 00 00 01 00 02 a2 03 15 00 00 00 01 00 02 a3 8c 15 00 00 00 01 00 02 a4 03 15 00 00 00 01 00 02 a5 9c 15 00 00 00 01 00 02 a6 03 15 00 00 00 01 00 02 a7 a9 15 00 00 00 01 00 02 a9 03 15 00 00 00 01 00 02 aa b2 15 00 00 00 01 00 02 ab 03 15 00 00 00 01 00 02 ac b6 15 00 00 00 01 00 02 ad 03 15 00 00 00 01 00 02 ae ff 15 00 00 00 01 00 02 af 01 15 00 00 00 01 00 02 b0 83 15 00 00 00 01 00 02 b1 01 15 00 00 00 01 00 02 b2 85 15 00 00 00 01 00 02 b3 01 15 00 00 00 01 00 02 b4 8a 15 00 00 00 01 00 02 b5 01 15 00 00 00 01 00 02 b6 8e 15 00 00 00 01 00 02 b7 01 15 00 00 00 01 00 02 b8 92 15 00 00 00 01 00 02 b9 01 15 00 00 00 01 00 02 ba 97 15 00 00 00 01 00 02 bb 01 15 00 00 00 01 00 02 bc 9b 15 00 00 00 01 00 02 bd 01 15 00 00 00 01 00 02 be 9f 15 00 00 00 01 00 02 bf 01 15 00 00 00 01 00 02 c0 a3 15 00 00 00 01 00 02 c1 01 15 00 00 00 01 00 02 c2 b2 15 00 00 00 01 00 02 c3 01 15 00 00 00 01 00 02 c4 c1 15 00 00 00 01 00 02 c5 01 15 01 00 00 01 00 02 c6 dc 15 00 00 00 01 00 02 c7 01 15 00 00 00 01 00 02 c8 f5 15 00 00 00 01 00 02 c9 02 15 00 00 00 01 00 02 ca 15 15 00 00 00 01 00 02 cb 02 15 00 00 00 01 00 02 cc 3a 15 00 00 00 01 00 02 cd 02 15 00 00 00 01 00 02 ce 3b 15 00 00 00 01 00 02 cf 02 15 00 00 00 01 00 02 d0 67 15 00 00 00 01 00 02 d1 02 15 00 00 00 01 00 02 d2 a2 15 00 00 00 01 00 02 d3 02 15 00 00 00 01 00 02 d4 ca 15 00 00 00 01 00 02 d5 02 15 00 00 00 01 00 02 d6 fe 15 00 00 00 01 00 02 d7 03 15 00 00 00 01 00 02 d8 1b 15 00 00 00 01 00 02 d9 03 15 00 00 00 01 00 02 da 58 15 00 00 00 01 00 02 db 03 15 00 00 00 01 00 02 dc 6a 15 00 00 00 01 00 02 dd 03 15 00 00 00 01 00 02 de 7b 15 00 00 00 01 00 02 df 03 15 00 00 00 01 00 02 e0 8c 15 00 00 00 01 00 02 e1 03 15 00 00 00 01 00 02 e2 9c 15 00 00 00 01 00 02 e3 03 15 00 00 00 01 00 02 e4 a9 15 00 00 00 01 00 02 e5 03 15 00 00 00 01 00 02 e6 b2 15 00 00 00 01 00 02 e7 03 15 00 00 00 01 00 02 e8 b6 15 00 00 00 01 00 02 e9 03 15 00 00 00 01 00 02 ea ff 15 00 00 00 01 00 02 fb 01 15 01 00 00 01 00 02 ff 10];
		qcom,mdss-dsi-dispparam-papermode2-command-state = "dsi_hs_mode";
		qcom,mdss-dsi-dispparam-papermode3-command = [15 00 00 00 01 00 02 ff 20 15 00 00 00 01 00 02 fb 01 15 00 00 00 01 00 02 75 01 15 00 00 00 01 00 02 76 37 15 00 00 00 01 00 02 77 01 15 00 00 00 01 00 02 78 3b 15 00 00 00 01 00 02 79 01 15 00 00 00 01 00 02 7a 42 15 00 00 00 01 00 02 7b 01 15 00 00 00 01 00 02 7c 49 15 00 00 00 01 00 02 7d 01 15 00 00 00 01 00 02 7e 50 15 00 00 00 01 00 02 7f 01 15 00 00 00 01 00 02 80 56 15 00 00 00 01 00 02 81 01 15 00 00 00 01 00 02 82 5c 15 00 00 00 01 00 02 83 01 15 00 00 00 01 00 02 84 62 15 00 00 00 01 00 02 85 01 15 00 00 00 01 00 02 86 68 15 00 00 00 01 00 02 87 01 15 00 00 00 01 00 02 88 7e 15 00 00 00 01 00 02 89 01 15 00 00 00 01 00 02 8a 92 15 00 00 00 01 00 02 8b 01 15 00 00 00 01 00 02 8c b5 15 00 00 00 01 00 02 8d 01 15 00 00 00 01 00 02 8e d4 15 00 00 00 01 00 02 8f 02 15 00 00 00 01 00 02 90 04 15 00 00 00 01 00 02 91 02 15 00 00 00 01 00 02 92 2a 15 00 00 00 01 00 02 93 02 15 00 00 00 01 00 02 94 2b 15 00 00 00 01 00 02 95 02 15 00 00 00 01 00 02 96 58 15 00 00 00 01 00 02 97 02 15 00 00 00 01 00 02 98 94 15 00 00 00 01 00 02 99 02 15 01 00 00 01 00 02 9a be 15 00 00 00 01 00 02 9b 02 15 00 00 00 01 00 02 9c f4 15 00 00 00 01 00 02 9d 03 15 00 00 00 01 00 02 9e 12 15 00 00 00 01 00 02 9f 03 15 00 00 00 01 00 02 a0 48 15 00 00 00 01 00 02 a2 03 15 00 00 00 01 00 02 a3 5a 15 00 00 00 01 00 02 a4 03 15 00 00 00 01 00 02 a5 6d 15 00 00 00 01 00 02 a6 03 15 00 00 00 01 00 02 a7 82 15 00 00 00 01 00 02 a9 03 15 00 00 00 01 00 02 aa 95 15 00 00 00 01 00 02 ab 03 15 00 00 00 01 00 02 ac a6 15 00 00 00 01 00 02 ad 03 15 00 00 00 01 00 02 ae b1 15 00 00 00 01 00 02 af 03 15 00 00 00 01 00 02 b0 b6 15 00 00 00 01 00 02 b1 03 15 00 00 00 01 00 02 b2 ff 15 00 00 00 01 00 02 b3 01 15 00 00 00 01 00 02 b4 37 15 00 00 00 01 00 02 b5 01 15 00 00 00 01 00 02 b6 3b 15 00 00 00 01 00 02 b7 01 15 00 00 00 01 00 02 b8 42 15 00 00 00 01 00 02 b9 01 15 00 00 00 01 00 02 ba 49 15 00 00 00 01 00 02 bb 01 15 00 00 00 01 00 02 bc 50 15 00 00 00 01 00 02 bd 01 15 00 00 00 01 00 02 be 56 15 00 00 00 01 00 02 bf 01 15 00 00 00 01 00 02 c0 5c 15 00 00 00 01 00 02 c1 01 15 00 00 00 01 00 02 c2 62 15 00 00 00 01 00 02 c3 01 15 00 00 00 01 00 02 c4 68 15 00 00 00 01 00 02 c5 01 15 01 00 00 01 00 02 c6 7e 15 00 00 00 01 00 02 c7 01 15 00 00 00 01 00 02 c8 92 15 00 00 00 01 00 02 c9 01 15 00 00 00 01 00 02 ca b5 15 00 00 00 01 00 02 cb 01 15 00 00 00 01 00 02 cc d4 15 00 00 00 01 00 02 cd 02 15 00 00 00 01 00 02 ce 04 15 00 00 00 01 00 02 cf 02 15 00 00 00 01 00 02 d0 2a 15 00 00 00 01 00 02 d1 02 15 00 00 00 01 00 02 d2 2b 15 00 00 00 01 00 02 d3 02 15 00 00 00 01 00 02 d4 58 15 00 00 00 01 00 02 d5 02 15 00 00 00 01 00 02 d6 94 15 00 00 00 01 00 02 d7 02 15 00 00 00 01 00 02 d8 be 15 00 00 00 01 00 02 d9 02 15 00 00 00 01 00 02 da f4 15 00 00 00 01 00 02 db 03 15 00 00 00 01 00 02 dc 12 15 00 00 00 01 00 02 dd 03 15 00 00 00 01 00 02 de 48 15 00 00 00 01 00 02 df 03 15 00 00 00 01 00 02 e0 5a 15 00 00 00 01 00 02 e1 03 15 00 00 00 01 00 02 e2 6d 15 00 00 00 01 00 02 e3 03 15 00 00 00 01 00 02 e4 82 15 00 00 00 01 00 02 e5 03 15 00 00 00 01 00 02 e6 95 15 00 00 00 01 00 02 e7 03 15 00 00 00 01 00 02 e8 a6 15 00 00 00 01 00 02 e9 03 15 00 00 00 01 00 02 ea b1 15 00 00 00 01 00 02 eb 03 15 00 00 00 01 00 02 ec b6 15 00 00 00 01 00 02 ed 03 15 00 00 00 01 00 02 ee ff 15 01 00 00 01 00 02 ef 01 15 00 00 00 01 00 02 f0 37 15 00 00 00 01 00 02 f1 01 15 00 00 00 01 00 02 f2 3b 15 00 00 00 01 00 02 f3 01 15 00 00 00 01 00 02 f4 42 15 00 00 00 01 00 02 f5 01 15 00 00 00 01 00 02 f6 49 15 00 00 00 01 00 02 f7 01 15 00 00 00 01 00 02 f8 50 15 00 00 00 01 00 02 f9 01 15 00 00 00 01 00 02 fa 56 15 00 00 00 01 00 02 ff 21 15 00 00 00 01 00 02 fb 01 15 00 00 00 01 00 02 00 01 15 00 00 00 01 00 02 01 5c 15 00 00 00 01 00 02 02 01 15 00 00 00 01 00 02 03 63 15 00 00 00 01 00 02 04 01 15 00 00 00 01 00 02 05 68 15 00 00 00 01 00 02 06 01 15 00 00 00 01 00 02 07 7e 15 00 00 00 01 00 02 08 01 15 00 00 00 01 00 02 09 92 15 00 00 00 01 00 02 0a 01 15 00 00 00 01 00 02 0b b5 15 00 00 00 01 00 02 0c 01 15 00 00 00 01 00 02 0d d4 15 00 00 00 01 00 02 0e 02 15 00 00 00 01 00 02 0f 04 15 00 00 00 01 00 02 10 02 15 00 00 00 01 00 02 11 2a 15 00 00 00 01 00 02 12 02 15 00 00 00 01 00 02 13 2b 15 00 00 00 01 00 02 14 02 15 00 00 00 01 00 02 15 59 15 00 00 00 01 00 02 16 02 15 00 00 00 01 00 02 17 95 15 00 00 00 01 00 02 18 02 15 01 00 00 01 00 02 19 be 15 00 00 00 01 00 02 1a 02 15 00 00 00 01 00 02 1b f3 15 00 00 00 01 00 02 1c 03 15 00 00 00 01 00 02 1d 11 15 00 00 00 01 00 02 1e 03 15 00 00 00 01 00 02 1f 41 15 00 00 00 01 00 02 20 03 15 00 00 00 01 00 02 21 51 15 00 00 00 01 00 02 22 03 15 00 00 00 01 00 02 23 62 15 00 00 00 01 00 02 24 03 15 00 00 00 01 00 02 25 75 15 00 00 00 01 00 02 26 03 15 00 00 00 01 00 02 27 8b 15 00 00 00 01 00 02 28 03 15 00 00 00 01 00 02 29 a5 15 00 00 00 01 00 02 2a 03 15 00 00 00 01 00 02 2b bd 15 00 00 00 01 00 02 2d 03 15 00 00 00 01 00 02 2f cb 15 00 00 00 01 00 02 30 03 15 00 00 00 01 00 02 31 ff 15 00 00 00 01 00 02 32 01 15 00 00 00 01 00 02 33 37 15 00 00 00 01 00 02 34 01 15 00 00 00 01 00 02 35 3b 15 00 00 00 01 00 02 36 01 15 00 00 00 01 00 02 37 42 15 00 00 00 01 00 02 38 01 15 00 00 00 01 00 02 39 49 15 00 00 00 01 00 02 3a 01 15 00 00 00 01 00 02 3b 50 15 00 00 00 01 00 02 3d 01 15 00 00 00 01 00 02 3f 56 15 00 00 00 01 00 02 40 01 15 00 00 00 01 00 02 41 5c 15 00 00 00 01 00 02 42 01 15 00 00 00 01 00 02 43 63 15 00 00 00 01 00 02 44 01 15 00 00 00 01 00 02 45 68 15 01 00 00 01 00 02 46 01 15 00 00 00 01 00 02 47 7e 15 00 00 00 01 00 02 48 01 15 00 00 00 01 00 02 49 92 15 00 00 00 01 00 02 4a 01 15 00 00 00 01 00 02 4b b5 15 00 00 00 01 00 02 4c 01 15 00 00 00 01 00 02 4d d4 15 00 00 00 01 00 02 4e 02 15 00 00 00 01 00 02 4f 04 15 00 00 00 01 00 02 50 02 15 00 00 00 01 00 02 51 2a 15 00 00 00 01 00 02 52 02 15 00 00 00 01 00 02 53 2b 15 00 00 00 01 00 02 54 02 15 00 00 00 01 00 02 55 59 15 00 00 00 01 00 02 56 02 15 00 00 00 01 00 02 58 95 15 00 00 00 01 00 02 59 02 15 00 00 00 01 00 02 5a be 15 00 00 00 01 00 02 5b 02 15 00 00 00 01 00 02 5c f3 15 00 00 00 01 00 02 5d 03 15 00 00 00 01 00 02 5e 11 15 00 00 00 01 00 02 5f 03 15 00 00 00 01 00 02 60 41 15 00 00 00 01 00 02 61 03 15 00 00 00 01 00 02 62 51 15 00 00 00 01 00 02 63 03 15 00 00 00 01 00 02 64 62 15 00 00 00 01 00 02 65 03 15 00 00 00 01 00 02 66 75 15 00 00 00 01 00 02 67 03 15 00 00 00 01 00 02 68 8b 15 00 00 00 01 00 02 69 03 15 00 00 00 01 00 02 6a a5 15 00 00 00 01 00 02 6b 03 15 00 00 00 01 00 02 6c bd 15 00 00 00 01 00 02 6d 03 15 00 00 00 01 00 02 6e cb 15 00 00 00 01 00 02 6f 03 15 01 00 00 01 00 02 70 ff 15 00 00 00 01 00 02 71 01 15 00 00 00 01 00 02 72 b0 15 00 00 00 01 00 02 73 01 15 00 00 00 01 00 02 74 b2 15 00 00 00 01 00 02 75 01 15 00 00 00 01 00 02 76 b5 15 00 00 00 01 00 02 77 01 15 00 00 00 01 00 02 78 b8 15 00 00 00 01 00 02 79 01 15 00 00 00 01 00 02 7a bc 15 00 00 00 01 00 02 7b 01 15 00 00 00 01 00 02 7c bf 15 00 00 00 01 00 02 7d 01 15 00 00 00 01 00 02 7e c2 15 00 00 00 01 00 02 7f 01 15 00 00 00 01 00 02 80 c6 15 00 00 00 01 00 02 81 01 15 00 00 00 01 00 02 82 c9 15 00 00 00 01 00 02 83 01 15 00 00 00 01 00 02 84 d5 15 00 00 00 01 00 02 85 01 15 00 00 00 01 00 02 86 e1 15 00 00 00 01 00 02 87 01 15 00 00 00 01 00 02 88 f7 15 00 00 00 01 00 02 89 02 15 00 00 00 01 00 02 8a 05 15 00 00 00 01 00 02 8b 02 15 00 00 00 01 00 02 8c 24 15 00 00 00 01 00 02 8d 02 15 00 00 00 01 00 02 8e 48 15 00 00 00 01 00 02 8f 02 15 00 00 00 01 00 02 90 49 15 00 00 00 01 00 02 91 02 15 00 00 00 01 00 02 92 74 15 00 00 00 01 00 02 93 02 15 00 00 00 01 00 02 94 ae 15 00 00 00 01 00 02 95 02 15 00 00 00 01 00 02 96 d6 15 00 00 00 01 00 02 97 03 15 01 00 00 01 00 02 98 08 15 00 00 00 01 00 02 99 03 15 00 00 00 01 00 02 9a 2a 15 00 00 00 01 00 02 9b 03 15 00 00 00 01 00 02 9c 63 15 00 00 00 01 00 02 9d 03 15 00 00 00 01 00 02 9e 73 15 00 00 00 01 00 02 9f 03 15 00 00 00 01 00 02 a0 83 15 00 00 00 01 00 02 a2 03 15 00 00 00 01 00 02 a3 93 15 00 00 00 01 00 02 a4 03 15 00 00 00 01 00 02 a5 a0 15 00 00 00 01 00 02 a6 03 15 00 00 00 01 00 02 a7 ab 15 00 00 00 01 00 02 a9 03 15 00 00 00 01 00 02 aa b3 15 00 00 00 01 00 02 ab 03 15 00 00 00 01 00 02 ac b6 15 00 00 00 01 00 02 ad 03 15 00 00 00 01 00 02 ae ff 15 00 00 00 01 00 02 af 01 15 00 00 00 01 00 02 b0 b0 15 00 00 00 01 00 02 b1 01 15 00 00 00 01 00 02 b2 b2 15 00 00 00 01 00 02 b3 01 15 00 00 00 01 00 02 b4 b5 15 00 00 00 01 00 02 b5 01 15 00 00 00 01 00 02 b6 b8 15 00 00 00 01 00 02 b7 01 15 00 00 00 01 00 02 b8 bc 15 00 00 00 01 00 02 b9 01 15 00 00 00 01 00 02 ba bf 15 00 00 00 01 00 02 bb 01 15 00 00 00 01 00 02 bc c2 15 00 00 00 01 00 02 bd 01 15 00 00 00 01 00 02 be c6 15 00 00 00 01 00 02 bf 01 15 00 00 00 01 00 02 c0 c9 15 00 00 00 01 00 02 c1 01 15 01 00 00 01 00 02 c2 d5 15 00 00 00 01 00 02 c3 01 15 00 00 00 01 00 02 c4 e1 15 00 00 00 01 00 02 c5 01 15 00 00 00 01 00 02 c6 f7 15 00 00 00 01 00 02 c7 02 15 00 00 00 01 00 02 c8 05 15 00 00 00 01 00 02 c9 02 15 00 00 00 01 00 02 ca 24 15 00 00 00 01 00 02 cb 02 15 00 00 00 01 00 02 cc 48 15 00 00 00 01 00 02 cd 02 15 00 00 00 01 00 02 ce 49 15 00 00 00 01 00 02 cf 02 15 00 00 00 01 00 02 d0 74 15 00 00 00 01 00 02 d1 02 15 00 00 00 01 00 02 d2 ae 15 00 00 00 01 00 02 d3 02 15 00 00 00 01 00 02 d4 d6 15 00 00 00 01 00 02 d5 03 15 00 00 00 01 00 02 d6 08 15 00 00 00 01 00 02 d7 03 15 00 00 00 01 00 02 d8 2a 15 00 00 00 01 00 02 d9 03 15 00 00 00 01 00 02 da 63 15 00 00 00 01 00 02 db 03 15 00 00 00 01 00 02 dc 73 15 00 00 00 01 00 02 dd 03 15 00 00 00 01 00 02 de 83 15 00 00 00 01 00 02 df 03 15 00 00 00 01 00 02 e0 93 15 00 00 00 01 00 02 e1 03 15 00 00 00 01 00 02 e2 a0 15 00 00 00 01 00 02 e3 03 15 00 00 00 01 00 02 e4 ab 15 00 00 00 01 00 02 e5 03 15 00 00 00 01 00 02 e6 b3 15 00 00 00 01 00 02 e7 03 15 00 00 00 01 00 02 e8 b6 15 00 00 00 01 00 02 e9 03 15 00 00 00 01 00 02 ea ff 15 00 00 00 01 00 02 fb 01 15 01 00 00 01 00 02 ff 10];
		qcom,mdss-dsi-dispparam-papermode3-command-state = "dsi_hs_mode";
		qcom,mdss-dsi-dispparam-papermode4-command = [15 00 00 00 01 00 02 ff 20 15 00 00 00 01 00 02 fb 01 15 00 00 00 01 00 02 75 01 15 00 00 00 01 00 02 76 4f 15 00 00 00 01 00 02 77 01 15 00 00 00 01 00 02 78 52 15 00 00 00 01 00 02 79 01 15 00 00 00 01 00 02 7a 58 15 00 00 00 01 00 02 7b 01 15 00 00 00 01 00 02 7c 5e 15 00 00 00 01 00 02 7d 01 15 00 00 00 01 00 02 7e 64 15 00 00 00 01 00 02 7f 01 15 00 00 00 01 00 02 80 6a 15 00 00 00 01 00 02 81 01 15 00 00 00 01 00 02 82 6f 15 00 00 00 01 00 02 83 01 15 00 00 00 01 00 02 84 75 15 00 00 00 01 00 02 85 01 15 00 00 00 01 00 02 86 7a 15 00 00 00 01 00 02 87 01 15 00 00 00 01 00 02 88 8e 15 00 00 00 01 00 02 89 01 15 00 00 00 01 00 02 8a a0 15 00 00 00 01 00 02 8b 01 15 00 00 00 01 00 02 8c c0 15 00 00 00 01 00 02 8d 01 15 00 00 00 01 00 02 8e de 15 00 00 00 01 00 02 8f 02 15 00 00 00 01 00 02 90 08 15 00 00 00 01 00 02 91 02 15 00 00 00 01 00 02 92 2e 15 00 00 00 01 00 02 93 02 15 00 00 00 01 00 02 94 2f 15 00 00 00 01 00 02 95 02 15 00 00 00 01 00 02 96 5c 15 00 00 00 01 00 02 97 02 15 00 00 00 01 00 02 98 98 15 00 00 00 01 00 02 99 02 15 00 00 00 01 00 02 9a c1 15 01 00 00 01 00 02 9b 02 15 00 00 00 01 00 02 9c f7 15 00 00 00 01 00 02 9d 03 15 00 00 00 01 00 02 9e 15 15 00 00 00 01 00 02 9f 03 15 00 00 00 01 00 02 a0 4b 15 00 00 00 01 00 02 a2 03 15 00 00 00 01 00 02 a3 5d 15 00 00 00 01 00 02 a4 03 15 00 00 00 01 00 02 a5 70 15 00 00 00 01 00 02 a6 03 15 00 00 00 01 00 02 a7 84 15 00 00 00 01 00 02 a9 03 15 00 00 00 01 00 02 aa 97 15 00 00 00 01 00 02 ab 03 15 00 00 00 01 00 02 ac a7 15 00 00 00 01 00 02 ad 03 15 00 00 00 01 00 02 ae b1 15 00 00 00 01 00 02 af 03 15 00 00 00 01 00 02 b0 b6 15 00 00 00 01 00 02 b1 03 15 00 00 00 01 00 02 b2 ff 15 00 00 00 01 00 02 b3 01 15 00 00 00 01 00 02 b4 4f 15 00 00 00 01 00 02 b5 01 15 00 00 00 01 00 02 b6 52 15 00 00 00 01 00 02 b7 01 15 00 00 00 01 00 02 b8 58 15 00 00 00 01 00 02 b9 01 15 00 00 00 01 00 02 ba 5e 15 00 00 00 01 00 02 bb 01 15 00 00 00 01 00 02 bc 64 15 00 00 00 01 00 02 bd 01 15 00 00 00 01 00 02 be 6a 15 00 00 00 01 00 02 bf 01 15 00 00 00 01 00 02 c0 6f 15 00 00 00 01 00 02 c1 01 15 00 00 00 01 00 02 c2 75 15 00 00 00 01 00 02 c3 01 15 00 00 00 01 00 02 c4 7a 15 01 00 00 01 00 02 c5 01 15 00 00 00 01 00 02 c6 8e 15 00 00 00 01 00 02 c7 01 15 00 00 00 01 00 02 c8 a0 15 00 00 00 01 00 02 c9 01 15 00 00 00 01 00 02 ca c0 15 00 00 00 01 00 02 cb 01 15 00 00 00 01 00 02 cc de 15 00 00 00 01 00 02 cd 02 15 00 00 00 01 00 02 ce 08 15 00 00 00 01 00 02 cf 02 15 00 00 00 01 00 02 d0 2e 15 00 00 00 01 00 02 d1 02 15 00 00 00 01 00 02 d2 2f 15 00 00 00 01 00 02 d3 02 15 00 00 00 01 00 02 d4 5c 15 00 00 00 01 00 02 d5 02 15 00 00 00 01 00 02 d6 98 15 00 00 00 01 00 02 d7 02 15 00 00 00 01 00 02 d8 c1 15 00 00 00 01 00 02 d9 02 15 00 00 00 01 00 02 da f7 15 00 00 00 01 00 02 db 03 15 00 00 00 01 00 02 dc 15 15 00 00 00 01 00 02 dd 03 15 00 00 00 01 00 02 de 4b 15 00 00 00 01 00 02 df 03 15 00 00 00 01 00 02 e0 5d 15 00 00 00 01 00 02 e1 03 15 00 00 00 01 00 02 e2 70 15 00 00 00 01 00 02 e3 03 15 00 00 00 01 00 02 e4 84 15 00 00 00 01 00 02 e5 03 15 00 00 00 01 00 02 e6 97 15 00 00 00 01 00 02 e7 03 15 00 00 00 01 00 02 e8 a7 15 00 00 00 01 00 02 e9 03 15 00 00 00 01 00 02 ea b1 15 00 00 00 01 00 02 eb 03 15 00 00 00 01 00 02 ec b6 15 00 00 00 01 00 02 ed 03 15 01 00 00 01 00 02 ee ff 15 00 00 00 01 00 02 ef 01 15 00 00 00 01 00 02 f0 4f 15 00 00 00 01 00 02 f1 01 15 00 00 00 01 00 02 f2 52 15 00 00 00 01 00 02 f3 01 15 00 00 00 01 00 02 f4 58 15 00 00 00 01 00 02 f5 01 15 00 00 00 01 00 02 f6 5e 15 00 00 00 01 00 02 f7 01 15 00 00 00 01 00 02 f8 64 15 00 00 00 01 00 02 f9 01 15 00 00 00 01 00 02 fa 6a 15 00 00 00 01 00 02 ff 21 15 00 00 00 01 00 02 fb 01 15 00 00 00 01 00 02 00 01 15 00 00 00 01 00 02 01 70 15 00 00 00 01 00 02 02 01 15 00 00 00 01 00 02 03 75 15 00 00 00 01 00 02 04 01 15 00 00 00 01 00 02 05 7a 15 00 00 00 01 00 02 06 01 15 00 00 00 01 00 02 07 8e 15 00 00 00 01 00 02 08 01 15 00 00 00 01 00 02 09 a0 15 00 00 00 01 00 02 0a 01 15 00 00 00 01 00 02 0b c0 15 00 00 00 01 00 02 0c 01 15 00 00 00 01 00 02 0d de 15 00 00 00 01 00 02 0e 02 15 00 00 00 01 00 02 0f 09 15 00 00 00 01 00 02 10 02 15 00 00 00 01 00 02 11 2e 15 00 00 00 01 00 02 12 02 15 00 00 00 01 00 02 13 30 15 00 00 00 01 00 02 14 02 15 00 00 00 01 00 02 15 5d 15 00 00 00 01 00 02 16 02 15 00 00 00 01 00 02 17 99 15 01 00 00 01 00 02 18 02 15 00 00 00 01 00 02 19 c2 15 00 00 00 01 00 02 1a 02 15 00 00 00 01 00 02 1b f6 15 00 00 00 01 00 02 1c 03 15 00 00 00 01 00 02 1d 13 15 00 00 00 01 00 02 1e 03 15 00 00 00 01 00 02 1f 44 15 00 00 00 01 00 02 20 03 15 00 00 00 01 00 02 21 54 15 00 00 00 01 00 02 22 03 15 00 00 00 01 00 02 23 65 15 00 00 00 01 00 02 24 03 15 00 00 00 01 00 02 25 78 15 00 00 00 01 00 02 26 03 15 00 00 00 01 00 02 27 8e 15 00 00 00 01 00 02 28 03 15 00 00 00 01 00 02 29 a6 15 00 00 00 01 00 02 2a 03 15 00 00 00 01 00 02 2b be 15 00 00 00 01 00 02 2d 03 15 00 00 00 01 00 02 2f cb 15 00 00 00 01 00 02 30 03 15 00 00 00 01 00 02 31 ff 15 00 00 00 01 00 02 32 01 15 00 00 00 01 00 02 33 4f 15 00 00 00 01 00 02 34 01 15 00 00 00 01 00 02 35 52 15 00 00 00 01 00 02 36 01 15 00 00 00 01 00 02 37 58 15 00 00 00 01 00 02 38 01 15 00 00 00 01 00 02 39 5e 15 00 00 00 01 00 02 3a 01 15 00 00 00 01 00 02 3b 64 15 00 00 00 01 00 02 3d 01 15 00 00 00 01 00 02 3f 6a 15 00 00 00 01 00 02 40 01 15 00 00 00 01 00 02 41 70 15 00 00 00 01 00 02 42 01 15 00 00 00 01 00 02 43 75 15 01 00 00 01 00 02 44 01 15 00 00 00 01 00 02 45 7a 15 00 00 00 01 00 02 46 01 15 00 00 00 01 00 02 47 8e 15 00 00 00 01 00 02 48 01 15 00 00 00 01 00 02 49 a0 15 00 00 00 01 00 02 4a 01 15 00 00 00 01 00 02 4b c0 15 00 00 00 01 00 02 4c 01 15 00 00 00 01 00 02 4d de 15 00 00 00 01 00 02 4e 02 15 00 00 00 01 00 02 4f 09 15 00 00 00 01 00 02 50 02 15 00 00 00 01 00 02 51 2e 15 00 00 00 01 00 02 52 02 15 00 00 00 01 00 02 53 30 15 00 00 00 01 00 02 54 02 15 00 00 00 01 00 02 55 5d 15 00 00 00 01 00 02 56 02 15 00 00 00 01 00 02 58 99 15 00 00 00 01 00 02 59 02 15 00 00 00 01 00 02 5a c2 15 00 00 00 01 00 02 5b 02 15 00 00 00 01 00 02 5c f6 15 00 00 00 01 00 02 5d 03 15 00 00 00 01 00 02 5e 13 15 00 00 00 01 00 02 5f 03 15 00 00 00 01 00 02 60 44 15 00 00 00 01 00 02 61 03 15 00 00 00 01 00 02 62 54 15 00 00 00 01 00 02 63 03 15 00 00 00 01 00 02 64 65 15 00 00 00 01 00 02 65 03 15 00 00 00 01 00 02 66 78 15 00 00 00 01 00 02 67 03 15 00 00 00 01 00 02 68 8e 15 00 00 00 01 00 02 69 03 15 00 00 00 01 00 02 6a a6 15 00 00 00 01 00 02 6b 03 15 00 00 00 01 00 02 6c be 15 01 00 00 01 00 02 6d 03 15 00 00 00 01 00 02 6e cb 15 00 00 00 01 00 02 6f 03 15 00 00 00 01 00 02 70 ff 15 00 00 00 01 00 02 71 01 15 00 00 00 01 00 02 72 d2 15 00 00 00 01 00 02 73 01 15 00 00 00 01 00 02 74 d3 15 00 00 00 01 00 02 75 01 15 00 00 00 01 00 02 76 d6 15 00 00 00 01 00 02 77 01 15 00 00 00 01 00 02 78 d9 15 00 00 00 01 00 02 79 01 15 00 00 00 01 00 02 7a dc 15 00 00 00 01 00 02 7b 01 15 00 00 00 01 00 02 7c df 15 00 00 00 01 00 02 7d 01 15 00 00 00 01 00 02 7e e1 15 00 00 00 01 00 02 7f 01 15 00 00 00 01 00 02 80 e4 15 00 00 00 01 00 02 81 01 15 00 00 00 01 00 02 82 e7 15 00 00 00 01 00 02 83 01 15 00 00 00 01 00 02 84 f2 15 00 00 00 01 00 02 85 01 15 00 00 00 01 00 02 86 f9 15 00 00 00 01 00 02 87 02 15 00 00 00 01 00 02 88 06 15 00 00 00 01 00 02 89 02 15 00 00 00 01 00 02 8a 14 15 00 00 00 01 00 02 8b 02 15 00 00 00 01 00 02 8c 32 15 00 00 00 01 00 02 8d 02 15 00 00 00 01 00 02 8e 55 15 00 00 00 01 00 02 8f 02 15 00 00 00 01 00 02 90 56 15 00 00 00 01 00 02 91 02 15 00 00 00 01 00 02 92 80 15 00 00 00 01 00 02 93 02 15 00 00 00 01 00 02 94 ba 15 00 00 00 01 00 02 95 02 15 01 00 00 01 00 02 96 e1 15 00 00 00 01 00 02 97 03 15 00 00 00 01 00 02 98 10 15 00 00 00 01 00 02 99 03 15 00 00 00 01 00 02 9a 36 15 00 00 00 01 00 02 9b 03 15 00 00 00 01 00 02 9c 6d 15 00 00 00 01 00 02 9d 03 15 00 00 00 01 00 02 9e 7c 15 00 00 00 01 00 02 9f 03 15 00 00 00 01 00 02 a0 8a 15 00 00 00 01 00 02 a2 03 15 00 00 00 01 00 02 a3 98 15 00 00 00 01 00 02 a4 03 15 00 00 00 01 00 02 a5 a4 15 00 00 00 01 00 02 a6 03 15 00 00 00 01 00 02 a7 ad 15 00 00 00 01 00 02 a9 03 15 00 00 00 01 00 02 aa b3 15 00 00 00 01 00 02 ab 03 15 00 00 00 01 00 02 ac b6 15 00 00 00 01 00 02 ad 03 15 00 00 00 01 00 02 ae ff 15 00 00 00 01 00 02 af 01 15 00 00 00 01 00 02 b0 d2 15 00 00 00 01 00 02 b1 01 15 00 00 00 01 00 02 b2 d3 15 00 00 00 01 00 02 b3 01 15 00 00 00 01 00 02 b4 d6 15 00 00 00 01 00 02 b5 01 15 00 00 00 01 00 02 b6 d9 15 00 00 00 01 00 02 b7 01 15 00 00 00 01 00 02 b8 dc 15 00 00 00 01 00 02 b9 01 15 00 00 00 01 00 02 ba df 15 00 00 00 01 00 02 bb 01 15 00 00 00 01 00 02 bc e1 15 00 00 00 01 00 02 bd 01 15 00 00 00 01 00 02 be e4 15 00 00 00 01 00 02 bf 01 15 00 00 00 01 00 02 c0 e7 15 01 00 00 01 00 02 c1 01 15 00 00 00 01 00 02 c2 f2 15 00 00 00 01 00 02 c3 01 15 00 00 00 01 00 02 c4 f9 15 00 00 00 01 00 02 c5 02 15 00 00 00 01 00 02 c6 06 15 00 00 00 01 00 02 c7 02 15 00 00 00 01 00 02 c8 14 15 00 00 00 01 00 02 c9 02 15 00 00 00 01 00 02 ca 32 15 00 00 00 01 00 02 cb 02 15 00 00 00 01 00 02 cc 55 15 00 00 00 01 00 02 cd 02 15 00 00 00 01 00 02 ce 56 15 00 00 00 01 00 02 cf 02 15 00 00 00 01 00 02 d0 80 15 00 00 00 01 00 02 d1 02 15 00 00 00 01 00 02 d2 ba 15 00 00 00 01 00 02 d3 02 15 00 00 00 01 00 02 d4 e1 15 00 00 00 01 00 02 d5 03 15 00 00 00 01 00 02 d6 10 15 00 00 00 01 00 02 d7 03 15 00 00 00 01 00 02 d8 36 15 00 00 00 01 00 02 d9 03 15 00 00 00 01 00 02 da 6d 15 00 00 00 01 00 02 db 03 15 00 00 00 01 00 02 dc 7c 15 00 00 00 01 00 02 dd 03 15 00 00 00 01 00 02 de 8a 15 00 00 00 01 00 02 df 03 15 00 00 00 01 00 02 e0 98 15 00 00 00 01 00 02 e1 03 15 00 00 00 01 00 02 e2 a4 15 00 00 00 01 00 02 e3 03 15 00 00 00 01 00 02 e4 ad 15 00 00 00 01 00 02 e5 03 15 00 00 00 01 00 02 e6 b3 15 00 00 00 01 00 02 e7 03 15 00 00 00 01 00 02 e8 b6 15 00 00 00 01 00 02 e9 03 15 00 00 00 01 00 02 ea ff 15 00 00 00 01 00 02 fb 01 15 01 00 00 01 00 02 ff 10];
		qcom,mdss-dsi-dispparam-papermode4-command-state = "dsi_hs_mode";
		qcom,mdss-dsi-dispparam-papermode5-command = [15 00 00 00 01 00 02 ff 20 15 00 00 00 01 00 02 fb 01 15 00 00 00 01 00 02 75 01 15 00 00 00 01 00 02 76 5f 15 00 00 00 01 00 02 77 01 15 00 00 00 01 00 02 78 62 15 00 00 00 01 00 02 79 01 15 00 00 00 01 00 02 7a 68 15 00 00 00 01 00 02 7b 01 15 00 00 00 01 00 02 7c 6d 15 00 00 00 01 00 02 7d 01 15 00 00 00 01 00 02 7e 72 15 00 00 00 01 00 02 7f 01 15 00 00 00 01 00 02 80 77 15 00 00 00 01 00 02 81 01 15 00 00 00 01 00 02 82 7d 15 00 00 00 01 00 02 83 01 15 00 00 00 01 00 02 84 81 15 00 00 00 01 00 02 85 01 15 00 00 00 01 00 02 86 86 15 00 00 00 01 00 02 87 01 15 00 00 00 01 00 02 88 99 15 00 00 00 01 00 02 89 01 15 00 00 00 01 00 02 8a a9 15 00 00 00 01 00 02 8b 01 15 00 00 00 01 00 02 8c c8 15 00 00 00 01 00 02 8d 01 15 00 00 00 01 00 02 8e e5 15 00 00 00 01 00 02 8f 02 15 00 00 00 01 00 02 90 0c 15 00 00 00 01 00 02 91 02 15 00 00 00 01 00 02 92 31 15 00 00 00 01 00 02 93 02 15 00 00 00 01 00 02 94 33 15 00 00 00 01 00 02 95 02 15 00 00 00 01 00 02 96 5f 15 00 00 00 01 00 02 97 02 15 00 00 00 01 00 02 98 9b 15 00 00 00 01 00 02 99 02 15 00 00 00 01 00 02 9a c4 15 01 00 00 01 00 02 9b 02 15 00 00 00 01 00 02 9c fa 15 00 00 00 01 00 02 9d 03 15 00 00 00 01 00 02 9e 16 15 00 00 00 01 00 02 9f 03 15 00 00 00 01 00 02 a0 4e 15 00 00 00 01 00 02 a2 03 15 00 00 00 01 00 02 a3 5f 15 00 00 00 01 00 02 a4 03 15 00 00 00 01 00 02 a5 72 15 00 00 00 01 00 02 a6 03 15 00 00 00 01 00 02 a7 86 15 00 00 00 01 00 02 a9 03 15 00 00 00 01 00 02 aa 98 15 00 00 00 01 00 02 ab 03 15 00 00 00 01 00 02 ac a7 15 00 00 00 01 00 02 ad 03 15 00 00 00 01 00 02 ae b1 15 00 00 00 01 00 02 af 03 15 00 00 00 01 00 02 b0 b6 15 00 00 00 01 00 02 b1 03 15 00 00 00 01 00 02 b2 ff 15 00 00 00 01 00 02 b3 01 15 00 00 00 01 00 02 b4 5f 15 00 00 00 01 00 02 b5 01 15 00 00 00 01 00 02 b6 62 15 00 00 00 01 00 02 b7 01 15 00 00 00 01 00 02 b8 68 15 00 00 00 01 00 02 b9 01 15 00 00 00 01 00 02 ba 6d 15 00 00 00 01 00 02 bb 01 15 00 00 00 01 00 02 bc 72 15 00 00 00 01 00 02 bd 01 15 00 00 00 01 00 02 be 77 15 00 00 00 01 00 02 bf 01 15 00 00 00 01 00 02 c0 7d 15 00 00 00 01 00 02 c1 01 15 00 00 00 01 00 02 c2 81 15 00 00 00 01 00 02 c3 01 15 00 00 00 01 00 02 c4 86 15 01 00 00 01 00 02 c5 01 15 00 00 00 01 00 02 c6 99 15 00 00 00 01 00 02 c7 01 15 00 00 00 01 00 02 c8 a9 15 00 00 00 01 00 02 c9 01 15 00 00 00 01 00 02 ca c8 15 00 00 00 01 00 02 cb 01 15 00 00 00 01 00 02 cc e5 15 00 00 00 01 00 02 cd 02 15 00 00 00 01 00 02 ce 0c 15 00 00 00 01 00 02 cf 02 15 00 00 00 01 00 02 d0 31 15 00 00 00 01 00 02 d1 02 15 00 00 00 01 00 02 d2 33 15 00 00 00 01 00 02 d3 02 15 00 00 00 01 00 02 d4 5f 15 00 00 00 01 00 02 d5 02 15 00 00 00 01 00 02 d6 9b 15 00 00 00 01 00 02 d7 02 15 00 00 00 01 00 02 d8 c4 15 00 00 00 01 00 02 d9 02 15 00 00 00 01 00 02 da fa 15 00 00 00 01 00 02 db 03 15 00 00 00 01 00 02 dc 16 15 00 00 00 01 00 02 dd 03 15 00 00 00 01 00 02 de 4e 15 00 00 00 01 00 02 df 03 15 00 00 00 01 00 02 e0 5f 15 00 00 00 01 00 02 e1 03 15 00 00 00 01 00 02 e2 72 15 00 00 00 01 00 02 e3 03 15 00 00 00 01 00 02 e4 86 15 00 00 00 01 00 02 e5 03 15 00 00 00 01 00 02 e6 98 15 00 00 00 01 00 02 e7 03 15 00 00 00 01 00 02 e8 a7 15 00 00 00 01 00 02 e9 03 15 00 00 00 01 00 02 ea b1 15 00 00 00 01 00 02 eb 03 15 00 00 00 01 00 02 ec b6 15 00 00 00 01 00 02 ed 03 15 01 00 00 01 00 02 ee ff 15 00 00 00 01 00 02 ef 01 15 00 00 00 01 00 02 f0 5f 15 00 00 00 01 00 02 f1 01 15 00 00 00 01 00 02 f2 62 15 00 00 00 01 00 02 f3 01 15 00 00 00 01 00 02 f4 68 15 00 00 00 01 00 02 f5 01 15 00 00 00 01 00 02 f6 6d 15 00 00 00 01 00 02 f7 01 15 00 00 00 01 00 02 f8 72 15 00 00 00 01 00 02 f9 01 15 00 00 00 01 00 02 fa 78 15 00 00 00 01 00 02 ff 21 15 00 00 00 01 00 02 fb 01 15 00 00 00 01 00 02 00 01 15 00 00 00 01 00 02 01 7d 15 00 00 00 01 00 02 02 01 15 00 00 00 01 00 02 03 82 15 00 00 00 01 00 02 04 01 15 00 00 00 01 00 02 05 86 15 00 00 00 01 00 02 06 01 15 00 00 00 01 00 02 07 99 15 00 00 00 01 00 02 08 01 15 00 00 00 01 00 02 09 a9 15 00 00 00 01 00 02 0a 01 15 00 00 00 01 00 02 0b c8 15 00 00 00 01 00 02 0c 01 15 00 00 00 01 00 02 0d e5 15 00 00 00 01 00 02 0e 02 15 00 00 00 01 00 02 0f 0c 15 00 00 00 01 00 02 10 02 15 00 00 00 01 00 02 11 32 15 00 00 00 01 00 02 12 02 15 00 00 00 01 00 02 13 33 15 00 00 00 01 00 02 14 02 15 00 00 00 01 00 02 15 60 15 00 00 00 01 00 02 16 02 15 00 00 00 01 00 02 17 9c 15 01 00 00 01 00 02 18 02 15 00 00 00 01 00 02 19 c4 15 00 00 00 01 00 02 1a 02 15 00 00 00 01 00 02 1b f8 15 00 00 00 01 00 02 1c 03 15 00 00 00 01 00 02 1d 14 15 00 00 00 01 00 02 1e 03 15 00 00 00 01 00 02 1f 47 15 00 00 00 01 00 02 20 03 15 00 00 00 01 00 02 21 56 15 00 00 00 01 00 02 22 03 15 00 00 00 01 00 02 23 67 15 00 00 00 01 00 02 24 03 15 00 00 00 01 00 02 25 7a 15 00 00 00 01 00 02 26 03 15 00 00 00 01 00 02 27 8f 15 00 00 00 01 00 02 28 03 15 00 00 00 01 00 02 29 a8 15 00 00 00 01 00 02 2a 03 15 00 00 00 01 00 02 2b be 15 00 00 00 01 00 02 2d 03 15 00 00 00 01 00 02 2f cc 15 00 00 00 01 00 02 30 03 15 00 00 00 01 00 02 31 ff 15 00 00 00 01 00 02 32 01 15 00 00 00 01 00 02 33 5f 15 00 00 00 01 00 02 34 01 15 00 00 00 01 00 02 35 62 15 00 00 00 01 00 02 36 01 15 00 00 00 01 00 02 37 68 15 00 00 00 01 00 02 38 01 15 00 00 00 01 00 02 39 6d 15 00 00 00 01 00 02 3a 01 15 00 00 00 01 00 02 3b 72 15 00 00 00 01 00 02 3d 01 15 00 00 00 01 00 02 3f 78 15 00 00 00 01 00 02 40 01 15 00 00 00 01 00 02 41 7d 15 00 00 00 01 00 02 42 01 15 00 00 00 01 00 02 43 82 15 01 00 00 01 00 02 44 01 15 00 00 00 01 00 02 45 86 15 00 00 00 01 00 02 46 01 15 00 00 00 01 00 02 47 99 15 00 00 00 01 00 02 48 01 15 00 00 00 01 00 02 49 a9 15 00 00 00 01 00 02 4a 01 15 00 00 00 01 00 02 4b c8 15 00 00 00 01 00 02 4c 01 15 00 00 00 01 00 02 4d e5 15 00 00 00 01 00 02 4e 02 15 00 00 00 01 00 02 4f 0c 15 00 00 00 01 00 02 50 02 15 00 00 00 01 00 02 51 32 15 00 00 00 01 00 02 52 02 15 00 00 00 01 00 02 53 33 15 00 00 00 01 00 02 54 02 15 00 00 00 01 00 02 55 60 15 00 00 00 01 00 02 56 02 15 00 00 00 01 00 02 58 9c 15 00 00 00 01 00 02 59 02 15 00 00 00 01 00 02 5a c4 15 00 00 00 01 00 02 5b 02 15 00 00 00 01 00 02 5c f8 15 00 00 00 01 00 02 5d 03 15 00 00 00 01 00 02 5e 14 15 00 00 00 01 00 02 5f 03 15 00 00 00 01 00 02 60 47 15 00 00 00 01 00 02 61 03 15 00 00 00 01 00 02 62 56 15 00 00 00 01 00 02 63 03 15 00 00 00 01 00 02 64 67 15 00 00 00 01 00 02 65 03 15 00 00 00 01 00 02 66 7a 15 00 00 00 01 00 02 67 03 15 00 00 00 01 00 02 68 8f 15 00 00 00 01 00 02 69 03 15 00 00 00 01 00 02 6a a8 15 00 00 00 01 00 02 6b 03 15 00 00 00 01 00 02 6c be 15 01 00 00 01 00 02 6d 03 15 00 00 00 01 00 02 6e cc 15 00 00 00 01 00 02 6f 03 15 00 00 00 01 00 02 70 ff 15 00 00 00 01 00 02 71 01 15 00 00 00 01 00 02 72 e5 15 00 00 00 01 00 02 73 01 15 00 00 00 01 00 02 74 e6 15 00 00 00 01 00 02 75 01 15 00 00 00 01 00 02 76 e9 15 00 00 00 01 00 02 77 01 15 00 00 00 01 00 02 78 ec 15 00 00 00 01 00 02 79 01 15 00 00 00 01 00 02 7a ee 15 00 00 00 01 00 02 7b 01 15 00 00 00 01 00 02 7c f1 15 00 00 00 01 00 02 7d 01 15 00 00 00 01 00 02 7e f3 15 00 00 00 01 00 02 7f 01 15 00 00 00 01 00 02 80 f5 15 00 00 00 01 00 02 81 01 15 00 00 00 01 00 02 82 f6 15 00 00 00 01 00 02 83 01 15 00 00 00 01 00 02 84 fd 15 00 00 00 01 00 02 85 02 15 00 00 00 01 00 02 86 03 15 00 00 00 01 00 02 87 02 15 00 00 00 01 00 02 88 10 15 00 00 00 01 00 02 89 02 15 00 00 00 01 00 02 8a 1d 15 00 00 00 01 00 02 8b 02 15 00 00 00 01 00 02 8c 3b 15 00 00 00 01 00 02 8d 02 15 00 00 00 01 00 02 8e 5d 15 00 00 00 01 00 02 8f 02 15 00 00 00 01 00 02 90 5e 15 00 00 00 01 00 02 91 02 15 00 00 00 01 00 02 92 88 15 00 00 00 01 00 02 93 02 15 00 00 00 01 00 02 94 c1 15 01 00 00 01 00 02 95 02 15 00 00 00 01 00 02 96 e8 15 00 00 00 01 00 02 97 03 15 00 00 00 01 00 02 98 15 15 00 00 00 01 00 02 99 03 15 00 00 00 01 00 02 9a 3e 15 00 00 00 01 00 02 9b 03 15 00 00 00 01 00 02 9c 73 15 00 00 00 01 00 02 9d 03 15 00 00 00 01 00 02 9e 81 15 00 00 00 01 00 02 9f 03 15 00 00 00 01 00 02 a0 8e 15 00 00 00 01 00 02 a2 03 15 00 00 00 01 00 02 a3 9b 15 00 00 00 01 00 02 a4 03 15 00 00 00 01 00 02 a5 a6 15 00 00 00 01 00 02 a6 03 15 00 00 00 01 00 02 a7 ae 15 00 00 00 01 00 02 a9 03 15 00 00 00 01 00 02 aa b4 15 00 00 00 01 00 02 ab 03 15 00 00 00 01 00 02 ac b6 15 00 00 00 01 00 02 ad 03 15 00 00 00 01 00 02 ae ff 15 00 00 00 01 00 02 af 01 15 00 00 00 01 00 02 b0 e5 15 00 00 00 01 00 02 b1 01 15 00 00 00 01 00 02 b2 e6 15 00 00 00 01 00 02 b3 01 15 00 00 00 01 00 02 b4 e9 15 00 00 00 01 00 02 b5 01 15 00 00 00 01 00 02 b6 ec 15 00 00 00 01 00 02 b7 01 15 00 00 00 01 00 02 b8 ee 15 00 00 00 01 00 02 b9 01 15 00 00 00 01 00 02 ba f1 15 00 00 00 01 00 02 bb 01 15 00 00 00 01 00 02 bc f3 15 00 00 00 01 00 02 bd 01 15 00 00 00 01 00 02 be f5 15 01 00 00 01 00 02 bf 01 15 00 00 00 01 00 02 c0 f6 15 00 00 00 01 00 02 c1 01 15 00 00 00 01 00 02 c2 fd 15 00 00 00 01 00 02 c3 02 15 00 00 00 01 00 02 c4 03 15 00 00 00 01 00 02 c5 02 15 00 00 00 01 00 02 c6 10 15 00 00 00 01 00 02 c7 02 15 00 00 00 01 00 02 c8 1d 15 00 00 00 01 00 02 c9 02 15 00 00 00 01 00 02 ca 3b 15 00 00 00 01 00 02 cb 02 15 00 00 00 01 00 02 cc 5d 15 00 00 00 01 00 02 cd 02 15 00 00 00 01 00 02 ce 5e 15 00 00 00 01 00 02 cf 02 15 00 00 00 01 00 02 d0 88 15 00 00 00 01 00 02 d1 02 15 00 00 00 01 00 02 d2 c1 15 00 00 00 01 00 02 d3 02 15 00 00 00 01 00 02 d4 e8 15 00 00 00 01 00 02 d5 03 15 00 00 00 01 00 02 d6 15 15 00 00 00 01 00 02 d7 03 15 00 00 00 01 00 02 d8 3e 15 00 00 00 01 00 02 d9 03 15 00 00 00 01 00 02 da 73 15 00 00 00 01 00 02 db 03 15 00 00 00 01 00 02 dc 81 15 00 00 00 01 00 02 dd 03 15 00 00 00 01 00 02 de 8e 15 00 00 00 01 00 02 df 03 15 00 00 00 01 00 02 e0 9b 15 00 00 00 01 00 02 e1 03 15 00 00 00 01 00 02 e2 a6 15 00 00 00 01 00 02 e3 03 15 00 00 00 01 00 02 e4 ae 15 00 00 00 01 00 02 e5 03 15 00 00 00 01 00 02 e6 b4 15 00 00 00 01 00 02 e7 03 15 00 00 00 01 00 02 e8 b6 15 00 00 00 01 00 02 e9 03 15 00 00 00 01 00 02 ea ff 15 00 00 00 01 00 02 fb 01 15 01 00 00 01 00 02 ff 10];
		qcom,mdss-dsi-dispparam-papermode5-command-state = "dsi_hs_mode";
		qcom,mdss-dsi-dispparam-papermode6-command = [15 00 00 00 01 00 02 ff 20 15 00 00 00 01 00 02 fb 01 15 00 00 00 01 00 02 75 01 15 00 00 00 01 00 02 76 60 15 00 00 00 01 00 02 77 01 15 00 00 00 01 00 02 78 63 15 00 00 00 01 00 02 79 01 15 00 00 00 01 00 02 7a 68 15 00 00 00 01 00 02 7b 01 15 00 00 00 01 00 02 7c 6e 15 00 00 00 01 00 02 7d 01 15 00 00 00 01 00 02 7e 73 15 00 00 00 01 00 02 7f 01 15 00 00 00 01 00 02 80 78 15 00 00 00 01 00 02 81 01 15 00 00 00 01 00 02 82 7d 15 00 00 00 01 00 02 83 01 15 00 00 00 01 00 02 84 82 15 00 00 00 01 00 02 85 01 15 00 00 00 01 00 02 86 87 15 00 00 00 01 00 02 87 01 15 00 00 00 01 00 02 88 99 15 00 00 00 01 00 02 89 01 15 00 00 00 01 00 02 8a aa 15 00 00 00 01 00 02 8b 01 15 00 00 00 01 00 02 8c c9 15 00 00 00 01 00 02 8d 01 15 00 00 00 01 00 02 8e e5 15 00 00 00 01 00 02 8f 02 15 00 00 00 01 00 02 90 0c 15 00 00 00 01 00 02 91 02 15 00 00 00 01 00 02 92 31 15 00 00 00 01 00 02 93 02 15 00 00 00 01 00 02 94 33 15 00 00 00 01 00 02 95 02 15 00 00 00 01 00 02 96 60 15 00 00 00 01 00 02 97 02 15 00 00 00 01 00 02 98 9b 15 00 00 00 01 00 02 99 02 15 00 00 00 01 00 02 9a c4 15 00 00 00 01 00 02 9b 02 15 00 00 00 01 00 02 9c fa 15 01 00 00 01 00 02 9d 03 15 00 00 00 01 00 02 9e 17 15 00 00 00 01 00 02 9f 03 15 00 00 00 01 00 02 a0 4e 15 00 00 00 01 00 02 a2 03 15 00 00 00 01 00 02 a3 60 15 00 00 00 01 00 02 a4 03 15 00 00 00 01 00 02 a5 73 15 00 00 00 01 00 02 a6 03 15 00 00 00 01 00 02 a7 86 15 00 00 00 01 00 02 a9 03 15 00 00 00 01 00 02 aa 98 15 00 00 00 01 00 02 ab 03 15 00 00 00 01 00 02 ac a7 15 00 00 00 01 00 02 ad 03 15 00 00 00 01 00 02 ae b1 15 00 00 00 01 00 02 af 03 15 00 00 00 01 00 02 b0 b6 15 00 00 00 01 00 02 b1 03 15 00 00 00 01 00 02 b2 ff 15 00 00 00 01 00 02 b3 01 15 00 00 00 01 00 02 b4 60 15 00 00 00 01 00 02 b5 01 15 00 00 00 01 00 02 b6 63 15 00 00 00 01 00 02 b7 01 15 00 00 00 01 00 02 b8 68 15 00 00 00 01 00 02 b9 01 15 00 00 00 01 00 02 ba 6e 15 00 00 00 01 00 02 bb 01 15 00 00 00 01 00 02 bc 73 15 00 00 00 01 00 02 bd 01 15 00 00 00 01 00 02 be 78 15 00 00 00 01 00 02 bf 01 15 00 00 00 01 00 02 c0 7d 15 00 00 00 01 00 02 c1 01 15 00 00 00 01 00 02 c2 82 15 00 00 00 01 00 02 c3 01 15 00 00 00 01 00 02 c4 87 15 00 00 00 01 00 02 c5 01 15 00 00 00 01 00 02 c6 99 15 00 00 00 01 00 02 c7 01 15 01 00 00 01 00 02 c8 aa 15 00 00 00 01 00 02 c9 01 15 00 00 00 01 00 02 ca c9 15 00 00 00 01 00 02 cb 01 15 00 00 00 01 00 02 cc e5 15 00 00 00 01 00 02 cd 02 15 00 00 00 01 00 02 ce 0c 15 00 00 00 01 00 02 cf 02 15 00 00 00 01 00 02 d0 31 15 00 00 00 01 00 02 d1 02 15 00 00 00 01 00 02 d2 33 15 00 00 00 01 00 02 d3 02 15 00 00 00 01 00 02 d4 60 15 00 00 00 01 00 02 d5 02 15 00 00 00 01 00 02 d6 9b 15 00 00 00 01 00 02 d7 02 15 00 00 00 01 00 02 d8 c4 15 00 00 00 01 00 02 d9 02 15 00 00 00 01 00 02 da fa 15 00 00 00 01 00 02 db 03 15 00 00 00 01 00 02 dc 17 15 00 00 00 01 00 02 dd 03 15 00 00 00 01 00 02 de 4e 15 00 00 00 01 00 02 df 03 15 00 00 00 01 00 02 e0 60 15 00 00 00 01 00 02 e1 03 15 00 00 00 01 00 02 e2 73 15 00 00 00 01 00 02 e3 03 15 00 00 00 01 00 02 e4 86 15 00 00 00 01 00 02 e5 03 15 00 00 00 01 00 02 e6 98 15 00 00 00 01 00 02 e7 03 15 00 00 00 01 00 02 e8 a7 15 00 00 00 01 00 02 e9 03 15 00 00 00 01 00 02 ea b1 15 00 00 00 01 00 02 eb 03 15 00 00 00 01 00 02 ec b6 15 00 00 00 01 00 02 ed 03 15 00 00 00 01 00 02 ee ff 15 00 00 00 01 00 02 ef 01 15 00 00 00 01 00 02 f0 6a 15 01 00 00 01 00 02 f1 01 15 00 00 00 01 00 02 f2 6d 15 00 00 00 01 00 02 f3 01 15 00 00 00 01 00 02 f4 72 15 00 00 00 01 00 02 f5 01 15 00 00 00 01 00 02 f6 77 15 00 00 00 01 00 02 f7 01 15 00 00 00 01 00 02 f8 7c 15 00 00 00 01 00 02 f9 01 15 00 00 00 01 00 02 fa 81 15 00 00 00 01 00 02 ff 21 15 00 00 00 01 00 02 fb 01 15 00 00 00 01 00 02 00 01 15 00 00 00 01 00 02 01 86 15 00 00 00 01 00 02 02 01 15 00 00 00 01 00 02 03 8a 15 00 00 00 01 00 02 04 01 15 00 00 00 01 00 02 05 8f 15 00 00 00 01 00 02 06 01 15 00 00 00 01 00 02 07 a0 15 00 00 00 01 00 02 08 01 15 00 00 00 01 00 02 09 b0 15 00 00 00 01 00 02 0a 01 15 00 00 00 01 00 02 0b ce 15 00 00 00 01 00 02 0c 01 15 00 00 00 01 00 02 0d ea 15 00 00 00 01 00 02 0e 02 15 00 00 00 01 00 02 0f 0f 15 00 00 00 01 00 02 10 02 15 00 00 00 01 00 02 11 34 15 00 00 00 01 00 02 12 02 15 00 00 00 01 00 02 13 35 15 00 00 00 01 00 02 14 02 15 00 00 00 01 00 02 15 62 15 00 00 00 01 00 02 16 02 15 00 00 00 01 00 02 17 9e 15 00 00 00 01 00 02 18 02 15 00 00 00 01 00 02 19 c6 15 00 00 00 01 00 02 1a 02 15 01 00 00 01 00 02 1b fa 15 00 00 00 01 00 02 1c 03 15 00 00 00 01 00 02 1d 16 15 00 00 00 01 00 02 1e 03 15 00 00 00 01 00 02 1f 48 15 00 00 00 01 00 02 20 03 15 00 00 00 01 00 02 21 57 15 00 00 00 01 00 02 22 03 15 00 00 00 01 00 02 23 68 15 00 00 00 01 00 02 24 03 15 00 00 00 01 00 02 25 7b 15 00 00 00 01 00 02 26 03 15 00 00 00 01 00 02 27 91 15 00 00 00 01 00 02 28 03 15 00 00 00 01 00 02 29 a9 15 00 00 00 01 00 02 2a 03 15 00 00 00 01 00 02 2b bf 15 00 00 00 01 00 02 2d 03 15 00 00 00 01 00 02 2f cc 15 00 00 00 01 00 02 30 03 15 00 00 00 01 00 02 31 ff 15 00 00 00 01 00 02 32 01 15 00 00 00 01 00 02 33 6a 15 00 00 00 01 00 02 34 01 15 00 00 00 01 00 02 35 6d 15 00 00 00 01 00 02 36 01 15 00 00 00 01 00 02 37 72 15 00 00 00 01 00 02 38 01 15 00 00 00 01 00 02 39 77 15 00 00 00 01 00 02 3a 01 15 00 00 00 01 00 02 3b 7c 15 00 00 00 01 00 02 3d 01 15 00 00 00 01 00 02 3f 81 15 00 00 00 01 00 02 40 01 15 00 00 00 01 00 02 41 86 15 00 00 00 01 00 02 42 01 15 00 00 00 01 00 02 43 8a 15 00 00 00 01 00 02 44 01 15 00 00 00 01 00 02 45 8f 15 00 00 00 01 00 02 46 01 15 00 00 00 01 00 02 47 a0 15 01 00 00 01 00 02 48 01 15 00 00 00 01 00 02 49 b0 15 00 00 00 01 00 02 4a 01 15 00 00 00 01 00 02 4b ce 15 00 00 00 01 00 02 4c 01 15 00 00 00 01 00 02 4d ea 15 00 00 00 01 00 02 4e 02 15 00 00 00 01 00 02 4f 0f 15 00 00 00 01 00 02 50 02 15 00 00 00 01 00 02 51 34 15 00 00 00 01 00 02 52 02 15 00 00 00 01 00 02 53 35 15 00 00 00 01 00 02 54 02 15 00 00 00 01 00 02 55 62 15 00 00 00 01 00 02 56 02 15 00 00 00 01 00 02 58 9e 15 00 00 00 01 00 02 59 02 15 00 00 00 01 00 02 5a c6 15 00 00 00 01 00 02 5b 02 15 00 00 00 01 00 02 5c fa 15 00 00 00 01 00 02 5d 03 15 00 00 00 01 00 02 5e 16 15 00 00 00 01 00 02 5f 03 15 00 00 00 01 00 02 60 48 15 00 00 00 01 00 02 61 03 15 00 00 00 01 00 02 62 57 15 00 00 00 01 00 02 63 03 15 00 00 00 01 00 02 64 68 15 00 00 00 01 00 02 65 03 15 00 00 00 01 00 02 66 7b 15 00 00 00 01 00 02 67 03 15 00 00 00 01 00 02 68 91 15 00 00 00 01 00 02 69 03 15 00 00 00 01 00 02 6a a9 15 00 00 00 01 00 02 6b 03 15 00 00 00 01 00 02 6c bf 15 00 00 00 01 00 02 6d 03 15 00 00 00 01 00 02 6e cc 15 00 00 00 01 00 02 6f 03 15 00 00 00 01 00 02 70 ff 15 01 00 00 01 00 02 71 01 15 00 00 00 01 00 02 72 f4 15 00 00 00 01 00 02 73 01 15 00 00 00 01 00 02 74 f5 15 00 00 00 01 00 02 75 01 15 00 00 00 01 00 02 76 f6 15 00 00 00 01 00 02 77 01 15 00 00 00 01 00 02 78 f7 15 00 00 00 01 00 02 79 01 15 00 00 00 01 00 02 7a f8 15 00 00 00 01 00 02 7b 01 15 00 00 00 01 00 02 7c f9 15 00 00 00 01 00 02 7d 01 15 00 00 00 01 00 02 7e fa 15 00 00 00 01 00 02 7f 01 15 00 00 00 01 00 02 80 fc 15 00 00 00 01 00 02 81 01 15 00 00 00 01 00 02 82 fd 15 00 00 00 01 00 02 83 02 15 00 00 00 01 00 02 84 03 15 00 00 00 01 00 02 85 02 15 00 00 00 01 00 02 86 09 15 00 00 00 01 00 02 87 02 15 00 00 00 01 00 02 88 16 15 00 00 00 01 00 02 89 02 15 00 00 00 01 00 02 8a 23 15 00 00 00 01 00 02 8b 02 15 00 00 00 01 00 02 8c 41 15 00 00 00 01 00 02 8d 02 15 00 00 00 01 00 02 8e 62 15 00 00 00 01 00 02 8f 02 15 00 00 00 01 00 02 90 64 15 00 00 00 01 00 02 91 02 15 00 00 00 01 00 02 92 8d 15 00 00 00 01 00 02 93 02 15 00 00 00 01 00 02 94 c6 15 00 00 00 01 00 02 95 02 15 00 00 00 01 00 02 96 ec 15 00 00 00 01 00 02 97 03 15 00 00 00 01 00 02 98 18 15 00 00 00 01 00 02 99 03 15 00 00 00 01 00 02 9a 43 15 01 00 00 01 00 02 9b 03 15 00 00 00 01 00 02 9c 77 15 00 00 00 01 00 02 9d 03 15 00 00 00 01 00 02 9e 84 15 00 00 00 01 00 02 9f 03 15 00 00 00 01 00 02 a0 91 15 00 00 00 01 00 02 a2 03 15 00 00 00 01 00 02 a3 9d 15 00 00 00 01 00 02 a4 03 15 00 00 00 01 00 02 a5 a7 15 00 00 00 01 00 02 a6 03 15 00 00 00 01 00 02 a7 af 15 00 00 00 01 00 02 a9 03 15 00 00 00 01 00 02 aa b4 15 00 00 00 01 00 02 ab 03 15 00 00 00 01 00 02 ac b6 15 00 00 00 01 00 02 ad 03 15 00 00 00 01 00 02 ae ff 15 00 00 00 01 00 02 af 01 15 00 00 00 01 00 02 b0 f4 15 00 00 00 01 00 02 b1 01 15 00 00 00 01 00 02 b2 f5 15 00 00 00 01 00 02 b3 01 15 00 00 00 01 00 02 b4 f6 15 00 00 00 01 00 02 b5 01 15 00 00 00 01 00 02 b6 f7 15 00 00 00 01 00 02 b7 01 15 00 00 00 01 00 02 b8 f8 15 00 00 00 01 00 02 b9 01 15 00 00 00 01 00 02 ba f9 15 00 00 00 01 00 02 bb 01 15 00 00 00 01 00 02 bc fa 15 00 00 00 01 00 02 bd 01 15 00 00 00 01 00 02 be fc 15 00 00 00 01 00 02 bf 01 15 00 00 00 01 00 02 c0 fd 15 00 00 00 01 00 02 c1 02 15 00 00 00 01 00 02 c2 03 15 00 00 00 01 00 02 c3 02 15 00 00 00 01 00 02 c4 09 15 00 00 00 01 00 02 c5 02 15 01 00 00 01 00 02 c6 16 15 00 00 00 01 00 02 c7 02 15 00 00 00 01 00 02 c8 23 15 00 00 00 01 00 02 c9 02 15 00 00 00 01 00 02 ca 41 15 00 00 00 01 00 02 cb 02 15 00 00 00 01 00 02 cc 62 15 00 00 00 01 00 02 cd 02 15 00 00 00 01 00 02 ce 64 15 00 00 00 01 00 02 cf 02 15 00 00 00 01 00 02 d0 8d 15 00 00 00 01 00 02 d1 02 15 00 00 00 01 00 02 d2 c6 15 00 00 00 01 00 02 d3 02 15 00 00 00 01 00 02 d4 ec 15 00 00 00 01 00 02 d5 03 15 00 00 00 01 00 02 d6 18 15 00 00 00 01 00 02 d7 03 15 00 00 00 01 00 02 d8 43 15 00 00 00 01 00 02 d9 03 15 00 00 00 01 00 02 da 77 15 00 00 00 01 00 02 db 03 15 00 00 00 01 00 02 dc 84 15 00 00 00 01 00 02 dd 03 15 00 00 00 01 00 02 de 91 15 00 00 00 01 00 02 df 03 15 00 00 00 01 00 02 e0 9d 15 00 00 00 01 00 02 e1 03 15 00 00 00 01 00 02 e2 a7 15 00 00 00 01 00 02 e3 03 15 00 00 00 01 00 02 e4 af 15 00 00 00 01 00 02 e5 03 15 00 00 00 01 00 02 e6 b4 15 00 00 00 01 00 02 e7 03 15 00 00 00 01 00 02 e8 b6 15 00 00 00 01 00 02 e9 03 15 00 00 00 01 00 02 ea ff 15 00 00 00 01 00 02 fb 01 15 01 00 00 01 00 02 ff 10];
		qcom,mdss-dsi-dispparam-papermode6-command-state = "dsi_hs_mode";
		qcom,mdss-dsi-dispparam-papermode7-command = [15 00 00 00 01 00 02 ff 20 15 00 00 00 01 00 02 fb 01 15 00 00 00 01 00 02 75 01 15 00 00 00 01 00 02 76 60 15 00 00 00 01 00 02 77 01 15 00 00 00 01 00 02 78 63 15 00 00 00 01 00 02 79 01 15 00 00 00 01 00 02 7a 68 15 00 00 00 01 00 02 7b 01 15 00 00 00 01 00 02 7c 6e 15 00 00 00 01 00 02 7d 01 15 00 00 00 01 00 02 7e 73 15 00 00 00 01 00 02 7f 01 15 00 00 00 01 00 02 80 78 15 00 00 00 01 00 02 81 01 15 00 00 00 01 00 02 82 7d 15 00 00 00 01 00 02 83 01 15 00 00 00 01 00 02 84 82 15 00 00 00 01 00 02 85 01 15 00 00 00 01 00 02 86 87 15 00 00 00 01 00 02 87 01 15 00 00 00 01 00 02 88 99 15 00 00 00 01 00 02 89 01 15 00 00 00 01 00 02 8a aa 15 00 00 00 01 00 02 8b 01 15 00 00 00 01 00 02 8c c9 15 00 00 00 01 00 02 8d 01 15 00 00 00 01 00 02 8e e5 15 00 00 00 01 00 02 8f 02 15 00 00 00 01 00 02 90 0c 15 00 00 00 01 00 02 91 02 15 00 00 00 01 00 02 92 31 15 00 00 00 01 00 02 93 02 15 00 00 00 01 00 02 94 33 15 00 00 00 01 00 02 95 02 15 00 00 00 01 00 02 96 60 15 00 00 00 01 00 02 97 02 15 00 00 00 01 00 02 98 9b 15 00 00 00 01 00 02 99 02 15 00 00 00 01 00 02 9a c4 15 01 00 00 01 00 02 9b 02 15 00 00 00 01 00 02 9c fa 15 00 00 00 01 00 02 9d 03 15 00 00 00 01 00 02 9e 17 15 00 00 00 01 00 02 9f 03 15 00 00 00 01 00 02 a0 4e 15 00 00 00 01 00 02 a2 03 15 00 00 00 01 00 02 a3 60 15 00 00 00 01 00 02 a4 03 15 00 00 00 01 00 02 a5 73 15 00 00 00 01 00 02 a6 03 15 00 00 00 01 00 02 a7 86 15 00 00 00 01 00 02 a9 03 15 00 00 00 01 00 02 aa 98 15 00 00 00 01 00 02 ab 03 15 00 00 00 01 00 02 ac a7 15 00 00 00 01 00 02 ad 03 15 00 00 00 01 00 02 ae b1 15 00 00 00 01 00 02 af 03 15 00 00 00 01 00 02 b0 b6 15 00 00 00 01 00 02 b1 03 15 00 00 00 01 00 02 b2 ff 15 00 00 00 01 00 02 b3 01 15 00 00 00 01 00 02 b4 60 15 00 00 00 01 00 02 b5 01 15 00 00 00 01 00 02 b6 63 15 00 00 00 01 00 02 b7 01 15 00 00 00 01 00 02 b8 68 15 00 00 00 01 00 02 b9 01 15 00 00 00 01 00 02 ba 6e 15 00 00 00 01 00 02 bb 01 15 00 00 00 01 00 02 bc 73 15 00 00 00 01 00 02 bd 01 15 00 00 00 01 00 02 be 78 15 00 00 00 01 00 02 bf 01 15 00 00 00 01 00 02 c0 7d 15 00 00 00 01 00 02 c1 01 15 00 00 00 01 00 02 c2 82 15 00 00 00 01 00 02 c3 01 15 00 00 00 01 00 02 c4 87 15 01 00 00 01 00 02 c5 01 15 00 00 00 01 00 02 c6 99 15 00 00 00 01 00 02 c7 01 15 00 00 00 01 00 02 c8 aa 15 00 00 00 01 00 02 c9 01 15 00 00 00 01 00 02 ca c9 15 00 00 00 01 00 02 cb 01 15 00 00 00 01 00 02 cc e5 15 00 00 00 01 00 02 cd 02 15 00 00 00 01 00 02 ce 0c 15 00 00 00 01 00 02 cf 02 15 00 00 00 01 00 02 d0 31 15 00 00 00 01 00 02 d1 02 15 00 00 00 01 00 02 d2 33 15 00 00 00 01 00 02 d3 02 15 00 00 00 01 00 02 d4 60 15 00 00 00 01 00 02 d5 02 15 00 00 00 01 00 02 d6 9b 15 00 00 00 01 00 02 d7 02 15 00 00 00 01 00 02 d8 c4 15 00 00 00 01 00 02 d9 02 15 00 00 00 01 00 02 da fa 15 00 00 00 01 00 02 db 03 15 00 00 00 01 00 02 dc 17 15 00 00 00 01 00 02 dd 03 15 00 00 00 01 00 02 de 4e 15 00 00 00 01 00 02 df 03 15 00 00 00 01 00 02 e0 60 15 00 00 00 01 00 02 e1 03 15 00 00 00 01 00 02 e2 73 15 00 00 00 01 00 02 e3 03 15 00 00 00 01 00 02 e4 86 15 00 00 00 01 00 02 e5 03 15 00 00 00 01 00 02 e6 98 15 00 00 00 01 00 02 e7 03 15 00 00 00 01 00 02 e8 a7 15 00 00 00 01 00 02 e9 03 15 00 00 00 01 00 02 ea b1 15 00 00 00 01 00 02 eb 03 15 00 00 00 01 00 02 ec b6 15 00 00 00 01 00 02 ed 03 15 01 00 00 01 00 02 ee ff 15 00 00 00 01 00 02 ef 01 15 00 00 00 01 00 02 f0 6a 15 00 00 00 01 00 02 f1 01 15 00 00 00 01 00 02 f2 6d 15 00 00 00 01 00 02 f3 01 15 00 00 00 01 00 02 f4 72 15 00 00 00 01 00 02 f5 01 15 00 00 00 01 00 02 f6 77 15 00 00 00 01 00 02 f7 01 15 00 00 00 01 00 02 f8 7c 15 00 00 00 01 00 02 f9 01 15 00 00 00 01 00 02 fa 81 15 00 00 00 01 00 02 ff 21 15 00 00 00 01 00 02 fb 01 15 00 00 00 01 00 02 00 01 15 00 00 00 01 00 02 01 86 15 00 00 00 01 00 02 02 01 15 00 00 00 01 00 02 03 8a 15 00 00 00 01 00 02 04 01 15 00 00 00 01 00 02 05 8f 15 00 00 00 01 00 02 06 01 15 00 00 00 01 00 02 07 a0 15 00 00 00 01 00 02 08 01 15 00 00 00 01 00 02 09 b0 15 00 00 00 01 00 02 0a 01 15 00 00 00 01 00 02 0b ce 15 00 00 00 01 00 02 0c 01 15 00 00 00 01 00 02 0d ea 15 00 00 00 01 00 02 0e 02 15 00 00 00 01 00 02 0f 0f 15 00 00 00 01 00 02 10 02 15 00 00 00 01 00 02 11 34 15 00 00 00 01 00 02 12 02 15 00 00 00 01 00 02 13 35 15 00 00 00 01 00 02 14 02 15 00 00 00 01 00 02 15 62 15 00 00 00 01 00 02 16 02 15 00 00 00 01 00 02 17 9e 15 00 00 00 01 00 02 18 02 15 00 00 00 01 00 02 19 c6 15 01 00 00 01 00 02 1a 02 15 00 00 00 01 00 02 1b fa 15 00 00 00 01 00 02 1c 03 15 00 00 00 01 00 02 1d 16 15 00 00 00 01 00 02 1e 03 15 00 00 00 01 00 02 1f 48 15 00 00 00 01 00 02 20 03 15 00 00 00 01 00 02 21 57 15 00 00 00 01 00 02 22 03 15 00 00 00 01 00 02 23 68 15 00 00 00 01 00 02 24 03 15 00 00 00 01 00 02 25 7b 15 00 00 00 01 00 02 26 03 15 00 00 00 01 00 02 27 91 15 00 00 00 01 00 02 28 03 15 00 00 00 01 00 02 29 a9 15 00 00 00 01 00 02 2a 03 15 00 00 00 01 00 02 2b bf 15 00 00 00 01 00 02 2d 03 15 00 00 00 01 00 02 2f cc 15 00 00 00 01 00 02 30 03 15 00 00 00 01 00 02 31 ff 15 00 00 00 01 00 02 32 01 15 00 00 00 01 00 02 33 6a 15 00 00 00 01 00 02 34 01 15 00 00 00 01 00 02 35 6d 15 00 00 00 01 00 02 36 01 15 00 00 00 01 00 02 37 72 15 00 00 00 01 00 02 38 01 15 00 00 00 01 00 02 39 77 15 00 00 00 01 00 02 3a 01 15 00 00 00 01 00 02 3b 7c 15 00 00 00 01 00 02 3d 01 15 00 00 00 01 00 02 3f 81 15 00 00 00 01 00 02 40 01 15 00 00 00 01 00 02 41 86 15 00 00 00 01 00 02 42 01 15 00 00 00 01 00 02 43 8a 15 00 00 00 01 00 02 44 01 15 00 00 00 01 00 02 45 8f 15 01 00 00 01 00 02 46 01 15 00 00 00 01 00 02 47 a0 15 00 00 00 01 00 02 48 01 15 00 00 00 01 00 02 49 b0 15 00 00 00 01 00 02 4a 01 15 00 00 00 01 00 02 4b ce 15 00 00 00 01 00 02 4c 01 15 00 00 00 01 00 02 4d ea 15 00 00 00 01 00 02 4e 02 15 00 00 00 01 00 02 4f 0f 15 00 00 00 01 00 02 50 02 15 00 00 00 01 00 02 51 34 15 00 00 00 01 00 02 52 02 15 00 00 00 01 00 02 53 35 15 00 00 00 01 00 02 54 02 15 00 00 00 01 00 02 55 62 15 00 00 00 01 00 02 56 02 15 00 00 00 01 00 02 58 9e 15 00 00 00 01 00 02 59 02 15 00 00 00 01 00 02 5a c6 15 00 00 00 01 00 02 5b 02 15 00 00 00 01 00 02 5c fa 15 00 00 00 01 00 02 5d 03 15 00 00 00 01 00 02 5e 16 15 00 00 00 01 00 02 5f 03 15 00 00 00 01 00 02 60 48 15 00 00 00 01 00 02 61 03 15 00 00 00 01 00 02 62 57 15 00 00 00 01 00 02 63 03 15 00 00 00 01 00 02 64 68 15 00 00 00 01 00 02 65 03 15 00 00 00 01 00 02 66 7b 15 00 00 00 01 00 02 67 03 15 00 00 00 01 00 02 68 91 15 00 00 00 01 00 02 69 03 15 00 00 00 01 00 02 6a a9 15 00 00 00 01 00 02 6b 03 15 00 00 00 01 00 02 6c bf 15 00 00 00 01 00 02 6d 03 15 00 00 00 01 00 02 6e cc 15 00 00 00 01 00 02 6f 03 15 01 00 00 01 00 02 70 ff 15 00 00 00 01 00 02 71 02 15 00 00 00 01 00 02 72 01 15 00 00 00 01 00 02 73 02 15 00 00 00 01 00 02 74 02 15 00 00 00 01 00 02 75 02 15 00 00 00 01 00 02 76 03 15 00 00 00 01 00 02 77 02 15 00 00 00 01 00 02 78 04 15 00 00 00 01 00 02 79 02 15 00 00 00 01 00 02 7a 06 15 00 00 00 01 00 02 7b 02 15 00 00 00 01 00 02 7c 07 15 00 00 00 01 00 02 7d 02 15 00 00 00 01 00 02 7e 09 15 00 00 00 01 00 02 7f 02 15 00 00 00 01 00 02 80 0a 15 00 00 00 01 00 02 81 02 15 00 00 00 01 00 02 82 0c 15 00 00 00 01 00 02 83 02 15 00 00 00 01 00 02 84 11 15 00 00 00 01 00 02 85 02 15 00 00 00 01 00 02 86 17 15 00 00 00 01 00 02 87 02 15 00 00 00 01 00 02 88 24 15 00 00 00 01 00 02 89 02 15 00 00 00 01 00 02 8a 31 15 00 00 00 01 00 02 8b 02 15 00 00 00 01 00 02 8c 4e 15 00 00 00 01 00 02 8d 02 15 00 00 00 01 00 02 8e 6f 15 00 00 00 01 00 02 8f 02 15 00 00 00 01 00 02 90 70 15 00 00 00 01 00 02 91 02 15 00 00 00 01 00 02 92 9a 15 00 00 00 01 00 02 93 02 15 00 00 00 01 00 02 94 d3 15 00 00 00 01 00 02 95 02 15 00 00 00 01 00 02 96 f8 15 00 00 00 01 00 02 97 03 15 00 00 00 01 00 02 98 24 15 01 00 00 01 00 02 99 03 15 00 00 00 01 00 02 9a 4b 15 00 00 00 01 00 02 9b 03 15 00 00 00 01 00 02 9c 7c 15 00 00 00 01 00 02 9d 03 15 00 00 00 01 00 02 9e 89 15 00 00 00 01 00 02 9f 03 15 00 00 00 01 00 02 a0 95 15 00 00 00 01 00 02 a2 03 15 00 00 00 01 00 02 a3 a0 15 00 00 00 01 00 02 a4 03 15 00 00 00 01 00 02 a5 a9 15 00 00 00 01 00 02 a6 03 15 00 00 00 01 00 02 a7 b0 15 00 00 00 01 00 02 a9 03 15 00 00 00 01 00 02 aa b4 15 00 00 00 01 00 02 ab 03 15 00 00 00 01 00 02 ac b6 15 00 00 00 01 00 02 ad 03 15 00 00 00 01 00 02 ae ff 15 00 00 00 01 00 02 af 02 15 00 00 00 01 00 02 b0 01 15 00 00 00 01 00 02 b1 02 15 00 00 00 01 00 02 b2 02 15 00 00 00 01 00 02 b3 02 15 00 00 00 01 00 02 b4 03 15 00 00 00 01 00 02 b5 02 15 00 00 00 01 00 02 b6 04 15 00 00 00 01 00 02 b7 02 15 00 00 00 01 00 02 b8 06 15 00 00 00 01 00 02 b9 02 15 00 00 00 01 00 02 ba 07 15 00 00 00 01 00 02 bb 02 15 00 00 00 01 00 02 bc 09 15 00 00 00 01 00 02 bd 02 15 00 00 00 01 00 02 be 0a 15 00 00 00 01 00 02 bf 02 15 00 00 00 01 00 02 c0 0c 15 00 00 00 01 00 02 c1 02 15 00 00 00 01 00 02 c2 11 15 00 00 00 01 00 02 c3 02 15 00 00 00 01 00 02 c4 17 15 01 00 00 01 00 02 c5 02 15 00 00 00 01 00 02 c6 24 15 00 00 00 01 00 02 c7 02 15 00 00 00 01 00 02 c8 31 15 00 00 00 01 00 02 c9 02 15 00 00 00 01 00 02 ca 4e 15 00 00 00 01 00 02 cb 02 15 00 00 00 01 00 02 cc 6f 15 00 00 00 01 00 02 cd 02 15 00 00 00 01 00 02 ce 70 15 00 00 00 01 00 02 cf 02 15 00 00 00 01 00 02 d0 9a 15 00 00 00 01 00 02 d1 02 15 00 00 00 01 00 02 d2 d3 15 00 00 00 01 00 02 d3 02 15 00 00 00 01 00 02 d4 f8 15 00 00 00 01 00 02 d5 03 15 00 00 00 01 00 02 d6 24 15 00 00 00 01 00 02 d7 03 15 00 00 00 01 00 02 d8 4b 15 00 00 00 01 00 02 d9 03 15 00 00 00 01 00 02 da 7c 15 00 00 00 01 00 02 db 03 15 00 00 00 01 00 02 dc 89 15 00 00 00 01 00 02 dd 03 15 00 00 00 01 00 02 de 95 15 00 00 00 01 00 02 df 03 15 00 00 00 01 00 02 e0 a0 15 00 00 00 01 00 02 e1 03 15 00 00 00 01 00 02 e2 a9 15 00 00 00 01 00 02 e3 03 15 00 00 00 01 00 02 e4 b0 15 00 00 00 01 00 02 e5 03 15 00 00 00 01 00 02 e6 b4 15 00 00 00 01 00 02 e7 03 15 00 00 00 01 00 02 e8 b6 15 00 00 00 01 00 02 e9 03 15 00 00 00 01 00 02 ea ff 15 00 00 00 01 00 02 fb 01 15 01 00 00 01 00 02 ff 10];
		qcom,mdss-dsi-dispparam-papermode7-command-state = "dsi_hs_mode";
	}; 
};



