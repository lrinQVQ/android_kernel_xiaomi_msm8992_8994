/* Copyright (c) 2015, The Linux Foundation. All rights reserved.
 * Copyright (C) 2016 XiaoMi, Inc.
 *
 * This program is free software; you can redistribute it and/or modify
 * it under the terms of the GNU General Public License version 2 and
 * only version 2 as published by the Free Software Foundation.
 *
 * This program is distributed in the hope that it will be useful,
 * but WITHOUT ANY WARRANTY; without even the implied warranty of
 * MERCHANTABILITY or FITNESS FOR A PARTICULAR PURPOSE.  See the
 * GNU General Public License for more details.
 */

 /*---------------------------------------------------------------------------
 * This file is autogenerated file using gcdb parser. Please do not edit it.
 * Update input XML file to add a new entry or update variable in this file
 * VERSION = "1.0"
 *---------------------------------------------------------------------------*/
&mdss_mdp {
	dsi_sharp_rsp61322_1080_vid: qcom,mdss_dsi_sharp_rsp61322_1080p_video {
		qcom,mdss-dsi-panel-name = "sharp rsp61322 1080p video mode dsi panel";
		qcom,mdss-dsi-panel-id = <8>;
		qcom,mdss-dsi-panel-controller = <&mdss_dsi0>;
		qcom,mdss-dsi-panel-type = "dsi_video_mode";
		qcom,mdss-dsi-panel-destination = "display_1";
		qcom,mdss-dsi-panel-framerate = <60>;
		qcom,mdss-dsi-virtual-channel-id = <0>;
		qcom,mdss-dsi-stream = <0>;
		qcom,mdss-dsi-panel-width = <1080>;
		qcom,mdss-dsi-panel-height = <1920>;
		qcom,mdss-dsi-h-front-porch = <72>;
		qcom,mdss-dsi-h-back-porch = <50>;
		qcom,mdss-dsi-h-pulse-width = <10>;
		qcom,mdss-dsi-h-sync-skew = <0>;
		qcom,mdss-dsi-v-back-porch = <5>;
		qcom,mdss-dsi-v-front-porch = <7>;
		qcom,mdss-dsi-v-pulse-width = <2>;
		qcom,mdss-dsi-h-left-border = <0>;
		qcom,mdss-dsi-h-right-border = <0>;
		qcom,mdss-dsi-v-top-border = <0>;
		qcom,mdss-dsi-v-bottom-border = <0>;
		qcom,mdss-dsi-bpp = <24>;
		qcom,mdss-dsi-underflow-color = <0xff>;
		qcom,mdss-dsi-border-color = <0>;
		qcom,mdss-dsi-pixel-packing = "tight";
		qcom,mdss-dsi-pan-enable-dynamic-fps;
		qcom,mdss-dsi-pan-fps-update = "dfps_immediate_porch_mode_vfp";
		qcom,mdss-dsi-min-refresh-rate = <55>;
		qcom,mdss-dsi-max-refresh-rate = <60>;
		qcom,mdss-dsi-on-command = [
				23 00 00 00 00 00 02 b0 00
				23 00 00 00 00 00 02 d6 01
				29 01 00 00 00 00 19 CE 3D 40 48 56 67 78 88 98 A7 B5 C3 D1 DE E9 F2 FA FF 01 5F 04 04 00 00 00
				29 00 00 00 00 00 1F C7 0B 18 20 2B 3A 48 51 60 45 4D 58 65 71 73 74 09 16 1E 29 38 48 51 60 45 4D 58 65 71 75 76
				29 01 00 00 00 00 14 c8 01 00 09 02 FD CF 00 00 05 FE 02 FC 00 00 0C FE F4 E8 00
				29 00 00 00 00 00 04 c3 01 00 0A
				29 00 00 00 00 00 06 EC 04 10 32 00 00
				23 00 00 00 00 00 02 b0 03

				15 00 00 00 00 00 02 34 00
				39 00 00 00 00 00 02 51 FF
				15 00 00 00 00 00 02 53 24
				15 00 00 00 00 00 02 55 01
				05 01 00 00 14 00 02 29 00
				05 01 00 00 32 00 02 11 00 ];

		qcom,mdss-dsi-off-command = [
				05 01 00 00 1D 00 02 28 00
				05 01 00 00 78 00 02 10 00
				];
		qcom,mdss-dsi-on-command-state = "dsi_lp_mode";
		qcom,mdss-dsi-off-command-state = "dsi_hs_mode";
		qcom,mdss-dsi-h-sync-pulse = <0>;
		qcom,mdss-dsi-traffic-mode = "burst_mode";
		qcom,mdss-dsi-bllp-eof-power-mode;
		qcom,mdss-dsi-bllp-power-mode;
		qcom,mdss-dsi-lane-0-state;
		qcom,mdss-dsi-lane-1-state;
		qcom,mdss-dsi-lane-2-state;
		qcom,mdss-dsi-lane-3-state;
		qcom,mdss-dsi-lp11-init;
		qcom,mdss-dsi-panel-timings = [E1 4B 37 00 A9 AB 2A 4F 3D 03 04 00];
		qcom,mdss-dsi-t-clk-post = <0x19>;
		qcom,mdss-dsi-t-clk-pre = <0x2f>;
		qcom,mdss-dsi-bl-min-level = <1>;
		qcom,mdss-dsi-bl-max-level = <4095>;
		qcom,mdss-dsi-dma-trigger = "trigger_sw";
		qcom,mdss-dsi-mdp-trigger = "none";
		qcom,mdss-dsi-bl-pmic-control-type = "bl_ctrl_wled";
		qcom,mdss-dsi-reset-sequence = <1 5>, <0 10>, <1 10>;
		qcom,mdss-pan-physical-width-dimension = <61>;
		qcom,mdss-pan-physical-height-dimension = <109>;
		qcom,cont-splash-enabled;
		qcom,dispparam-enabled;
		qcom,mdss-dsi-dispparam-warm-command = [29 01 00 00 32 00 02 b0 00 29 00 00 00 00 00 02 b0 00 29 00 00 00 00 00 1f c7 0c 19 21 2c 3b 48 51 60 45 4d 58 65 71 72 73 08 15 1d 28 37 48 51 60 45 4d 58 65 71 76 77 29 00 00 00 00 00 14 c8 01 00 0b 02 fe ec 00 00 05 fd 02 fc 00 00 0d 00 f7 bb 00 29 00 00 00 00 00 02 d6 01 29 01 00 00 05 00 02 b0 03];
		qcom,mdss-dsi-dispparam-warm-command-state = "dsi_hs_mode";
		qcom,mdss-dsi-dispparam-default-command = [29 01 00 00 32 00 02 b0 00 29 00 00 00 00 00 02 b0 00 29 00 00 00 00 00 1f c7 0b 18 20 2b 3a 48 51 60 45 4d 58 65 71 73 74 09 16 1e 29 38 48 51 60 45 4d 58 65 71 75 76 29 00 00 00 00 00 14 c8 01 00 09 02 fd cf 00 00 05 fe 02 fc 00 00 0c fe f4 e8 00 29 00 00 00 00 00 02 d6 01 29 01 00 00 05 00 02 b0 03];
		qcom,mdss-dsi-dispparam-default-command-state = "dsi_hs_mode";
		qcom,mdss-dsi-dispparam-cold-command = [29 01 00 00 32 00 02 b0 00 29 00 00 00 00 00 02 b0 00 29 00 00 00 00 00 1f c7 0c 19 22 2d 3d 49 53 63 48 50 5c 6b 72 73 74 08 15 1e 29 39 49 53 63 48 50 5c 6b 74 75 76 29 00 00 00 00 00 14 c8 01 11 f7 05 f6 a1 00 11 f3 00 f8 e7 00 11 fa fe ec fc 00 29 00 00 00 00 00 02 d6 01 29 01 00 00 05 00 02 b0 03];
		qcom,mdss-dsi-dispparam-cold-command-state = "dsi_hs_mode";
		qcom,mdss-dsi-dispparam-cabcon-command = [39 01 00 00 32 00 02 55 01 39 00 00 00 01 00 02 55 01 15 01 00 00 01 00 02 53 2c];
		qcom,mdss-dsi-dispparam-cabcon-command-state = "dsi_hs_mode";
		qcom,mdss-dsi-dispparam-cabcguion-command = [39 01 00 00 32 00 02 55 01 39 00 00 00 01 00 02 55 01 15 01 00 00 01 00 02 53 2c];
		qcom,mdss-dsi-dispparam-cabcguion-command-state = "dsi_hs_mode";
		qcom,mdss-dsi-dispparam-cabcstillon-command = [39 01 00 00 32 00 02 55 02 39 00 00 00 01 00 02 55 02 15 01 00 00 01 00 02 53 2c];
		qcom,mdss-dsi-dispparam-cabcstillon-command-state = "dsi_hs_mode";
		qcom,mdss-dsi-dispparam-cabcmovieon-command = [15 01 00 00 32 00 02 55 03 15 00 00 00 01 00 02 55 03 15 01 00 00 01 00 02 53 2c];
		qcom,mdss-dsi-dispparam-cabcmovieon-command-state = "dsi_hs_mode";
		qcom,mdss-dsi-dispparam-cabcoff-command = [39 01 00 00 32 00 02 55 00 39 00 00 00 01 00 02 55 00 15 01 00 00 01 00 02 53 2c];
		qcom,mdss-dsi-dispparam-cabcoff-command-state = "dsi_hs_mode";
		qcom,mdss-dsi-dispparam-nightmode1-command = <0x29010000 0x2b0 0x290100 0x1f 0xc73e4142 0x454c545a 0x6549505b 0x666d7175 0x3e414245 0x4c545a65 0x49505b66 0x6d717529 0x1000000 0x14c801 0x60301 0xdb000001 0xff03fa00 0x60303fd 0xa70f2901 0x0 0x2d60129 0x1000005 0x2b003>;
		qcom,mdss-dsi-dispparam-nightmode1-command-state = "dsi_hs_mode";
		qcom,mdss-dsi-dispparam-nightmode2-command = <0x29010000 0x2b0 0x290100 0x1f 0xc7515253 0x55585d61 0x6b4d545e 0x686e7274 0x51525355 0x585d616b 0x4d545e68 0x6e727429 0x1000000 0x14c801 0x305fd 0xe30001fb 0x1fdfcf0 0xfc07f8 0xb2002901 0x0 0x2d60129 0x1000005 0x2b003>;
		qcom,mdss-dsi-dispparam-nightmode2-command-state = "dsi_hs_mode";
		qcom,mdss-dsi-dispparam-nightmode3-command = <0x29010000 0x2b0 0x290100 0x1f 0xc75c5d5e 0x5f616468 0x71525862 0x6a6f7172 0x5c5d5e5f 0x61646871 0x5258626a 0x6f717229 0x1000000 0x14c801 0x110dfb 0xec0e00fd 0x309f7ef 0xff0cfa 0xbc022901 0x0 0x2d60129 0x1000005 0x2b003>;
		qcom,mdss-dsi-dispparam-nightmode3-command-state = "dsi_hs_mode";
		qcom,mdss-dsi-dispparam-nightmode4-command = <0x29010000 0x2b0 0x290100 0x1f 0xc7676869 0x6a6b6e71 0x78585e66 0x6d717374 0x6768696a 0x6b6e7178 0x585e666d 0x71737429 0x1000000 0x14c801 0xb0619 0xf20f03fc 0x24f6cf 0x3f1fd11 0xd70b2901 0x0 0x2d60129 0x1000005 0x2b003>;
		qcom,mdss-dsi-dispparam-nightmode4-command-state = "dsi_hs_mode";
		qcom,mdss-dsi-dispparam-nightmode5-command = <0x29010000 0x2b0 0x290100 0x1f 0xc7727374 0x7576787a 0x7f5f656b 0x71737475 0x72737475 0x76787a7f 0x5f656b71 0x73747529 0x1000000 0x14c801 0x110df42b 0xf8b10715 0xf034f7a2 0x26e7e71f 0xea992901 0x0 0x2d60129 0x1000005 0x2b003>;
		qcom,mdss-dsi-dispparam-nightmode5-command-state = "dsi_hs_mode";
		qcom,mdss-dsi-dispparam-papermode-command = [29 01 00 00 32 00 02 b0 00 29 00 00 00 00 00 02 b0 00 29 00 00 00 00 00 1f c7 0a 17 1f 2a 39 47 51 60 45 4d 58 63 6d 72 75 0a 17 1f 2a 39 47 51 60 45 4d 58 63 6d 72 75 29 00 00 00 00 00 14 c8 01 00 0c 03 04 cf 00 00 05 fe 02 fc 00 00 03 05 fe 09 20 29 00 00 00 00 00 02 d6 01 29 01 00 00 05 00 02 b0 03];
		qcom,mdss-dsi-dispparam-papermode-state = "dsi_hs_mode";
		qcom,mdss-dsi-dispparam-papermode1-command = [29 01 00 00 32 00 02 b0 00 29 00 00 00 00 00 02 b0 00 29 00 00 00 00 00 1f c7 0a 17 1f 2a 38 47 51 60 45 4d 58 64 6f 73 75 0a 17 1f 2a 38 47 51 60 45 4d 58 64 6f 73 75 29 00 00 00 00 00 14 c8 01 00 0a 02 00 d4 e1 00 05 fe 04 fc e0 00 0c 01 fe b0 e0 29 00 00 00 00 00 02 d6 01 29 01 00 00 05 00 02 b0 03];
		qcom,mdss-dsi-dispparam-papermode1-state = "dsi_hs_mode";
		qcom,mdss-dsi-dispparam-papermode2-command = [29 01 00 00 32 00 02 b0 00 29 00 00 00 00 00 02 b0 00 29 00 00 00 00 00 1f c7 0a 17 1f 2a 38 47 51 60 45 4d 58 64 6f 73 75 0a 17 1f 2a 38 47 51 60 45 4d 58 64 6f 73 75 29 00 00 00 00 00 14 c8 01 00 0a 02 00 d4 e1 00 05 fe 04 fc e0 00 0c 01 fe b0 e0 29 00 00 00 00 00 02 d6 01 29 01 00 00 05 00 02 b0 03];
		qcom,mdss-dsi-dispparam-papermode2-state = "dsi_hs_mode";
		qcom,mdss-dsi-dispparam-papermode3-command = [29 01 00 00 32 00 02 b0 00 29 00 00 00 00 00 02 b0 00 29 00 00 00 00 00 1f c7 0a 17 1f 2a 39 48 51 60 44 4d 58 64 6f 73 75 0a 17 1f 2a 39 48 51 60 44 4d 58 64 6f 73 75 29 00 00 00 00 00 14 c8 01 00 0c 02 05 ce f0 00 05 fe 02 fc 00 00 0c 00 fc 7b 10 29 00 00 00 00 00 02 d6 01 29 01 00 00 05 00 02 b0 03];
		qcom,mdss-dsi-dispparam-papermode3-state = "dsi_hs_mode";
		qcom,mdss-dsi-dispparam-papermode4-command = [29 01 00 00 32 00 02 b0 00 29 00 00 00 00 00 02 b0 00 29 00 00 00 00 00 1f c7 0a 17 1f 2a 39 48 51 60 44 4d 58 64 6f 73 75 0a 17 1f 2a 39 48 51 60 44 4d 58 64 6f 73 75 29 00 00 00 00 00 14 c8 01 00 0c 02 05 ce f0 00 05 fe 02 fc 00 00 0c 00 fc 7b 10 29 00 00 00 00 00 02 d6 01 29 01 00 00 05 00 02 b0 03];
		qcom,mdss-dsi-dispparam-papermode4-state = "dsi_hs_mode";
		qcom,mdss-dsi-dispparam-papermode5-command = [29 01 00 00 32 00 02 b0 00 29 00 00 00 00 00 02 b0 00 29 00 00 00 00 00 1f c7 0a 17 1f 2a 39 47 51 60 45 4d 58 64 6f 73 75 0a 17 1f 2a 39 47 51 60 45 4d 58 64 6f 73 75 29 00 00 00 00 00 14 c8 01 00 0c 03 04 cd 00 00 05 fe 02 fc 00 00 06 04 f8 41 20 29 00 00 00 00 00 02 d6 01 29 01 00 00 05 00 02 b0 03];
		qcom,mdss-dsi-dispparam-papermode5-state = "dsi_hs_mode";
		qcom,mdss-dsi-dispparam-papermode6-command = [29 01 00 00 32 00 02 b0 00 29 00 00 00 00 00 02 b0 00 29 00 00 00 00 00 1f c7 0a 17 1f 2a 39 47 51 60 45 4d 58 64 6f 73 75 0a 17 1f 2a 39 47 51 60 45 4d 58 64 6f 73 75 29 00 00 00 00 00 14 c8 01 00 0c 03 04 cd 00 00 05 fe 02 fc 00 00 06 04 f8 41 20 29 00 00 00 00 00 02 d6 01 29 01 00 00 05 00 02 b0 03];
		qcom,mdss-dsi-dispparam-papermode6-state = "dsi_hs_mode";
		qcom,mdss-dsi-dispparam-papermode7-command = [29 01 00 00 32 00 02 b0 00 29 00 00 00 00 00 02 b0 00 29 00 00 00 00 00 1f c7 0a 17 1f 2a 39 47 51 60 45 4d 58 63 6d 72 75 0a 17 1f 2a 39 47 51 60 45 4d 58 63 6d 72 75 29 00 00 00 00 00 14 c8 01 00 0c 03 04 cf 00 00 05 fe 02 fc 00 00 03 05 fe 09 20 29 00 00 00 00 00 02 d6 01 29 01 00 00 05 00 02 b0 03];
		qcom,mdss-dsi-dispparam-papermode7-state = "dsi_hs_mode";
		};
	};

