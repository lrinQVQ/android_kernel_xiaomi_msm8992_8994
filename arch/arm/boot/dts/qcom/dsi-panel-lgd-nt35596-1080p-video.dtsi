/* Copyright (c) 2015, The Linux Foundation. All rights reserved.
 * Copyright (C) 2016 XiaoMi, Inc.
 *
 * This program is free software; you can redistribute it and/or modify
 * it under the terms of the GNU General Public License version 2 and
 * only version 2 as published by the Free Software Foundation.
 *
 * This program is distributed in the hope that it will be useful,
 * but WITHOUT ANY WARRANTY; without even the implied warranty of
 * MERCHANTABILITY or FITNESS FOR A PARTICULAR PURPOSE.  See the
 * GNU General Public License for more details.
 */

 /*---------------------------------------------------------------------------
 * This file is autogenerated file using gcdb parser. Please do not edit it.
 * Update input XML file to add a new entry or update variable in this file
 * VERSION = "1.0"
 *---------------------------------------------------------------------------*/
&mdss_mdp {
	dsi_lgd_nt35596_1080_vid: qcom,mdss_dsi_lgd_nt35596_1080p_video {
		qcom,mdss-dsi-panel-name = "lgd nt35596 1080p video mode dsi panel";
		qcom,mdss-dsi-panel-id = <5>;
		qcom,mdss-dsi-panel-controller = <&mdss_dsi0>;
		qcom,mdss-dsi-panel-type = "dsi_video_mode";
		qcom,mdss-dsi-panel-destination = "display_1";
		qcom,mdss-dsi-panel-framerate = <60>;
		qcom,mdss-dsi-virtual-channel-id = <0>;
		qcom,mdss-dsi-stream = <0>;
		qcom,mdss-dsi-panel-width = <1080>;
		qcom,mdss-dsi-panel-height = <1920>;
		qcom,mdss-dsi-h-front-porch = <100>;
		qcom,mdss-dsi-h-back-porch = <24>;
		qcom,mdss-dsi-h-pulse-width = <8>;
		qcom,mdss-dsi-h-sync-skew = <0>;
		qcom,mdss-dsi-v-back-porch = <2>;
		qcom,mdss-dsi-v-front-porch = <12>;
		qcom,mdss-dsi-v-pulse-width = <1>;
		qcom,mdss-dsi-h-left-border = <0>;
		qcom,mdss-dsi-h-right-border = <0>;
		qcom,mdss-dsi-v-top-border = <0>;
		qcom,mdss-dsi-v-bottom-border = <0>;
		qcom,mdss-dsi-bpp = <24>;
		qcom,mdss-dsi-underflow-color = <0xff>;
		qcom,mdss-dsi-border-color = <0>;
		qcom,mdss-dsi-pixel-packing = "tight";
		qcom,mdss-dsi-pan-enable-dynamic-fps;
		qcom,mdss-dsi-pan-fps-update = "dfps_immediate_porch_mode_vfp";
		qcom,mdss-dsi-min-refresh-rate = <45>;
		qcom,mdss-dsi-max-refresh-rate = <60>;
		qcom,mdss-dsi-on-command = [
				15 00 00 00 01 00 02 FF 04
				15 00 00 00 01 00 02 08 06
				15 00 00 00 01 00 02 FB 01

				15 01 00 00 01 00 02 FF 05
				15 00 00 00 01 00 02 FB 01
				15 01 00 00 01 00 02 33 00
				15 00 00 00 01 00 02 34 03
				15 00 00 00 01 00 02 35 74
				15 00 00 00 01 00 02 7B 81
				15 00 00 00 01 00 02 7E 10
				15 00 00 00 01 00 02 7F 16
				15 00 00 00 01 00 02 80 08
				15 00 00 00 01 00 02 81 06
				15 00 00 00 01 00 02 82 00
				15 00 00 00 01 00 02 84 05
				15 00 00 00 01 00 02 85 03
				15 00 00 00 01 00 02 8C 01
				15 00 00 00 01 00 02 A4 07
				15 00 00 00 01 00 02 B5 20
				15 00 00 00 01 00 02 C5 32

				15 01 00 00 01 00 02 FF 01
				15 00 00 00 01 00 02 FB 01
				15 00 00 00 01 00 02 58 82
				15 00 00 00 01 00 02 59 02
				15 00 00 00 01 00 02 5A 02
				15 00 00 00 01 00 02 5B 02
				15 00 00 00 01 00 02 5C 82
				15 00 00 00 01 00 02 5D 82
				15 00 00 00 01 00 02 5E 01
				15 00 00 00 01 00 02 5F 01
				15 00 00 00 01 00 02 60 05

				15 01 00 00 01 00 02 FF EE
				15 00 00 00 01 00 02 FB 01
				15 00 00 00 01 00 02 2F 00
				15 00 00 00 01 00 02 32 C0

				15 00 00 00 00 00 02 FF 00
				15 00 00 00 01 00 02 FB 01
				15 00 00 00 01 00 02 D3 02
				15 01 00 00 01 00 02 D4 09
				05 01 00 00 64 00 02 11 00
				15 00 00 00 01 00 02 51 ff
				15 00 00 00 01 00 02 53 24
				15 00 00 00 01 00 02 55 01
				05 01 00 00 14 00 02 29 00
		];
		qcom,mdss-dsi-off-command = [
				15 00 00 00 00 00 02 FF 00
				05 01 00 00 20 00 02 28 00
				05 01 00 00 40 00 02 10 00
				23 01 00 00 00 00 02 4F 01
				];
		qcom,mdss-dsi-on-command-state = "dsi_lp_mode";
		qcom,mdss-dsi-off-command-state = "dsi_hs_mode";
		qcom,mdss-dsi-h-sync-pulse = <0>;
		qcom,mdss-dsi-traffic-mode = "non_burst_sync_pulse";
		qcom,mdss-dsi-bllp-eof-power-mode;
		qcom,mdss-dsi-bllp-power-mode;
		qcom,mdss-dsi-lane-0-state;
		qcom,mdss-dsi-lane-1-state;
		qcom,mdss-dsi-lane-2-state;
		qcom,mdss-dsi-lane-3-state;
		qcom,mdss-dsi-lp11-init;
		qcom,mdss-dsi-panel-timings = [E1 4B 37 00 A9 AB 2A 4F 3D 03 04 00];
		qcom,mdss-dsi-t-clk-post = <0x19>;
		qcom,mdss-dsi-t-clk-pre = <0x2f>;
		qcom,mdss-dsi-bl-min-level = <1>;
		qcom,mdss-dsi-bl-max-level = <4095>;
		qcom,mdss-dsi-dma-trigger = "trigger_sw";
		qcom,mdss-dsi-mdp-trigger = "none";
		qcom,mdss-dsi-bl-pmic-control-type = "bl_ctrl_wled";
		qcom,mdss-dsi-reset-sequence = <1 5>, <0 5>, <1 10>;
		qcom,mdss-pan-physical-width-dimension = <61>;
		qcom,mdss-pan-physical-height-dimension = <109>;
		qcom,cont-splash-enabled;
		qcom,dispparam-enabled;
		qcom,mdss-dsi-dispparam-warm-command = [15 01 00 00 01 00 02 ff 01 15 00 00 00 01 00 02 fb 01 15 00 00 00 01 00 02 0b d7 15 00 00 00 01 00 02 0c d7 15 00 00 00 01 00 02 75 00 15 00 00 00 01 00 02 76 00 15 00 00 00 01 00 02 77 00 15 00 00 00 01 00 02 78 1a 15 00 00 00 01 00 02 79 00 15 00 00 00 01 00 02 7a 47 15 00 00 00 01 00 02 7b 00 15 00 00 00 01 00 02 7c 6a 15 00 00 00 01 00 02 7d 00 15 00 00 00 01 00 02 7e 85 15 00 00 00 01 00 02 7f 00 15 00 00 00 01 00 02 80 9b 15 00 00 00 01 00 02 81 00 15 00 00 00 01 00 02 82 b0 15 00 00 00 01 00 02 83 00 15 00 00 00 01 00 02 84 c3 15 00 00 00 01 00 02 85 00 15 00 00 00 01 00 02 86 d4 15 00 00 00 01 00 02 87 01 15 00 00 00 01 00 02 88 09 15 00 00 00 01 00 02 89 01 15 00 00 00 01 00 02 8a 33 15 00 00 00 01 00 02 8b 01 15 00 00 00 01 00 02 8c 6c 15 00 00 00 01 00 02 8d 01 15 00 00 00 01 00 02 8e 9b 15 00 00 00 01 00 02 8f 01 15 00 00 00 01 00 02 90 dd 15 00 00 00 01 00 02 91 02 15 00 00 00 01 00 02 92 11 15 00 00 00 01 00 02 93 02 15 00 00 00 01 00 02 94 12 15 00 00 00 01 00 02 95 02 15 00 00 00 01 00 02 96 44 15 00 00 00 01 00 02 97 02 15 00 00 00 01 00 02 98 7d 15 00 00 00 01 00 02 99 02 15 01 00 00 01 00 02 9a a4 15 00 00 00 01 00 02 9b 02 15 00 00 00 01 00 02 9c d9 15 00 00 00 01 00 02 9d 03 15 00 00 00 01 00 02 9e 00 15 00 00 00 01 00 02 9f 03 15 00 00 00 01 00 02 a0 35 15 00 00 00 01 00 02 a2 03 15 00 00 00 01 00 02 a3 57 15 00 00 00 01 00 02 a4 03 15 00 00 00 01 00 02 a5 6d 15 00 00 00 01 00 02 a6 03 15 00 00 00 01 00 02 a7 89 15 00 00 00 01 00 02 a9 03 15 00 00 00 01 00 02 aa a3 15 00 00 00 01 00 02 ab 03 15 00 00 00 01 00 02 ac c9 15 00 00 00 01 00 02 ad 03 15 00 00 00 01 00 02 ae dd 15 00 00 00 01 00 02 af 03 15 00 00 00 01 00 02 b0 f5 15 00 00 00 01 00 02 b1 03 15 00 00 00 01 00 02 b2 ff 15 00 00 00 01 00 02 b3 00 15 00 00 00 01 00 02 b4 00 15 00 00 00 01 00 02 b5 00 15 00 00 00 01 00 02 b6 1a 15 00 00 00 01 00 02 b7 00 15 00 00 00 01 00 02 b8 47 15 00 00 00 01 00 02 b9 00 15 00 00 00 01 00 02 ba 6a 15 00 00 00 01 00 02 bb 00 15 00 00 00 01 00 02 bc 85 15 00 00 00 01 00 02 bd 00 15 00 00 00 01 00 02 be 9b 15 00 00 00 01 00 02 bf 00 15 00 00 00 01 00 02 c0 b0 15 00 00 00 01 00 02 c1 00 15 00 00 00 01 00 02 c2 c3 15 00 00 00 01 00 02 c3 00 15 01 00 00 01 00 02 c4 d4 15 00 00 00 01 00 02 c5 01 15 00 00 00 01 00 02 c6 09 15 00 00 00 01 00 02 c7 01 15 00 00 00 01 00 02 c8 33 15 00 00 00 01 00 02 c9 01 15 00 00 00 01 00 02 ca 6c 15 00 00 00 01 00 02 cb 01 15 00 00 00 01 00 02 cc 9b 15 00 00 00 01 00 02 cd 01 15 00 00 00 01 00 02 ce dd 15 00 00 00 01 00 02 cf 02 15 00 00 00 01 00 02 d0 11 15 00 00 00 01 00 02 d1 02 15 00 00 00 01 00 02 d2 12 15 00 00 00 01 00 02 d3 02 15 00 00 00 01 00 02 d4 44 15 00 00 00 01 00 02 d5 02 15 00 00 00 01 00 02 d6 7d 15 00 00 00 01 00 02 d7 02 15 00 00 00 01 00 02 d8 a4 15 00 00 00 01 00 02 d9 02 15 00 00 00 01 00 02 da da 15 00 00 00 01 00 02 db 03 15 00 00 00 01 00 02 dc 00 15 00 00 00 01 00 02 dd 03 15 00 00 00 01 00 02 de 35 15 00 00 00 01 00 02 df 03 15 00 00 00 01 00 02 e0 57 15 00 00 00 01 00 02 e1 03 15 00 00 00 01 00 02 e2 6d 15 00 00 00 01 00 02 e3 03 15 00 00 00 01 00 02 e4 89 15 00 00 00 01 00 02 e5 03 15 00 00 00 01 00 02 e6 a3 15 00 00 00 01 00 02 e7 03 15 00 00 00 01 00 02 e8 c9 15 00 00 00 01 00 02 e9 03 15 00 00 00 01 00 02 ea dd 15 00 00 00 01 00 02 eb 03 15 01 00 00 01 00 02 ec f5 15 00 00 00 01 00 02 ed 03 15 00 00 00 01 00 02 ee ff 15 00 00 00 01 00 02 ef 00 15 00 00 00 01 00 02 f0 bd 15 00 00 00 01 00 02 f1 00 15 00 00 00 01 00 02 f2 c5 15 00 00 00 01 00 02 f3 00 15 00 00 00 01 00 02 f4 d6 15 00 00 00 01 00 02 f5 00 15 00 00 00 01 00 02 f6 e5 15 00 00 00 01 00 02 f7 00 15 00 00 00 01 00 02 f8 f2 15 00 00 00 01 00 02 f9 00 15 00 00 00 01 00 02 fa fe 15 01 00 00 01 00 02 ff 02 15 00 00 00 01 00 02 fb 01 15 00 00 00 01 00 02 00 01 15 00 00 00 01 00 02 01 09 15 00 00 00 01 00 02 02 01 15 00 00 00 01 00 02 03 14 15 00 00 00 01 00 02 04 01 15 00 00 00 01 00 02 05 1e 15 00 00 00 01 00 02 06 01 15 00 00 00 01 00 02 07 41 15 00 00 00 01 00 02 08 01 15 00 00 00 01 00 02 09 5f 15 00 00 00 01 00 02 0a 01 15 00 00 00 01 00 02 0b 8c 15 00 00 00 01 00 02 0c 01 15 01 00 00 01 00 02 0d b2 15 00 00 00 01 00 02 0e 01 15 00 00 00 01 00 02 0f ec 15 00 00 00 01 00 02 10 02 15 00 00 00 01 00 02 11 1c 15 00 00 00 01 00 02 12 02 15 00 00 00 01 00 02 13 1d 15 00 00 00 01 00 02 14 02 15 00 00 00 01 00 02 15 4d 15 00 00 00 01 00 02 16 02 15 00 00 00 01 00 02 17 85 15 00 00 00 01 00 02 18 02 15 00 00 00 01 00 02 19 ac 15 00 00 00 01 00 02 1a 02 15 00 00 00 01 00 02 1b e1 15 00 00 00 01 00 02 1c 03 15 00 00 00 01 00 02 1d 08 15 00 00 00 01 00 02 1e 03 15 00 00 00 01 00 02 1f 3e 15 00 00 00 01 00 02 20 03 15 00 00 00 01 00 02 21 57 15 00 00 00 01 00 02 22 03 15 00 00 00 01 00 02 23 6d 15 00 00 00 01 00 02 24 03 15 00 00 00 01 00 02 25 89 15 00 00 00 01 00 02 26 03 15 00 00 00 01 00 02 27 a3 15 00 00 00 01 00 02 28 03 15 00 00 00 01 00 02 29 c9 15 00 00 00 01 00 02 2a 03 15 00 00 00 01 00 02 2b dd 15 00 00 00 01 00 02 2d 03 15 00 00 00 01 00 02 2f f5 15 00 00 00 01 00 02 30 03 15 00 00 00 01 00 02 31 ff 15 00 00 00 01 00 02 32 00 15 00 00 00 01 00 02 33 bd 15 00 00 00 01 00 02 34 00 15 00 00 00 01 00 02 35 c5 15 00 00 00 01 00 02 36 00 15 01 00 00 01 00 02 37 d6 15 00 00 00 01 00 02 38 00 15 00 00 00 01 00 02 39 e5 15 00 00 00 01 00 02 3a 00 15 00 00 00 01 00 02 3b f2 15 00 00 00 01 00 02 3d 00 15 00 00 00 01 00 02 3f fe 15 00 00 00 01 00 02 40 01 15 00 00 00 01 00 02 41 09 15 00 00 00 01 00 02 42 01 15 00 00 00 01 00 02 43 14 15 00 00 00 01 00 02 44 01 15 00 00 00 01 00 02 45 1e 15 00 00 00 01 00 02 46 01 15 00 00 00 01 00 02 47 41 15 00 00 00 01 00 02 48 01 15 00 00 00 01 00 02 49 5f 15 00 00 00 01 00 02 4a 01 15 00 00 00 01 00 02 4b 8c 15 00 00 00 01 00 02 4c 01 15 00 00 00 01 00 02 4d b2 15 00 00 00 01 00 02 4e 01 15 00 00 00 01 00 02 4f ec 15 00 00 00 01 00 02 50 02 15 00 00 00 01 00 02 51 1c 15 00 00 00 01 00 02 52 02 15 00 00 00 01 00 02 53 1d 15 00 00 00 01 00 02 54 02 15 00 00 00 01 00 02 55 4d 15 00 00 00 01 00 02 56 02 15 00 00 00 01 00 02 58 85 15 00 00 00 01 00 02 59 02 15 00 00 00 01 00 02 5a ac 15 00 00 00 01 00 02 5b 02 15 00 00 00 01 00 02 5c e1 15 00 00 00 01 00 02 5d 03 15 00 00 00 01 00 02 5e 08 15 00 00 00 01 00 02 5f 03 15 00 00 00 01 00 02 60 3e 15 00 00 00 01 00 02 61 03 15 01 00 00 01 00 02 62 57 15 00 00 00 01 00 02 63 03 15 00 00 00 01 00 02 64 6d 15 00 00 00 01 00 02 65 03 15 00 00 00 01 00 02 66 89 15 00 00 00 01 00 02 67 03 15 00 00 00 01 00 02 68 a3 15 00 00 00 01 00 02 69 03 15 00 00 00 01 00 02 6a c9 15 00 00 00 01 00 02 6b 03 15 00 00 00 01 00 02 6c dd 15 00 00 00 01 00 02 6d 03 15 00 00 00 01 00 02 6e f5 15 00 00 00 01 00 02 6f 03 15 00 00 00 01 00 02 70 ff 15 00 00 00 01 00 02 71 01 15 00 00 00 01 00 02 72 27 15 00 00 00 01 00 02 73 01 15 00 00 00 01 00 02 74 2b 15 00 00 00 01 00 02 75 01 15 00 00 00 01 00 02 76 34 15 00 00 00 01 00 02 77 01 15 00 00 00 01 00 02 78 3c 15 00 00 00 01 00 02 79 01 15 00 00 00 01 00 02 7a 43 15 00 00 00 01 00 02 7b 01 15 00 00 00 01 00 02 7c 4a 15 00 00 00 01 00 02 7d 01 15 00 00 00 01 00 02 7e 51 15 00 00 00 01 00 02 7f 01 15 00 00 00 01 00 02 80 58 15 00 00 00 01 00 02 81 01 15 00 00 00 01 00 02 82 5e 15 00 00 00 01 00 02 83 01 15 00 00 00 01 00 02 84 75 15 00 00 00 01 00 02 85 01 15 00 00 00 01 00 02 86 8a 15 00 00 00 01 00 02 87 01 15 00 00 00 01 00 02 88 ac 15 01 00 00 01 00 02 89 01 15 00 00 00 01 00 02 8a ca 15 00 00 00 01 00 02 8b 01 15 00 00 00 01 00 02 8c fb 15 00 00 00 01 00 02 8d 02 15 00 00 00 01 00 02 8e 27 15 00 00 00 01 00 02 8f 02 15 00 00 00 01 00 02 90 28 15 00 00 00 01 00 02 91 02 15 00 00 00 01 00 02 92 56 15 00 00 00 01 00 02 93 02 15 00 00 00 01 00 02 94 8d 15 00 00 00 01 00 02 95 02 15 00 00 00 01 00 02 96 b5 15 00 00 00 01 00 02 97 02 15 00 00 00 01 00 02 98 ec 15 00 00 00 01 00 02 99 03 15 00 00 00 01 00 02 9a 18 15 00 00 00 01 00 02 9b 03 15 00 00 00 01 00 02 9c 64 15 00 00 00 01 00 02 9d 03 15 00 00 00 01 00 02 9e 69 15 00 00 00 01 00 02 9f 03 15 00 00 00 01 00 02 a0 6d 15 00 00 00 01 00 02 a2 03 15 00 00 00 01 00 02 a3 89 15 00 00 00 01 00 02 a4 03 15 00 00 00 01 00 02 a5 a3 15 00 00 00 01 00 02 a6 03 15 00 00 00 01 00 02 a7 c9 15 00 00 00 01 00 02 a9 03 15 00 00 00 10 00 02 aa dd 15 00 00 00 01 00 02 ab 03 15 00 00 00 01 00 02 ac f5 15 00 00 00 01 00 02 ad 03 15 00 00 00 01 00 02 ae ff 15 00 00 00 01 00 02 af 01 15 00 00 00 01 00 02 b0 27 15 00 00 00 01 00 02 b1 01 15 00 00 00 01 00 02 b2 2b 15 00 00 00 01 00 02 b3 01 15 01 00 00 01 00 02 b4 34 15 00 00 00 01 00 02 b5 01 15 00 00 00 01 00 02 b6 3c 15 00 00 00 01 00 02 b7 01 15 00 00 00 01 00 02 b8 43 15 00 00 00 01 00 02 b9 01 15 00 00 00 01 00 02 ba 4a 15 00 00 00 01 00 02 bb 01 15 00 00 00 01 00 02 bc 51 15 00 00 00 01 00 02 bd 01 15 00 00 00 01 00 02 be 58 15 00 00 00 01 00 02 bf 01 15 00 00 00 01 00 02 c0 5e 15 00 00 00 01 00 02 c1 01 15 00 00 00 01 00 02 c2 75 15 00 00 00 01 00 02 c3 01 15 00 00 00 01 00 02 c4 8a 15 00 00 00 01 00 02 c5 01 15 00 00 00 01 00 02 c6 ac 15 00 00 00 01 00 02 c7 01 15 01 00 00 01 00 02 c8 cb 15 00 00 00 01 00 02 c9 01 15 00 00 00 01 00 02 ca fc 15 00 00 00 01 00 02 cb 02 15 00 00 00 01 00 02 cc 28 15 00 00 00 01 00 02 cd 02 15 00 00 00 01 00 02 ce 29 15 00 00 00 01 00 02 cf 02 15 00 00 00 01 00 02 d0 56 15 00 00 00 01 00 02 d1 02 15 00 00 00 01 00 02 d2 8e 15 00 00 00 01 00 02 d3 02 15 00 00 00 01 00 02 d4 b5 15 00 00 00 01 00 02 d5 02 15 00 00 00 01 00 02 d6 ed 15 00 00 00 01 00 02 d7 03 15 00 00 00 01 00 02 d8 18 15 00 00 00 01 00 02 d9 03 15 00 00 00 01 00 02 da 64 15 00 00 00 01 00 02 db 03 15 00 00 00 01 00 02 dc 69 15 00 00 00 01 00 02 dd 03 15 00 00 00 01 00 02 de 6d 15 00 00 00 01 00 02 df 03 15 00 00 00 01 00 02 e0 89 15 00 00 00 01 00 02 e1 03 15 00 00 00 01 00 02 e2 a3 15 00 00 00 01 00 02 e3 03 15 00 00 00 01 00 02 e4 c9 15 00 00 00 01 00 02 e5 03 15 00 00 00 01 00 02 e6 dd 15 00 00 00 01 00 02 e7 03 15 00 00 00 01 00 02 e8 f5 15 00 00 00 01 00 02 e9 03 15 00 00 00 01 00 02 ea ff 15 01 00 00 01 00 02 ff 00];
		qcom,mdss-dsi-dispparam-warm-command-state = "dsi_hs_mode";
		qcom,mdss-dsi-dispparam-default-command = [15 01 00 00 01 00 02 ff 01 15 00 00 00 01 00 02 fb 00 15 01 00 00 01 00 02 ff 02 15 00 00 00 01 00 02 fb 00 15 01 00 00 01 00 02 ff 00 05 01 00 00 10 00 02 11 00];
		qcom,mdss-dsi-dispparam-default-command-state = "dsi_hs_mode";
		qcom,mdss-dsi-dispparam-cold-command = [15 01 00 00 01 00 02 ff 01 15 00 00 00 01 00 02 fb 01 15 00 00 00 01 00 02 0b d7 15 00 00 00 01 00 02 0c d7 15 00 00 00 01 00 02 75 00 15 00 00 00 01 00 02 76 c5 15 00 00 00 01 00 02 77 00 15 00 00 00 01 00 02 78 cd 15 00 00 00 01 00 02 79 00 15 00 00 00 01 00 02 7a db 15 00 00 00 01 00 02 7b 00 15 00 00 00 01 00 02 7c e9 15 00 00 00 01 00 02 7d 00 15 00 00 00 01 00 02 7e f6 15 00 00 00 01 00 02 7f 01 15 00 00 00 01 00 02 80 02 15 00 00 00 01 00 02 81 01 15 00 00 00 01 00 02 82 0d 15 00 00 00 01 00 02 83 01 15 00 00 00 01 00 02 84 18 15 00 00 00 01 00 02 85 01 15 00 00 00 01 00 02 86 21 15 00 00 00 01 00 02 87 01 15 00 00 00 01 00 02 88 43 15 00 00 00 01 00 02 89 01 15 00 00 00 01 00 02 8a 5f 15 00 00 00 01 00 02 8b 01 15 00 00 00 01 00 02 8c 8e 15 00 00 00 01 00 02 8d 01 15 00 00 00 01 00 02 8e b2 15 00 00 00 01 00 02 8f 01 15 00 00 00 01 00 02 90 ec 15 00 00 00 01 00 02 91 02 15 00 00 00 01 00 02 92 1c 15 00 00 00 01 00 02 93 02 15 00 00 00 01 00 02 94 1d 15 00 00 00 01 00 02 95 02 15 00 00 00 01 00 02 96 4d 15 00 00 00 01 00 02 97 02 15 00 00 00 01 00 02 98 84 15 00 00 00 01 00 02 99 02 15 01 00 00 01 00 02 9a ac 15 00 00 00 01 00 02 9b 02 15 00 00 00 01 00 02 9c e1 15 00 00 00 01 00 02 9d 03 15 00 00 00 01 00 02 9e 06 15 00 00 00 01 00 02 9f 03 15 00 00 00 01 00 02 a0 40 15 00 00 00 01 00 02 a2 03 15 00 00 00 01 00 02 a3 57 15 00 00 00 01 00 02 a4 03 15 00 00 00 01 00 02 a5 6d 15 00 00 00 01 00 02 a6 03 15 00 00 00 01 00 02 a7 89 15 00 00 00 01 00 02 a9 03 15 00 00 00 01 00 02 aa a3 15 00 00 00 01 00 02 ab 03 15 00 00 00 01 00 02 ac c9 15 00 00 00 01 00 02 ad 03 15 00 00 00 01 00 02 ae dd 15 00 00 00 01 00 02 af 03 15 00 00 00 01 00 02 b0 f5 15 00 00 00 01 00 02 b1 03 15 00 00 00 01 00 02 b2 ff 15 00 00 00 01 00 02 b3 00 15 00 00 00 01 00 02 b4 c5 15 00 00 00 01 00 02 b5 00 15 00 00 00 01 00 02 b6 cd 15 00 00 00 01 00 02 b7 00 15 00 00 00 01 00 02 b8 db 15 00 00 00 01 00 02 b9 00 15 00 00 00 01 00 02 ba e9 15 00 00 00 01 00 02 bb 00 15 00 00 00 01 00 02 bc f6 15 00 00 00 01 00 02 bd 01 15 00 00 00 01 00 02 be 02 15 00 00 00 01 00 02 bf 01 15 00 00 00 01 00 02 c0 0d 15 00 00 00 01 00 02 c1 01 15 00 00 00 01 00 02 c2 18 15 00 00 00 01 00 02 c3 01 15 01 00 00 01 00 02 c4 21 15 00 00 00 01 00 02 c5 01 15 00 00 00 01 00 02 c6 43 15 00 00 00 01 00 02 c7 01 15 00 00 00 01 00 02 c8 60 15 00 00 00 01 00 02 c9 01 15 00 00 00 01 00 02 ca 8e 15 00 00 00 01 00 02 cb 01 15 00 00 00 01 00 02 cc b3 15 00 00 00 01 00 02 cd 01 15 00 00 00 01 00 02 ce ec 15 00 00 00 01 00 02 cf 02 15 00 00 00 01 00 02 d0 1c 15 00 00 00 01 00 02 d1 02 15 00 00 00 01 00 02 d2 1d 15 00 00 00 01 00 02 d3 02 15 00 00 00 01 00 02 d4 4d 15 00 00 00 01 00 02 d5 02 15 00 00 00 01 00 02 d6 84 15 00 00 00 01 00 02 d7 02 15 00 00 00 01 00 02 d8 ac 15 00 00 00 01 00 02 d9 02 15 00 00 00 01 00 02 da e1 15 00 00 00 01 00 02 db 03 15 00 00 00 01 00 02 dc 07 15 00 00 00 01 00 02 dd 03 15 00 00 00 01 00 02 de 40 15 00 00 00 01 00 02 df 03 15 00 00 00 01 00 02 e0 57 15 00 00 00 01 00 02 e1 03 15 00 00 00 01 00 02 e2 6d 15 00 00 00 01 00 02 e3 03 15 00 00 00 01 00 02 e4 89 15 00 00 00 01 00 02 e5 03 15 00 00 00 01 00 02 e6 a3 15 00 00 00 01 00 02 e7 03 15 00 00 00 01 00 02 e8 c9 15 00 00 00 01 00 02 e9 03 15 00 00 00 01 00 02 ea dd 15 00 00 00 01 00 02 eb 03 15 01 00 00 01 00 02 ec f5 15 00 00 00 01 00 02 ed 03 15 00 00 00 01 00 02 ee ff 15 00 00 00 01 00 02 ef 00 15 00 00 00 01 00 02 f0 bd 15 00 00 00 01 00 02 f1 00 15 00 00 00 01 00 02 f2 c6 15 00 00 00 01 00 02 f3 00 15 00 00 00 01 00 02 f4 d6 15 00 00 00 01 00 02 f5 00 15 00 00 00 01 00 02 f6 e4 15 00 00 00 01 00 02 f7 00 15 00 00 00 01 00 02 f8 f2 15 00 00 00 01 00 02 f9 00 15 00 00 00 01 00 02 fa fe 15 01 00 00 01 00 02 ff 02 15 00 00 00 01 00 02 fb 01 15 00 00 00 01 00 02 00 01 15 00 00 00 01 00 02 01 0a 15 00 00 00 01 00 02 02 01 15 00 00 00 01 00 02 03 15 15 00 00 00 01 00 02 04 01 15 00 00 00 01 00 02 05 1f 15 00 00 00 01 00 02 06 01 15 00 00 00 01 00 02 07 42 15 00 00 00 01 00 02 08 01 15 00 00 00 01 00 02 09 5f 15 00 00 00 01 00 02 0a 01 15 00 00 00 01 00 02 0b 8e 15 00 00 00 01 00 02 0c 01 15 01 00 00 01 00 02 0d b3 15 00 00 00 01 00 02 0e 01 15 00 00 00 01 00 02 0f ed 15 00 00 00 01 00 02 10 02 15 00 00 00 01 00 02 11 1d 15 00 00 00 01 00 02 12 02 15 00 00 00 01 00 02 13 1e 15 00 00 00 01 00 02 14 02 15 00 00 00 01 00 02 15 4e 15 00 00 00 01 00 02 16 02 15 00 00 00 01 00 02 17 85 15 00 00 00 01 00 02 18 02 15 00 00 00 01 00 02 19 ac 15 00 00 00 01 00 02 1a 02 15 00 00 00 01 00 02 1b e2 15 00 00 00 01 00 02 1c 03 15 00 00 00 01 00 02 1d 08 15 00 00 00 01 00 02 1e 03 15 00 00 00 01 00 02 1f 42 15 00 00 00 01 00 02 20 03 15 00 00 00 01 00 02 21 57 15 00 00 00 01 00 02 22 03 15 00 00 00 01 00 02 23 6d 15 00 00 00 01 00 02 24 03 15 00 00 00 01 00 02 25 89 15 00 00 00 01 00 02 26 03 15 00 00 00 01 00 02 27 a3 15 00 00 00 01 00 02 28 03 15 00 00 00 01 00 02 29 c9 15 00 00 00 01 00 02 2a 03 15 00 00 00 01 00 02 2b dd 15 00 00 00 01 00 02 2d 03 15 00 00 00 01 00 02 2f f5 15 00 00 00 01 00 02 30 03 15 00 00 00 01 00 02 31 ff 15 00 00 00 01 00 02 32 00 15 00 00 00 01 00 02 33 bd 15 00 00 00 01 00 02 34 00 15 00 00 00 01 00 02 35 c6 15 00 00 00 01 00 02 36 00 15 01 00 00 01 00 02 37 d6 15 00 00 00 01 00 02 38 00 15 00 00 00 01 00 02 39 e4 15 00 00 00 01 00 02 3a 00 15 00 00 00 01 00 02 3b f2 15 00 00 00 01 00 02 3d 00 15 00 00 00 01 00 02 3f fe 15 00 00 00 01 00 02 40 01 15 00 00 00 01 00 02 41 0a 15 00 00 00 01 00 02 42 01 15 00 00 00 01 00 02 43 15 15 00 00 00 01 00 02 44 01 15 00 00 00 01 00 02 45 1f 15 00 00 00 01 00 02 46 01 15 00 00 00 01 00 02 47 42 15 00 00 00 01 00 02 48 01 15 00 00 00 01 00 02 49 5f 15 00 00 00 01 00 02 4a 01 15 00 00 00 01 00 02 4b 8e 15 00 00 00 01 00 02 4c 01 15 00 00 00 01 00 02 4d b3 15 00 00 00 01 00 02 4e 01 15 00 00 00 01 00 02 4f ed 15 00 00 00 01 00 02 50 02 15 00 00 00 01 00 02 51 1d 15 00 00 00 01 00 02 52 02 15 00 00 00 01 00 02 53 1e 15 00 00 00 01 00 02 54 02 15 00 00 00 01 00 02 55 4e 15 00 00 00 01 00 02 56 02 15 00 00 00 01 00 02 58 85 15 00 00 00 01 00 02 59 02 15 00 00 00 01 00 02 5a ad 15 00 00 00 01 00 02 5b 02 15 00 00 00 01 00 02 5c e2 15 00 00 00 01 00 02 5d 03 15 00 00 00 01 00 02 5e 08 15 00 00 00 01 00 02 5f 03 15 00 00 00 01 00 02 60 42 15 00 00 00 01 00 02 61 03 15 01 00 00 01 00 02 62 57 15 00 00 00 01 00 02 63 03 15 00 00 00 01 00 02 64 6d 15 00 00 00 01 00 02 65 03 15 00 00 00 01 00 02 66 89 15 00 00 00 01 00 02 67 03 15 00 00 00 01 00 02 68 a3 15 00 00 00 01 00 02 69 03 15 00 00 00 01 00 02 6a c9 15 00 00 00 01 00 02 6b 03 15 00 00 00 01 00 02 6c dd 15 00 00 00 01 00 02 6d 03 15 00 00 00 01 00 02 6e f5 15 00 00 00 01 00 02 6f 03 15 00 00 00 01 00 02 70 ff 15 00 00 00 01 00 02 71 00 15 00 00 00 01 00 02 72 bf 15 00 00 00 01 00 02 73 00 15 00 00 00 01 00 02 74 c8 15 00 00 00 01 00 02 75 00 15 00 00 00 01 00 02 76 d8 15 00 00 00 01 00 02 77 00 15 00 00 00 01 00 02 78 e7 15 00 00 00 01 00 02 79 00 15 00 00 00 01 00 02 7a f5 15 00 00 00 01 00 02 7b 01 15 00 00 00 01 00 02 7c 01 15 00 00 00 01 00 02 7d 01 15 00 00 00 01 00 02 7e 0c 15 00 00 00 01 00 02 7f 01 15 00 00 00 01 00 02 80 18 15 00 00 00 01 00 02 81 01 15 00 00 00 01 00 02 82 22 15 00 00 00 01 00 02 83 01 15 00 00 00 01 00 02 84 45 15 00 00 00 01 00 02 85 01 15 00 00 00 01 00 02 86 61 15 00 00 00 01 00 02 87 01 15 00 00 00 01 00 02 88 90 15 01 00 00 01 00 02 89 01 15 00 00 00 01 00 02 8a b4 15 00 00 00 01 00 02 8b 01 15 00 00 00 01 00 02 8c ed 15 00 00 00 01 00 02 8d 02 15 00 00 00 01 00 02 8e 1c 15 00 00 00 01 00 02 8f 02 15 00 00 00 01 00 02 90 1d 15 00 00 00 01 00 02 91 02 15 00 00 00 01 00 02 92 4d 15 00 00 00 01 00 02 93 02 15 00 00 00 01 00 02 94 84 15 00 00 00 01 00 02 95 02 15 00 00 00 01 00 02 96 ad 15 00 00 00 01 00 02 97 02 15 00 00 00 01 00 02 98 e4 15 00 00 00 01 00 02 99 03 15 00 00 00 01 00 02 9a 0e 15 00 00 00 01 00 02 9b 03 15 00 00 00 01 00 02 9c 5b 15 00 00 00 01 00 02 9d 03 15 00 00 00 01 00 02 9e 65 15 00 00 00 01 00 02 9f 03 15 00 00 00 01 00 02 a0 6d 15 00 00 00 01 00 02 a2 03 15 00 00 00 01 00 02 a3 89 15 00 00 00 01 00 02 a4 03 15 00 00 00 01 00 02 a5 a3 15 00 00 00 01 00 02 a6 03 15 00 00 00 01 00 02 a7 c9 15 00 00 00 01 00 02 a9 03 15 00 00 00 10 00 02 aa dd 15 00 00 00 01 00 02 ab 03 15 00 00 00 01 00 02 ac f5 15 00 00 00 01 00 02 ad 03 15 00 00 00 01 00 02 ae ff 15 00 00 00 01 00 02 af 00 15 00 00 00 01 00 02 b0 bf 15 00 00 00 01 00 02 b1 00 15 00 00 00 01 00 02 b2 c8 15 00 00 00 01 00 02 b3 00 15 01 00 00 01 00 02 b4 d8 15 00 00 00 01 00 02 b5 00 15 00 00 00 01 00 02 b6 e7 15 00 00 00 01 00 02 b7 00 15 00 00 00 01 00 02 b8 f5 15 00 00 00 01 00 02 b9 01 15 00 00 00 01 00 02 ba 01 15 00 00 00 01 00 02 bb 01 15 00 00 00 01 00 02 bc 0c 15 00 00 00 01 00 02 bd 01 15 00 00 00 01 00 02 be 18 15 00 00 00 01 00 02 bf 01 15 00 00 00 01 00 02 c0 22 15 00 00 00 01 00 02 c1 01 15 00 00 00 01 00 02 c2 45 15 00 00 00 01 00 02 c3 01 15 00 00 00 01 00 02 c4 62 15 00 00 00 01 00 02 c5 01 15 00 00 00 01 00 02 c6 90 15 00 00 00 01 00 02 c7 01 15 01 00 00 01 00 02 c8 b4 15 00 00 00 01 00 02 c9 01 15 00 00 00 01 00 02 ca ed 15 00 00 00 01 00 02 cb 02 15 00 00 00 01 00 02 cc 1d 15 00 00 00 01 00 02 cd 02 15 00 00 00 01 00 02 ce 1e 15 00 00 00 01 00 02 cf 02 15 00 00 00 01 00 02 d0 4e 15 00 00 00 01 00 02 d1 02 15 00 00 00 01 00 02 d2 85 15 00 00 00 01 00 02 d3 02 15 00 00 00 01 00 02 d4 ad 15 00 00 00 01 00 02 d5 02 15 00 00 00 01 00 02 d6 e5 15 00 00 00 01 00 02 d7 03 15 00 00 00 01 00 02 d8 0e 15 00 00 00 01 00 02 d9 03 15 00 00 00 01 00 02 da 5c 15 00 00 00 01 00 02 db 03 15 00 00 00 01 00 02 dc 65 15 00 00 00 01 00 02 dd 03 15 00 00 00 01 00 02 de 6d 15 00 00 00 01 00 02 df 03 15 00 00 00 01 00 02 e0 89 15 00 00 00 01 00 02 e1 03 15 00 00 00 01 00 02 e2 a3 15 00 00 00 01 00 02 e3 03 15 00 00 00 01 00 02 e4 c9 15 00 00 00 01 00 02 e5 03 15 00 00 00 01 00 02 e6 dd 15 00 00 00 01 00 02 e7 03 15 00 00 00 01 00 02 e8 f5 15 00 00 00 01 00 02 e9 03 15 00 00 00 01 00 02 ea ff 15 01 00 00 01 00 02 ff 00];
		qcom,mdss-dsi-dispparam-cold-command-state = "dsi_hs_mode";
		qcom,mdss-dsi-dispparam-cabcon-command = [15 01 00 00 01 00 02 ff 00 15 00 00 00 01 00 02 53 2c 15 01 00 00 01 00 02 55 01];
		qcom,mdss-dsi-dispparam-cabcon-command-state = "dsi_hs_mode";
		qcom,mdss-dsi-dispparam-cabcguion-command = [15 01 00 00 01 00 02 ff 00 15 00 00 00 01 00 02 53 2c 15 01 00 00 01 00 02 55 01];
		qcom,mdss-dsi-dispparam-cabcguion-command-state = "dsi_hs_mode";
		qcom,mdss-dsi-dispparam-cabcstillon-command = [15 01 00 00 01 00 02 ff 00 15 00 00 00 01 00 02 53 2c 15 01 00 00 01 00 02 55 02];
		qcom,mdss-dsi-dispparam-cabcstillon-command-state = "dsi_hs_mode";
		qcom,mdss-dsi-dispparam-cabcmovieon-command = [15 01 00 00 01 00 02 ff 00 15 00 00 00 01 00 02 53 2c 15 01 00 00 01 00 02 55 03];
		qcom,mdss-dsi-dispparam-cabcmovieon-command-state = "dsi_hs_mode";
		qcom,mdss-dsi-dispparam-cabcoff-command = [15 01 00 00 01 00 02 ff 00 15 00 00 00 01 00 02 53 2c 15 01 00 00 01 00 02 55 00];
		qcom,mdss-dsi-dispparam-cabcoff-command-state = "dsi_hs_mode";
		qcom,mdss-dsi-dispparam-papermode-command = [15 01 00 00 01 00 02 ff 01 15 00 00 00 01 00 02 fb 01 15 00 00 00 01 00 02 75 00 15 00 00 00 01 00 02 76 00 15 00 00 00 01 00 02 77 00 15 00 00 00 01 00 02 78 1f 15 00 00 00 01 00 02 79 00 15 00 00 00 01 00 02 7a 46 15 00 00 00 01 00 02 7b 00 15 00 00 00 01 00 02 7c 69 15 00 00 00 01 00 02 7d 00 15 00 00 00 01 00 02 7e 84 15 00 00 00 01 00 02 7f 00 15 00 00 00 01 00 02 80 9b 15 00 00 00 01 00 02 81 00 15 00 00 00 01 00 02 82 b0 15 00 00 00 01 00 02 83 00 15 00 00 00 01 00 02 84 c3 15 00 00 00 01 00 02 85 00 15 00 00 00 01 00 02 86 d3 15 00 00 00 01 00 02 87 01 15 00 00 00 01 00 02 88 09 15 00 00 00 01 00 02 89 01 15 00 00 00 01 00 02 8a 31 15 00 00 00 01 00 02 8b 01 15 00 00 00 01 00 02 8c 6d 15 00 00 00 01 00 02 8d 01 15 00 00 00 01 00 02 8e 99 15 00 00 00 01 00 02 8f 01 15 00 00 00 01 00 02 90 db 15 00 00 00 01 00 02 91 02 15 00 00 00 01 00 02 92 0f 15 00 00 00 01 00 02 93 02 15 00 00 00 01 00 02 94 11 15 00 00 00 01 00 02 95 02 15 00 00 00 01 00 02 96 42 15 00 00 00 01 00 02 97 02 15 00 00 00 01 00 02 98 7d 15 00 00 00 01 00 02 99 02 15 01 00 00 01 00 02 9a a4 15 00 00 00 01 00 02 9b 02 15 00 00 00 01 00 02 9c d9 15 00 00 00 01 00 02 9d 02 15 00 00 00 01 00 02 9e ff 15 00 00 00 01 00 02 9f 03 15 00 00 00 01 00 02 a0 36 15 00 00 00 01 00 02 a2 03 15 00 00 00 01 00 02 a3 55 15 00 00 00 01 00 02 a4 03 15 00 00 00 01 00 02 a5 6d 15 00 00 00 01 00 02 a6 03 15 00 00 00 01 00 02 a7 89 15 00 00 00 01 00 02 a9 03 15 00 00 00 01 00 02 aa a3 15 00 00 00 01 00 02 ab 03 15 00 00 00 01 00 02 ac c9 15 00 00 00 01 00 02 ad 03 15 00 00 00 01 00 02 ae dd 15 00 00 00 01 00 02 af 03 15 00 00 00 01 00 02 b0 f5 15 00 00 00 01 00 02 b1 03 15 00 00 00 01 00 02 b2 ff 15 00 00 00 01 00 02 b3 00 15 00 00 00 01 00 02 b4 00 15 00 00 00 01 00 02 b5 00 15 00 00 00 01 00 02 b6 1f 15 00 00 00 01 00 02 b7 00 15 00 00 00 01 00 02 b8 46 15 00 00 00 01 00 02 b9 00 15 00 00 00 01 00 02 ba 69 15 00 00 00 01 00 02 bb 00 15 00 00 00 01 00 02 bc 84 15 00 00 00 01 00 02 bd 00 15 00 00 00 01 00 02 be 9b 15 00 00 00 01 00 02 bf 00 15 00 00 00 01 00 02 c0 b0 15 00 00 00 01 00 02 c1 00 15 00 00 00 01 00 02 c2 c3 15 00 00 00 01 00 02 c3 00 15 01 00 00 01 00 02 c4 d3 15 00 00 00 01 00 02 c5 01 15 00 00 00 01 00 02 c6 09 15 00 00 00 01 00 02 c7 01 15 00 00 00 01 00 02 c8 31 15 00 00 00 01 00 02 c9 01 15 00 00 00 01 00 02 ca 6d 15 00 00 00 01 00 02 cb 01 15 00 00 00 01 00 02 cc 9a 15 00 00 00 01 00 02 cd 01 15 00 00 00 01 00 02 ce dc 15 00 00 00 01 00 02 cf 02 15 00 00 00 01 00 02 d0 10 15 00 00 00 01 00 02 d1 02 15 00 00 00 01 00 02 d2 12 15 00 00 00 01 00 02 d3 02 15 00 00 00 01 00 02 d4 43 15 00 00 00 01 00 02 d5 02 15 00 00 00 01 00 02 d6 7d 15 00 00 00 01 00 02 d7 02 15 00 00 00 01 00 02 d8 a4 15 00 00 00 01 00 02 d9 02 15 00 00 00 01 00 02 da d9 15 00 00 00 01 00 02 db 02 15 00 00 00 01 00 02 dc ff 15 00 00 00 01 00 02 dd 03 15 00 00 00 01 00 02 de 36 15 00 00 00 01 00 02 df 03 15 00 00 00 01 00 02 e0 55 15 00 00 00 01 00 02 e1 03 15 00 00 00 01 00 02 e2 6d 15 00 00 00 01 00 02 e3 03 15 00 00 00 01 00 02 e4 89 15 00 00 00 01 00 02 e5 03 15 00 00 00 01 00 02 e6 a3 15 00 00 00 01 00 02 e7 03 15 00 00 00 01 00 02 e8 c9 15 00 00 00 01 00 02 e9 03 15 00 00 00 01 00 02 ea dd 15 00 00 00 01 00 02 eb 03 15 01 00 00 01 00 02 ec f5 15 00 00 00 01 00 02 ed 03 15 00 00 00 01 00 02 ee ff 15 00 00 00 01 00 02 ef 00 15 00 00 00 01 00 02 f0 66 15 00 00 00 01 00 02 f1 00 15 00 00 00 01 00 02 f2 75 15 00 00 00 01 00 02 f3 00 15 00 00 00 01 00 02 f4 90 15 00 00 00 01 00 02 f5 00 15 00 00 00 01 00 02 f6 a6 15 00 00 00 01 00 02 f7 00 15 00 00 00 01 00 02 f8 ba 15 00 00 00 01 00 02 f9 00 15 00 00 00 01 00 02 fa cb 15 01 00 00 01 00 02 ff 02 15 00 00 00 01 00 02 fb 01 15 00 00 00 01 00 02 00 00 15 00 00 00 01 00 02 01 db 15 00 00 00 01 00 02 02 00 15 00 00 00 01 00 02 03 ea 15 00 00 00 01 00 02 04 00 15 00 00 00 01 00 02 05 f7 15 00 00 00 01 00 02 06 01 15 00 00 00 01 00 02 07 24 15 00 00 00 01 00 02 08 01 15 00 00 00 01 00 02 09 46 15 00 00 00 01 00 02 0a 01 15 00 00 00 01 00 02 0b 7c 15 00 00 00 01 00 02 0c 01 15 01 00 00 01 00 02 0d a5 15 00 00 00 01 00 02 0e 01 15 00 00 00 01 00 02 0f e3 15 00 00 00 01 00 02 10 02 15 00 00 00 01 00 02 11 15 15 00 00 00 01 00 02 12 02 15 00 00 00 01 00 02 13 17 15 00 00 00 01 00 02 14 02 15 00 00 00 01 00 02 15 47 15 00 00 00 01 00 02 16 02 15 00 00 00 01 00 02 17 81 15 00 00 00 01 00 02 18 02 15 00 00 00 01 00 02 19 a8 15 00 00 00 01 00 02 1a 02 15 00 00 00 01 00 02 1b dd 15 00 00 00 01 00 02 1c 03 15 00 00 00 01 00 02 1d 03 15 00 00 00 01 00 02 1e 03 15 00 00 00 01 00 02 1f 3b 15 00 00 00 01 00 02 20 03 15 00 00 00 01 00 02 21 52 15 00 00 00 01 00 02 22 03 15 00 00 00 01 00 02 23 6d 15 00 00 00 01 00 02 24 03 15 00 00 00 01 00 02 25 89 15 00 00 00 01 00 02 26 03 15 00 00 00 01 00 02 27 a3 15 00 00 00 01 00 02 28 03 15 00 00 00 01 00 02 29 c9 15 00 00 00 01 00 02 2a 03 15 00 00 00 01 00 02 2b dd 15 00 00 00 01 00 02 2d 03 15 00 00 00 01 00 02 2f f5 15 00 00 00 01 00 02 30 03 15 00 00 00 01 00 02 31 ff 15 00 00 00 01 00 02 32 00 15 00 00 00 01 00 02 33 66 15 00 00 00 01 00 02 34 00 15 00 00 00 01 00 02 35 75 15 00 00 00 01 00 02 36 00 15 01 00 00 01 00 02 37 90 15 00 00 00 01 00 02 38 00 15 00 00 00 01 00 02 39 a6 15 00 00 00 01 00 02 3a 00 15 00 00 00 01 00 02 3b ba 15 00 00 00 01 00 02 3d 00 15 00 00 00 01 00 02 3f cb 15 00 00 00 01 00 02 40 00 15 00 00 00 01 00 02 41 db 15 00 00 00 01 00 02 42 00 15 00 00 00 01 00 02 43 ea 15 00 00 00 01 00 02 44 00 15 00 00 00 01 00 02 45 f7 15 00 00 00 01 00 02 46 01 15 00 00 00 01 00 02 47 24 15 00 00 00 01 00 02 48 01 15 00 00 00 01 00 02 49 46 15 00 00 00 01 00 02 4a 01 15 00 00 00 01 00 02 4b 7c 15 00 00 00 01 00 02 4c 01 15 00 00 00 01 00 02 4d a5 15 00 00 00 01 00 02 4e 01 15 00 00 00 01 00 02 4f e3 15 00 00 00 01 00 02 50 02 15 00 00 00 01 00 02 51 15 15 00 00 00 01 00 02 52 02 15 00 00 00 01 00 02 53 17 15 00 00 00 01 00 02 54 02 15 00 00 00 01 00 02 55 47 15 00 00 00 01 00 02 56 02 15 00 00 00 01 00 02 58 81 15 00 00 00 01 00 02 59 02 15 00 00 00 01 00 02 5a a8 15 00 00 00 01 00 02 5b 02 15 00 00 00 01 00 02 5c dd 15 00 00 00 01 00 02 5d 03 15 00 00 00 01 00 02 5e 03 15 00 00 00 01 00 02 5f 03 15 00 00 00 01 00 02 60 3b 15 00 00 00 01 00 02 61 03 15 01 00 00 01 00 02 62 52 15 00 00 00 01 00 02 63 03 15 00 00 00 01 00 02 64 6d 15 00 00 00 01 00 02 65 03 15 00 00 00 01 00 02 66 89 15 00 00 00 01 00 02 67 03 15 00 00 00 01 00 02 68 a3 15 00 00 00 01 00 02 69 03 15 00 00 00 01 00 02 6a c9 15 00 00 00 01 00 02 6b 03 15 00 00 00 01 00 02 6c dd 15 00 00 00 01 00 02 6d 03 15 00 00 00 01 00 02 6e f5 15 00 00 00 01 00 02 6f 03 15 00 00 00 01 00 02 70 ff 15 00 00 00 01 00 02 71 01 15 00 00 00 01 00 02 72 b6 15 00 00 00 01 00 02 73 01 15 00 00 00 01 00 02 74 b8 15 00 00 00 01 00 02 75 01 15 00 00 00 01 00 02 76 bb 15 00 00 00 01 00 02 77 01 15 00 00 00 01 00 02 78 bd 15 00 00 00 01 00 02 79 01 15 00 00 00 01 00 02 7a c0 15 00 00 00 01 00 02 7b 01 15 00 00 00 01 00 02 7c c2 15 00 00 00 01 00 02 7d 01 15 00 00 00 01 00 02 7e c5 15 00 00 00 01 00 02 7f 01 15 00 00 00 01 00 02 80 c8 15 00 00 00 01 00 02 81 01 15 00 00 00 01 00 02 82 ca 15 00 00 00 01 00 02 83 01 15 00 00 00 01 00 02 84 d5 15 00 00 00 01 00 02 85 01 15 00 00 00 01 00 02 86 df 15 00 00 00 01 00 02 87 01 15 00 00 00 01 00 02 88 f2 15 01 00 00 01 00 02 89 02 15 00 00 00 01 00 02 8a 04 15 00 00 00 01 00 02 8b 02 15 00 00 00 01 00 02 8c 26 15 00 00 00 01 00 02 8d 02 15 00 00 00 01 00 02 8e 4a 15 00 00 00 01 00 02 8f 02 15 00 00 00 01 00 02 90 4b 15 00 00 00 01 00 02 91 02 15 00 00 00 01 00 02 92 74 15 00 00 00 01 00 02 93 02 15 00 00 00 01 00 02 94 ac 15 00 00 00 01 00 02 95 02 15 00 00 00 01 00 02 96 d3 15 00 00 00 01 00 02 97 03 15 00 00 00 01 00 02 98 0b 15 00 00 00 01 00 02 99 03 15 00 00 00 01 00 02 9a 31 15 00 00 00 01 00 02 9b 03 15 00 00 00 01 00 02 9c 7e 15 00 00 00 01 00 02 9d 03 15 00 00 00 01 00 02 9e b0 15 00 00 00 01 00 02 9f 03 15 00 00 00 01 00 02 a0 db 15 00 00 00 01 00 02 a2 03 15 00 00 00 01 00 02 a3 e3 15 00 00 00 01 00 02 a4 03 15 00 00 00 01 00 02 a5 e7 15 00 00 00 01 00 02 a6 03 15 00 00 00 01 00 02 a7 ed 15 00 00 00 01 00 02 a9 03 15 00 00 00 10 00 02 aa f0 15 00 00 00 01 00 02 ab 03 15 00 00 00 01 00 02 ac f5 15 00 00 00 01 00 02 ad 03 15 00 00 00 01 00 02 ae ff 15 00 00 00 01 00 02 af 01 15 00 00 00 01 00 02 b0 b6 15 00 00 00 01 00 02 b1 01 15 00 00 00 01 00 02 b2 b8 15 00 00 00 01 00 02 b3 01 15 01 00 00 01 00 02 b4 bb 15 00 00 00 01 00 02 b5 01 15 00 00 00 01 00 02 b6 bd 15 00 00 00 01 00 02 b7 01 15 00 00 00 01 00 02 b8 c0 15 00 00 00 01 00 02 b9 01 15 00 00 00 01 00 02 ba c2 15 00 00 00 01 00 02 bb 01 15 00 00 00 01 00 02 bc c5 15 00 00 00 01 00 02 bd 01 15 00 00 00 01 00 02 be c8 15 00 00 00 01 00 02 bf 01 15 00 00 00 01 00 02 c0 ca 15 00 00 00 01 00 02 c1 01 15 00 00 00 01 00 02 c2 d5 15 00 00 00 01 00 02 c3 01 15 00 00 00 01 00 02 c4 df 15 00 00 00 01 00 02 c5 01 15 00 00 00 01 00 02 c6 f2 15 00 00 00 01 00 02 c7 02 15 00 00 00 01 00 02 c8 04 15 00 00 00 01 00 02 c9 02 15 00 00 00 01 00 02 ca 26 15 00 00 00 01 00 02 cb 02 15 00 00 00 01 00 02 cc 4a 15 00 00 00 01 00 02 cd 02 15 00 00 00 01 00 02 ce 4c 15 00 00 00 01 00 02 cf 02 15 00 00 00 01 00 02 d0 74 15 00 00 00 01 00 02 d1 02 15 00 00 00 01 00 02 d2 ac 15 00 00 00 01 00 02 d3 02 15 00 00 00 01 00 02 d4 d3 15 00 00 00 01 00 02 d5 03 15 00 00 00 01 00 02 d6 0b 15 00 00 00 01 00 02 d7 03 15 00 00 00 01 00 02 d8 31 15 00 00 00 01 00 02 d9 03 15 00 00 00 01 00 02 da 7e 15 00 00 00 01 00 02 db 03 15 01 00 00 01 00 02 dc b0 15 00 00 00 01 00 02 dd 03 15 00 00 00 01 00 02 de db 15 00 00 00 01 00 02 df 03 15 00 00 00 01 00 02 e0 e3 15 00 00 00 01 00 02 e1 03 15 00 00 00 01 00 02 e2 e7 15 00 00 00 01 00 02 e3 03 15 00 00 00 01 00 02 e4 ed 15 00 00 00 01 00 02 e5 03 15 00 00 00 01 00 02 e6 f0 15 00 00 00 01 00 02 e7 03 15 00 00 00 01 00 02 e8 f5 15 00 00 00 01 00 02 e9 03 15 00 00 00 01 00 02 ea ff 15 01 00 00 01 00 02 ff 00];
		qcom,mdss-dsi-dispparam-papermode-command-state = "dsi_hs_mode";
		qcom,mdss-dsi-dispparam-papermode1-command = [15 01 00 00 01 00 02 ff 01 15 00 00 00 01 00 02 fb 01 15 00 00 00 01 00 02 75 00 15 00 00 00 01 00 02 76 00 15 00 00 00 01 00 02 77 00 15 00 00 00 01 00 02 78 1f 15 00 00 00 01 00 02 79 00 15 00 00 00 01 00 02 7a 46 15 00 00 00 01 00 02 7b 00 15 00 00 00 01 00 02 7c 69 15 00 00 00 01 00 02 7d 00 15 00 00 00 01 00 02 7e 84 15 00 00 00 01 00 02 7f 00 15 00 00 00 01 00 02 80 9b 15 00 00 00 01 00 02 81 00 15 00 00 00 01 00 02 82 b0 15 00 00 00 01 00 02 83 00 15 00 00 00 01 00 02 84 c3 15 00 00 00 01 00 02 85 00 15 00 00 00 01 00 02 86 d3 15 00 00 00 01 00 02 87 01 15 00 00 00 01 00 02 88 09 15 00 00 00 01 00 02 89 01 15 00 00 00 01 00 02 8a 31 15 00 00 00 01 00 02 8b 01 15 00 00 00 01 00 02 8c 6d 15 00 00 00 01 00 02 8d 01 15 00 00 00 01 00 02 8e 99 15 00 00 00 01 00 02 8f 01 15 00 00 00 01 00 02 90 db 15 00 00 00 01 00 02 91 02 15 00 00 00 01 00 02 92 0f 15 00 00 00 01 00 02 93 02 15 00 00 00 01 00 02 94 11 15 00 00 00 01 00 02 95 02 15 00 00 00 01 00 02 96 42 15 00 00 00 01 00 02 97 02 15 00 00 00 01 00 02 98 7d 15 00 00 00 01 00 02 99 02 15 01 00 00 01 00 02 9a a4 15 00 00 00 01 00 02 9b 02 15 00 00 00 01 00 02 9c d9 15 00 00 00 01 00 02 9d 02 15 00 00 00 01 00 02 9e ff 15 00 00 00 01 00 02 9f 03 15 00 00 00 01 00 02 a0 36 15 00 00 00 01 00 02 a2 03 15 00 00 00 01 00 02 a3 55 15 00 00 00 01 00 02 a4 03 15 00 00 00 01 00 02 a5 6d 15 00 00 00 01 00 02 a6 03 15 00 00 00 01 00 02 a7 89 15 00 00 00 01 00 02 a9 03 15 00 00 00 01 00 02 aa a3 15 00 00 00 01 00 02 ab 03 15 00 00 00 01 00 02 ac c9 15 00 00 00 01 00 02 ad 03 15 00 00 00 01 00 02 ae dd 15 00 00 00 01 00 02 af 03 15 00 00 00 01 00 02 b0 f5 15 00 00 00 01 00 02 b1 03 15 00 00 00 01 00 02 b2 ff 15 00 00 00 01 00 02 b3 00 15 00 00 00 01 00 02 b4 00 15 00 00 00 01 00 02 b5 00 15 00 00 00 01 00 02 b6 1f 15 00 00 00 01 00 02 b7 00 15 00 00 00 01 00 02 b8 46 15 00 00 00 01 00 02 b9 00 15 00 00 00 01 00 02 ba 69 15 00 00 00 01 00 02 bb 00 15 00 00 00 01 00 02 bc 84 15 00 00 00 01 00 02 bd 00 15 00 00 00 01 00 02 be 9b 15 00 00 00 01 00 02 bf 00 15 00 00 00 01 00 02 c0 b0 15 00 00 00 01 00 02 c1 00 15 00 00 00 01 00 02 c2 c3 15 00 00 00 01 00 02 c3 00 15 01 00 00 01 00 02 c4 d3 15 00 00 00 01 00 02 c5 01 15 00 00 00 01 00 02 c6 09 15 00 00 00 01 00 02 c7 01 15 00 00 00 01 00 02 c8 31 15 00 00 00 01 00 02 c9 01 15 00 00 00 01 00 02 ca 6d 15 00 00 00 01 00 02 cb 01 15 00 00 00 01 00 02 cc 9a 15 00 00 00 01 00 02 cd 01 15 00 00 00 01 00 02 ce dc 15 00 00 00 01 00 02 cf 02 15 00 00 00 01 00 02 d0 10 15 00 00 00 01 00 02 d1 02 15 00 00 00 01 00 02 d2 12 15 00 00 00 01 00 02 d3 02 15 00 00 00 01 00 02 d4 43 15 00 00 00 01 00 02 d5 02 15 00 00 00 01 00 02 d6 7d 15 00 00 00 01 00 02 d7 02 15 00 00 00 01 00 02 d8 a4 15 00 00 00 01 00 02 d9 02 15 00 00 00 01 00 02 da d9 15 00 00 00 01 00 02 db 02 15 00 00 00 01 00 02 dc ff 15 00 00 00 01 00 02 dd 03 15 00 00 00 01 00 02 de 36 15 00 00 00 01 00 02 df 03 15 00 00 00 01 00 02 e0 55 15 00 00 00 01 00 02 e1 03 15 00 00 00 01 00 02 e2 6d 15 00 00 00 01 00 02 e3 03 15 00 00 00 01 00 02 e4 89 15 00 00 00 01 00 02 e5 03 15 00 00 00 01 00 02 e6 a3 15 00 00 00 01 00 02 e7 03 15 00 00 00 01 00 02 e8 c9 15 00 00 00 01 00 02 e9 03 15 00 00 00 01 00 02 ea dd 15 00 00 00 01 00 02 eb 03 15 01 00 00 01 00 02 ec f5 15 00 00 00 01 00 02 ed 03 15 00 00 00 01 00 02 ee ff 15 00 00 00 01 00 02 ef 00 15 00 00 00 01 00 02 f0 66 15 00 00 00 01 00 02 f1 00 15 00 00 00 01 00 02 f2 75 15 00 00 00 01 00 02 f3 00 15 00 00 00 01 00 02 f4 90 15 00 00 00 01 00 02 f5 00 15 00 00 00 01 00 02 f6 a6 15 00 00 00 01 00 02 f7 00 15 00 00 00 01 00 02 f8 ba 15 00 00 00 01 00 02 f9 00 15 00 00 00 01 00 02 fa cb 15 01 00 00 01 00 02 ff 02 15 00 00 00 01 00 02 fb 01 15 00 00 00 01 00 02 00 00 15 00 00 00 01 00 02 01 db 15 00 00 00 01 00 02 02 00 15 00 00 00 01 00 02 03 ea 15 00 00 00 01 00 02 04 00 15 00 00 00 01 00 02 05 f7 15 00 00 00 01 00 02 06 01 15 00 00 00 01 00 02 07 24 15 00 00 00 01 00 02 08 01 15 00 00 00 01 00 02 09 46 15 00 00 00 01 00 02 0a 01 15 00 00 00 01 00 02 0b 7c 15 00 00 00 01 00 02 0c 01 15 01 00 00 01 00 02 0d a5 15 00 00 00 01 00 02 0e 01 15 00 00 00 01 00 02 0f e3 15 00 00 00 01 00 02 10 02 15 00 00 00 01 00 02 11 15 15 00 00 00 01 00 02 12 02 15 00 00 00 01 00 02 13 17 15 00 00 00 01 00 02 14 02 15 00 00 00 01 00 02 15 47 15 00 00 00 01 00 02 16 02 15 00 00 00 01 00 02 17 81 15 00 00 00 01 00 02 18 02 15 00 00 00 01 00 02 19 a8 15 00 00 00 01 00 02 1a 02 15 00 00 00 01 00 02 1b dd 15 00 00 00 01 00 02 1c 03 15 00 00 00 01 00 02 1d 03 15 00 00 00 01 00 02 1e 03 15 00 00 00 01 00 02 1f 3b 15 00 00 00 01 00 02 20 03 15 00 00 00 01 00 02 21 52 15 00 00 00 01 00 02 22 03 15 00 00 00 01 00 02 23 6d 15 00 00 00 01 00 02 24 03 15 00 00 00 01 00 02 25 89 15 00 00 00 01 00 02 26 03 15 00 00 00 01 00 02 27 a3 15 00 00 00 01 00 02 28 03 15 00 00 00 01 00 02 29 c9 15 00 00 00 01 00 02 2a 03 15 00 00 00 01 00 02 2b dd 15 00 00 00 01 00 02 2d 03 15 00 00 00 01 00 02 2f f5 15 00 00 00 01 00 02 30 03 15 00 00 00 01 00 02 31 ff 15 00 00 00 01 00 02 32 00 15 00 00 00 01 00 02 33 66 15 00 00 00 01 00 02 34 00 15 00 00 00 01 00 02 35 75 15 00 00 00 01 00 02 36 00 15 01 00 00 01 00 02 37 90 15 00 00 00 01 00 02 38 00 15 00 00 00 01 00 02 39 a6 15 00 00 00 01 00 02 3a 00 15 00 00 00 01 00 02 3b ba 15 00 00 00 01 00 02 3d 00 15 00 00 00 01 00 02 3f cb 15 00 00 00 01 00 02 40 00 15 00 00 00 01 00 02 41 db 15 00 00 00 01 00 02 42 00 15 00 00 00 01 00 02 43 ea 15 00 00 00 01 00 02 44 00 15 00 00 00 01 00 02 45 f7 15 00 00 00 01 00 02 46 01 15 00 00 00 01 00 02 47 24 15 00 00 00 01 00 02 48 01 15 00 00 00 01 00 02 49 46 15 00 00 00 01 00 02 4a 01 15 00 00 00 01 00 02 4b 7c 15 00 00 00 01 00 02 4c 01 15 00 00 00 01 00 02 4d a5 15 00 00 00 01 00 02 4e 01 15 00 00 00 01 00 02 4f e3 15 00 00 00 01 00 02 50 02 15 00 00 00 01 00 02 51 15 15 00 00 00 01 00 02 52 02 15 00 00 00 01 00 02 53 17 15 00 00 00 01 00 02 54 02 15 00 00 00 01 00 02 55 47 15 00 00 00 01 00 02 56 02 15 00 00 00 01 00 02 58 81 15 00 00 00 01 00 02 59 02 15 00 00 00 01 00 02 5a a8 15 00 00 00 01 00 02 5b 02 15 00 00 00 01 00 02 5c dd 15 00 00 00 01 00 02 5d 03 15 00 00 00 01 00 02 5e 03 15 00 00 00 01 00 02 5f 03 15 00 00 00 01 00 02 60 3b 15 00 00 00 01 00 02 61 03 15 01 00 00 01 00 02 62 52 15 00 00 00 01 00 02 63 03 15 00 00 00 01 00 02 64 6d 15 00 00 00 01 00 02 65 03 15 00 00 00 01 00 02 66 89 15 00 00 00 01 00 02 67 03 15 00 00 00 01 00 02 68 a3 15 00 00 00 01 00 02 69 03 15 00 00 00 01 00 02 6a c9 15 00 00 00 01 00 02 6b 03 15 00 00 00 01 00 02 6c dd 15 00 00 00 01 00 02 6d 03 15 00 00 00 01 00 02 6e f5 15 00 00 00 01 00 02 6f 03 15 00 00 00 01 00 02 70 ff 15 00 00 00 01 00 02 71 01 15 00 00 00 01 00 02 72 4f 15 00 00 00 01 00 02 73 01 15 00 00 00 01 00 02 74 52 15 00 00 00 01 00 02 75 01 15 00 00 00 01 00 02 76 58 15 00 00 00 01 00 02 77 01 15 00 00 00 01 00 02 78 5e 15 00 00 00 01 00 02 79 01 15 00 00 00 01 00 02 7a 64 15 00 00 00 01 00 02 7b 01 15 00 00 00 01 00 02 7c 6a 15 00 00 00 01 00 02 7d 01 15 00 00 00 01 00 02 7e 6f 15 00 00 00 01 00 02 7f 01 15 00 00 00 01 00 02 80 74 15 00 00 00 01 00 02 81 01 15 00 00 00 01 00 02 82 79 15 00 00 00 01 00 02 83 01 15 00 00 00 01 00 02 84 8c 15 00 00 00 01 00 02 85 01 15 00 00 00 01 00 02 86 9d 15 00 00 00 01 00 02 87 01 15 00 00 00 01 00 02 88 bb 15 01 00 00 01 00 02 89 01 15 00 00 00 01 00 02 8a d6 15 00 00 00 01 00 02 8b 02 15 00 00 00 01 00 02 8c 03 15 00 00 00 01 00 02 8d 02 15 00 00 00 01 00 02 8e 2d 15 00 00 00 01 00 02 8f 02 15 00 00 00 01 00 02 90 2f 15 00 00 00 01 00 02 91 02 15 00 00 00 01 00 02 92 5a 15 00 00 00 01 00 02 93 02 15 00 00 00 01 00 02 94 93 15 00 00 00 01 00 02 95 02 15 00 00 00 01 00 02 96 bb 15 00 00 00 01 00 02 97 02 15 00 00 00 01 00 02 98 f1 15 00 00 00 01 00 02 99 03 15 00 00 00 01 00 02 9a 1b 15 00 00 00 01 00 02 9b 03 15 00 00 00 01 00 02 9c 6a 15 00 00 00 01 00 02 9d 03 15 00 00 00 01 00 02 9e d6 15 00 00 00 01 00 02 9f 03 15 00 00 00 01 00 02 a0 db 15 00 00 00 01 00 02 a2 03 15 00 00 00 01 00 02 a3 e3 15 00 00 00 01 00 02 a4 03 15 00 00 00 01 00 02 a5 e7 15 00 00 00 01 00 02 a6 03 15 00 00 00 01 00 02 a7 ed 15 00 00 00 01 00 02 a9 03 15 00 00 00 10 00 02 aa f0 15 00 00 00 01 00 02 ab 03 15 00 00 00 01 00 02 ac f5 15 00 00 00 01 00 02 ad 03 15 00 00 00 01 00 02 ae ff 15 00 00 00 01 00 02 af 01 15 00 00 00 01 00 02 b0 4f 15 00 00 00 01 00 02 b1 01 15 00 00 00 01 00 02 b2 52 15 00 00 00 01 00 02 b3 01 15 01 00 00 01 00 02 b4 58 15 00 00 00 01 00 02 b5 01 15 00 00 00 01 00 02 b6 5e 15 00 00 00 01 00 02 b7 01 15 00 00 00 01 00 02 b8 64 15 00 00 00 01 00 02 b9 01 15 00 00 00 01 00 02 ba 6a 15 00 00 00 01 00 02 bb 01 15 00 00 00 01 00 02 bc 6f 15 00 00 00 01 00 02 bd 01 15 00 00 00 01 00 02 be 74 15 00 00 00 01 00 02 bf 01 15 00 00 00 01 00 02 c0 79 15 00 00 00 01 00 02 c1 01 15 00 00 00 01 00 02 c2 8c 15 00 00 00 01 00 02 c3 01 15 00 00 00 01 00 02 c4 9d 15 00 00 00 01 00 02 c5 01 15 00 00 00 01 00 02 c6 bb 15 00 00 00 01 00 02 c7 01 15 00 00 00 01 00 02 c8 d6 15 00 00 00 01 00 02 c9 02 15 00 00 00 01 00 02 ca 03 15 00 00 00 01 00 02 cb 02 15 00 00 00 01 00 02 cc 2c 15 00 00 00 01 00 02 cd 02 15 00 00 00 01 00 02 ce 2e 15 00 00 00 01 00 02 cf 02 15 00 00 00 01 00 02 d0 5b 15 00 00 00 01 00 02 d1 02 15 00 00 00 01 00 02 d2 94 15 00 00 00 01 00 02 d3 02 15 00 00 00 01 00 02 d4 ba 15 00 00 00 01 00 02 d5 02 15 00 00 00 01 00 02 d6 f1 15 00 00 00 01 00 02 d7 03 15 00 00 00 01 00 02 d8 1b 15 00 00 00 01 00 02 d9 03 15 00 00 00 01 00 02 da 6a 15 00 00 00 01 00 02 db 03 15 01 00 00 01 00 02 dc d6 15 00 00 00 01 00 02 dd 03 15 00 00 00 01 00 02 de db 15 00 00 00 01 00 02 df 03 15 00 00 00 01 00 02 e0 e3 15 00 00 00 01 00 02 e1 03 15 00 00 00 01 00 02 e2 e7 15 00 00 00 01 00 02 e3 03 15 00 00 00 01 00 02 e4 ed 15 00 00 00 01 00 02 e5 03 15 00 00 00 01 00 02 e6 f0 15 00 00 00 01 00 02 e7 03 15 00 00 00 01 00 02 e8 f5 15 00 00 00 01 00 02 e9 03 15 00 00 00 01 00 02 ea ff 15 01 00 00 01 00 02 ff 00];
		qcom,mdss-dsi-dispparam-papermode1-command-state = "dsi_hs_mode";
		qcom,mdss-dsi-dispparam-papermode2-command = [15 01 00 00 01 00 02 ff 01 15 00 00 00 01 00 02 fb 01 15 00 00 00 01 00 02 75 00 15 00 00 00 01 00 02 76 00 15 00 00 00 01 00 02 77 00 15 00 00 00 01 00 02 78 1f 15 00 00 00 01 00 02 79 00 15 00 00 00 01 00 02 7a 46 15 00 00 00 01 00 02 7b 00 15 00 00 00 01 00 02 7c 69 15 00 00 00 01 00 02 7d 00 15 00 00 00 01 00 02 7e 84 15 00 00 00 01 00 02 7f 00 15 00 00 00 01 00 02 80 9b 15 00 00 00 01 00 02 81 00 15 00 00 00 01 00 02 82 b0 15 00 00 00 01 00 02 83 00 15 00 00 00 01 00 02 84 c3 15 00 00 00 01 00 02 85 00 15 00 00 00 01 00 02 86 d3 15 00 00 00 01 00 02 87 01 15 00 00 00 01 00 02 88 09 15 00 00 00 01 00 02 89 01 15 00 00 00 01 00 02 8a 31 15 00 00 00 01 00 02 8b 01 15 00 00 00 01 00 02 8c 6d 15 00 00 00 01 00 02 8d 01 15 00 00 00 01 00 02 8e 99 15 00 00 00 01 00 02 8f 01 15 00 00 00 01 00 02 90 db 15 00 00 00 01 00 02 91 02 15 00 00 00 01 00 02 92 0f 15 00 00 00 01 00 02 93 02 15 00 00 00 01 00 02 94 11 15 00 00 00 01 00 02 95 02 15 00 00 00 01 00 02 96 42 15 00 00 00 01 00 02 97 02 15 00 00 00 01 00 02 98 7d 15 00 00 00 01 00 02 99 02 15 01 00 00 01 00 02 9a a4 15 00 00 00 01 00 02 9b 02 15 00 00 00 01 00 02 9c d9 15 00 00 00 01 00 02 9d 02 15 00 00 00 01 00 02 9e ff 15 00 00 00 01 00 02 9f 03 15 00 00 00 01 00 02 a0 36 15 00 00 00 01 00 02 a2 03 15 00 00 00 01 00 02 a3 55 15 00 00 00 01 00 02 a4 03 15 00 00 00 01 00 02 a5 6d 15 00 00 00 01 00 02 a6 03 15 00 00 00 01 00 02 a7 89 15 00 00 00 01 00 02 a9 03 15 00 00 00 01 00 02 aa a3 15 00 00 00 01 00 02 ab 03 15 00 00 00 01 00 02 ac c9 15 00 00 00 01 00 02 ad 03 15 00 00 00 01 00 02 ae dd 15 00 00 00 01 00 02 af 03 15 00 00 00 01 00 02 b0 f5 15 00 00 00 01 00 02 b1 03 15 00 00 00 01 00 02 b2 ff 15 00 00 00 01 00 02 b3 00 15 00 00 00 01 00 02 b4 00 15 00 00 00 01 00 02 b5 00 15 00 00 00 01 00 02 b6 1f 15 00 00 00 01 00 02 b7 00 15 00 00 00 01 00 02 b8 46 15 00 00 00 01 00 02 b9 00 15 00 00 00 01 00 02 ba 69 15 00 00 00 01 00 02 bb 00 15 00 00 00 01 00 02 bc 84 15 00 00 00 01 00 02 bd 00 15 00 00 00 01 00 02 be 9b 15 00 00 00 01 00 02 bf 00 15 00 00 00 01 00 02 c0 b0 15 00 00 00 01 00 02 c1 00 15 00 00 00 01 00 02 c2 c3 15 00 00 00 01 00 02 c3 00 15 01 00 00 01 00 02 c4 d3 15 00 00 00 01 00 02 c5 01 15 00 00 00 01 00 02 c6 09 15 00 00 00 01 00 02 c7 01 15 00 00 00 01 00 02 c8 31 15 00 00 00 01 00 02 c9 01 15 00 00 00 01 00 02 ca 6d 15 00 00 00 01 00 02 cb 01 15 00 00 00 01 00 02 cc 9a 15 00 00 00 01 00 02 cd 01 15 00 00 00 01 00 02 ce dc 15 00 00 00 01 00 02 cf 02 15 00 00 00 01 00 02 d0 10 15 00 00 00 01 00 02 d1 02 15 00 00 00 01 00 02 d2 12 15 00 00 00 01 00 02 d3 02 15 00 00 00 01 00 02 d4 43 15 00 00 00 01 00 02 d5 02 15 00 00 00 01 00 02 d6 7d 15 00 00 00 01 00 02 d7 02 15 00 00 00 01 00 02 d8 a4 15 00 00 00 01 00 02 d9 02 15 00 00 00 01 00 02 da d9 15 00 00 00 01 00 02 db 02 15 00 00 00 01 00 02 dc ff 15 00 00 00 01 00 02 dd 03 15 00 00 00 01 00 02 de 36 15 00 00 00 01 00 02 df 03 15 00 00 00 01 00 02 e0 55 15 00 00 00 01 00 02 e1 03 15 00 00 00 01 00 02 e2 6d 15 00 00 00 01 00 02 e3 03 15 00 00 00 01 00 02 e4 89 15 00 00 00 01 00 02 e5 03 15 00 00 00 01 00 02 e6 a3 15 00 00 00 01 00 02 e7 03 15 00 00 00 01 00 02 e8 c9 15 00 00 00 01 00 02 e9 03 15 00 00 00 01 00 02 ea dd 15 00 00 00 01 00 02 eb 03 15 01 00 00 01 00 02 ec f5 15 00 00 00 01 00 02 ed 03 15 00 00 00 01 00 02 ee ff 15 00 00 00 01 00 02 ef 00 15 00 00 00 01 00 02 f0 66 15 00 00 00 01 00 02 f1 00 15 00 00 00 01 00 02 f2 75 15 00 00 00 01 00 02 f3 00 15 00 00 00 01 00 02 f4 90 15 00 00 00 01 00 02 f5 00 15 00 00 00 01 00 02 f6 a6 15 00 00 00 01 00 02 f7 00 15 00 00 00 01 00 02 f8 ba 15 00 00 00 01 00 02 f9 00 15 00 00 00 01 00 02 fa cb 15 01 00 00 01 00 02 ff 02 15 00 00 00 01 00 02 fb 01 15 00 00 00 01 00 02 00 00 15 00 00 00 01 00 02 01 db 15 00 00 00 01 00 02 02 00 15 00 00 00 01 00 02 03 ea 15 00 00 00 01 00 02 04 00 15 00 00 00 01 00 02 05 f7 15 00 00 00 01 00 02 06 01 15 00 00 00 01 00 02 07 24 15 00 00 00 01 00 02 08 01 15 00 00 00 01 00 02 09 46 15 00 00 00 01 00 02 0a 01 15 00 00 00 01 00 02 0b 7c 15 00 00 00 01 00 02 0c 01 15 01 00 00 01 00 02 0d a5 15 00 00 00 01 00 02 0e 01 15 00 00 00 01 00 02 0f e3 15 00 00 00 01 00 02 10 02 15 00 00 00 01 00 02 11 15 15 00 00 00 01 00 02 12 02 15 00 00 00 01 00 02 13 17 15 00 00 00 01 00 02 14 02 15 00 00 00 01 00 02 15 47 15 00 00 00 01 00 02 16 02 15 00 00 00 01 00 02 17 81 15 00 00 00 01 00 02 18 02 15 00 00 00 01 00 02 19 a8 15 00 00 00 01 00 02 1a 02 15 00 00 00 01 00 02 1b dd 15 00 00 00 01 00 02 1c 03 15 00 00 00 01 00 02 1d 03 15 00 00 00 01 00 02 1e 03 15 00 00 00 01 00 02 1f 3b 15 00 00 00 01 00 02 20 03 15 00 00 00 01 00 02 21 52 15 00 00 00 01 00 02 22 03 15 00 00 00 01 00 02 23 6d 15 00 00 00 01 00 02 24 03 15 00 00 00 01 00 02 25 89 15 00 00 00 01 00 02 26 03 15 00 00 00 01 00 02 27 a3 15 00 00 00 01 00 02 28 03 15 00 00 00 01 00 02 29 c9 15 00 00 00 01 00 02 2a 03 15 00 00 00 01 00 02 2b dd 15 00 00 00 01 00 02 2d 03 15 00 00 00 01 00 02 2f f5 15 00 00 00 01 00 02 30 03 15 00 00 00 01 00 02 31 ff 15 00 00 00 01 00 02 32 00 15 00 00 00 01 00 02 33 66 15 00 00 00 01 00 02 34 00 15 00 00 00 01 00 02 35 75 15 00 00 00 01 00 02 36 00 15 01 00 00 01 00 02 37 90 15 00 00 00 01 00 02 38 00 15 00 00 00 01 00 02 39 a6 15 00 00 00 01 00 02 3a 00 15 00 00 00 01 00 02 3b ba 15 00 00 00 01 00 02 3d 00 15 00 00 00 01 00 02 3f cb 15 00 00 00 01 00 02 40 00 15 00 00 00 01 00 02 41 db 15 00 00 00 01 00 02 42 00 15 00 00 00 01 00 02 43 ea 15 00 00 00 01 00 02 44 00 15 00 00 00 01 00 02 45 f7 15 00 00 00 01 00 02 46 01 15 00 00 00 01 00 02 47 24 15 00 00 00 01 00 02 48 01 15 00 00 00 01 00 02 49 46 15 00 00 00 01 00 02 4a 01 15 00 00 00 01 00 02 4b 7c 15 00 00 00 01 00 02 4c 01 15 00 00 00 01 00 02 4d a5 15 00 00 00 01 00 02 4e 01 15 00 00 00 01 00 02 4f e3 15 00 00 00 01 00 02 50 02 15 00 00 00 01 00 02 51 15 15 00 00 00 01 00 02 52 02 15 00 00 00 01 00 02 53 17 15 00 00 00 01 00 02 54 02 15 00 00 00 01 00 02 55 47 15 00 00 00 01 00 02 56 02 15 00 00 00 01 00 02 58 81 15 00 00 00 01 00 02 59 02 15 00 00 00 01 00 02 5a a8 15 00 00 00 01 00 02 5b 02 15 00 00 00 01 00 02 5c dd 15 00 00 00 01 00 02 5d 03 15 00 00 00 01 00 02 5e 03 15 00 00 00 01 00 02 5f 03 15 00 00 00 01 00 02 60 3b 15 00 00 00 01 00 02 61 03 15 01 00 00 01 00 02 62 52 15 00 00 00 01 00 02 63 03 15 00 00 00 01 00 02 64 6d 15 00 00 00 01 00 02 65 03 15 00 00 00 01 00 02 66 89 15 00 00 00 01 00 02 67 03 15 00 00 00 01 00 02 68 a3 15 00 00 00 01 00 02 69 03 15 00 00 00 01 00 02 6a c9 15 00 00 00 01 00 02 6b 03 15 00 00 00 01 00 02 6c dd 15 00 00 00 01 00 02 6d 03 15 00 00 00 01 00 02 6e f5 15 00 00 00 01 00 02 6f 03 15 00 00 00 01 00 02 70 ff 15 00 00 00 01 00 02 71 01 15 00 00 00 01 00 02 72 4f 15 00 00 00 01 00 02 73 01 15 00 00 00 01 00 02 74 52 15 00 00 00 01 00 02 75 01 15 00 00 00 01 00 02 76 58 15 00 00 00 01 00 02 77 01 15 00 00 00 01 00 02 78 5e 15 00 00 00 01 00 02 79 01 15 00 00 00 01 00 02 7a 64 15 00 00 00 01 00 02 7b 01 15 00 00 00 01 00 02 7c 6a 15 00 00 00 01 00 02 7d 01 15 00 00 00 01 00 02 7e 6f 15 00 00 00 01 00 02 7f 01 15 00 00 00 01 00 02 80 74 15 00 00 00 01 00 02 81 01 15 00 00 00 01 00 02 82 79 15 00 00 00 01 00 02 83 01 15 00 00 00 01 00 02 84 8c 15 00 00 00 01 00 02 85 01 15 00 00 00 01 00 02 86 9d 15 00 00 00 01 00 02 87 01 15 00 00 00 01 00 02 88 bb 15 01 00 00 01 00 02 89 01 15 00 00 00 01 00 02 8a d6 15 00 00 00 01 00 02 8b 02 15 00 00 00 01 00 02 8c 03 15 00 00 00 01 00 02 8d 02 15 00 00 00 01 00 02 8e 2d 15 00 00 00 01 00 02 8f 02 15 00 00 00 01 00 02 90 2f 15 00 00 00 01 00 02 91 02 15 00 00 00 01 00 02 92 5a 15 00 00 00 01 00 02 93 02 15 00 00 00 01 00 02 94 93 15 00 00 00 01 00 02 95 02 15 00 00 00 01 00 02 96 bb 15 00 00 00 01 00 02 97 02 15 00 00 00 01 00 02 98 f1 15 00 00 00 01 00 02 99 03 15 00 00 00 01 00 02 9a 1b 15 00 00 00 01 00 02 9b 03 15 00 00 00 01 00 02 9c 6a 15 00 00 00 01 00 02 9d 03 15 00 00 00 01 00 02 9e d6 15 00 00 00 01 00 02 9f 03 15 00 00 00 01 00 02 a0 db 15 00 00 00 01 00 02 a2 03 15 00 00 00 01 00 02 a3 e3 15 00 00 00 01 00 02 a4 03 15 00 00 00 01 00 02 a5 e7 15 00 00 00 01 00 02 a6 03 15 00 00 00 01 00 02 a7 ed 15 00 00 00 01 00 02 a9 03 15 00 00 00 10 00 02 aa f0 15 00 00 00 01 00 02 ab 03 15 00 00 00 01 00 02 ac f5 15 00 00 00 01 00 02 ad 03 15 00 00 00 01 00 02 ae ff 15 00 00 00 01 00 02 af 01 15 00 00 00 01 00 02 b0 4f 15 00 00 00 01 00 02 b1 01 15 00 00 00 01 00 02 b2 52 15 00 00 00 01 00 02 b3 01 15 01 00 00 01 00 02 b4 58 15 00 00 00 01 00 02 b5 01 15 00 00 00 01 00 02 b6 5e 15 00 00 00 01 00 02 b7 01 15 00 00 00 01 00 02 b8 64 15 00 00 00 01 00 02 b9 01 15 00 00 00 01 00 02 ba 6a 15 00 00 00 01 00 02 bb 01 15 00 00 00 01 00 02 bc 6f 15 00 00 00 01 00 02 bd 01 15 00 00 00 01 00 02 be 74 15 00 00 00 01 00 02 bf 01 15 00 00 00 01 00 02 c0 79 15 00 00 00 01 00 02 c1 01 15 00 00 00 01 00 02 c2 8c 15 00 00 00 01 00 02 c3 01 15 00 00 00 01 00 02 c4 9d 15 00 00 00 01 00 02 c5 01 15 00 00 00 01 00 02 c6 bb 15 00 00 00 01 00 02 c7 01 15 00 00 00 01 00 02 c8 d6 15 00 00 00 01 00 02 c9 02 15 00 00 00 01 00 02 ca 03 15 00 00 00 01 00 02 cb 02 15 00 00 00 01 00 02 cc 2c 15 00 00 00 01 00 02 cd 02 15 00 00 00 01 00 02 ce 2e 15 00 00 00 01 00 02 cf 02 15 00 00 00 01 00 02 d0 5b 15 00 00 00 01 00 02 d1 02 15 00 00 00 01 00 02 d2 94 15 00 00 00 01 00 02 d3 02 15 00 00 00 01 00 02 d4 ba 15 00 00 00 01 00 02 d5 02 15 00 00 00 01 00 02 d6 f1 15 00 00 00 01 00 02 d7 03 15 00 00 00 01 00 02 d8 1b 15 00 00 00 01 00 02 d9 03 15 00 00 00 01 00 02 da 6a 15 00 00 00 01 00 02 db 03 15 01 00 00 01 00 02 dc d6 15 00 00 00 01 00 02 dd 03 15 00 00 00 01 00 02 de db 15 00 00 00 01 00 02 df 03 15 00 00 00 01 00 02 e0 e3 15 00 00 00 01 00 02 e1 03 15 00 00 00 01 00 02 e2 e7 15 00 00 00 01 00 02 e3 03 15 00 00 00 01 00 02 e4 ed 15 00 00 00 01 00 02 e5 03 15 00 00 00 01 00 02 e6 f0 15 00 00 00 01 00 02 e7 03 15 00 00 00 01 00 02 e8 f5 15 00 00 00 01 00 02 e9 03 15 00 00 00 01 00 02 ea ff 15 01 00 00 01 00 02 ff 00];
		qcom,mdss-dsi-dispparam-papermode2-command-state = "dsi_hs_mode";
		qcom,mdss-dsi-dispparam-papermode3-command = [15 01 00 00 01 00 02 ff 01 15 00 00 00 01 00 02 fb 01 15 00 00 00 01 00 02 75 00 15 00 00 00 01 00 02 76 00 15 00 00 00 01 00 02 77 00 15 00 00 00 01 00 02 78 1f 15 00 00 00 01 00 02 79 00 15 00 00 00 01 00 02 7a 46 15 00 00 00 01 00 02 7b 00 15 00 00 00 01 00 02 7c 69 15 00 00 00 01 00 02 7d 00 15 00 00 00 01 00 02 7e 84 15 00 00 00 01 00 02 7f 00 15 00 00 00 01 00 02 80 9b 15 00 00 00 01 00 02 81 00 15 00 00 00 01 00 02 82 b0 15 00 00 00 01 00 02 83 00 15 00 00 00 01 00 02 84 c3 15 00 00 00 01 00 02 85 00 15 00 00 00 01 00 02 86 d3 15 00 00 00 01 00 02 87 01 15 00 00 00 01 00 02 88 09 15 00 00 00 01 00 02 89 01 15 00 00 00 01 00 02 8a 31 15 00 00 00 01 00 02 8b 01 15 00 00 00 01 00 02 8c 6d 15 00 00 00 01 00 02 8d 01 15 00 00 00 01 00 02 8e 99 15 00 00 00 01 00 02 8f 01 15 00 00 00 01 00 02 90 db 15 00 00 00 01 00 02 91 02 15 00 00 00 01 00 02 92 0f 15 00 00 00 01 00 02 93 02 15 00 00 00 01 00 02 94 11 15 00 00 00 01 00 02 95 02 15 00 00 00 01 00 02 96 42 15 00 00 00 01 00 02 97 02 15 00 00 00 01 00 02 98 7d 15 00 00 00 01 00 02 99 02 15 01 00 00 01 00 02 9a a4 15 00 00 00 01 00 02 9b 02 15 00 00 00 01 00 02 9c d9 15 00 00 00 01 00 02 9d 02 15 00 00 00 01 00 02 9e ff 15 00 00 00 01 00 02 9f 03 15 00 00 00 01 00 02 a0 36 15 00 00 00 01 00 02 a2 03 15 00 00 00 01 00 02 a3 55 15 00 00 00 01 00 02 a4 03 15 00 00 00 01 00 02 a5 6d 15 00 00 00 01 00 02 a6 03 15 00 00 00 01 00 02 a7 89 15 00 00 00 01 00 02 a9 03 15 00 00 00 01 00 02 aa a3 15 00 00 00 01 00 02 ab 03 15 00 00 00 01 00 02 ac c9 15 00 00 00 01 00 02 ad 03 15 00 00 00 01 00 02 ae dd 15 00 00 00 01 00 02 af 03 15 00 00 00 01 00 02 b0 f5 15 00 00 00 01 00 02 b1 03 15 00 00 00 01 00 02 b2 ff 15 00 00 00 01 00 02 b3 00 15 00 00 00 01 00 02 b4 00 15 00 00 00 01 00 02 b5 00 15 00 00 00 01 00 02 b6 1f 15 00 00 00 01 00 02 b7 00 15 00 00 00 01 00 02 b8 46 15 00 00 00 01 00 02 b9 00 15 00 00 00 01 00 02 ba 69 15 00 00 00 01 00 02 bb 00 15 00 00 00 01 00 02 bc 84 15 00 00 00 01 00 02 bd 00 15 00 00 00 01 00 02 be 9b 15 00 00 00 01 00 02 bf 00 15 00 00 00 01 00 02 c0 b0 15 00 00 00 01 00 02 c1 00 15 00 00 00 01 00 02 c2 c3 15 00 00 00 01 00 02 c3 00 15 01 00 00 01 00 02 c4 d3 15 00 00 00 01 00 02 c5 01 15 00 00 00 01 00 02 c6 09 15 00 00 00 01 00 02 c7 01 15 00 00 00 01 00 02 c8 31 15 00 00 00 01 00 02 c9 01 15 00 00 00 01 00 02 ca 6d 15 00 00 00 01 00 02 cb 01 15 00 00 00 01 00 02 cc 9a 15 00 00 00 01 00 02 cd 01 15 00 00 00 01 00 02 ce dc 15 00 00 00 01 00 02 cf 02 15 00 00 00 01 00 02 d0 10 15 00 00 00 01 00 02 d1 02 15 00 00 00 01 00 02 d2 12 15 00 00 00 01 00 02 d3 02 15 00 00 00 01 00 02 d4 43 15 00 00 00 01 00 02 d5 02 15 00 00 00 01 00 02 d6 7d 15 00 00 00 01 00 02 d7 02 15 00 00 00 01 00 02 d8 a4 15 00 00 00 01 00 02 d9 02 15 00 00 00 01 00 02 da d9 15 00 00 00 01 00 02 db 02 15 00 00 00 01 00 02 dc ff 15 00 00 00 01 00 02 dd 03 15 00 00 00 01 00 02 de 36 15 00 00 00 01 00 02 df 03 15 00 00 00 01 00 02 e0 55 15 00 00 00 01 00 02 e1 03 15 00 00 00 01 00 02 e2 6d 15 00 00 00 01 00 02 e3 03 15 00 00 00 01 00 02 e4 89 15 00 00 00 01 00 02 e5 03 15 00 00 00 01 00 02 e6 a3 15 00 00 00 01 00 02 e7 03 15 00 00 00 01 00 02 e8 c9 15 00 00 00 01 00 02 e9 03 15 00 00 00 01 00 02 ea dd 15 00 00 00 01 00 02 eb 03 15 01 00 00 01 00 02 ec f5 15 00 00 00 01 00 02 ed 03 15 00 00 00 01 00 02 ee ff 15 00 00 00 01 00 02 ef 00 15 00 00 00 01 00 02 f0 66 15 00 00 00 01 00 02 f1 00 15 00 00 00 01 00 02 f2 75 15 00 00 00 01 00 02 f3 00 15 00 00 00 01 00 02 f4 90 15 00 00 00 01 00 02 f5 00 15 00 00 00 01 00 02 f6 a6 15 00 00 00 01 00 02 f7 00 15 00 00 00 01 00 02 f8 ba 15 00 00 00 01 00 02 f9 00 15 00 00 00 01 00 02 fa cb 15 01 00 00 01 00 02 ff 02 15 00 00 00 01 00 02 fb 01 15 00 00 00 01 00 02 00 00 15 00 00 00 01 00 02 01 db 15 00 00 00 01 00 02 02 00 15 00 00 00 01 00 02 03 ea 15 00 00 00 01 00 02 04 00 15 00 00 00 01 00 02 05 f7 15 00 00 00 01 00 02 06 01 15 00 00 00 01 00 02 07 24 15 00 00 00 01 00 02 08 01 15 00 00 00 01 00 02 09 46 15 00 00 00 01 00 02 0a 01 15 00 00 00 01 00 02 0b 7c 15 00 00 00 01 00 02 0c 01 15 01 00 00 01 00 02 0d a5 15 00 00 00 01 00 02 0e 01 15 00 00 00 01 00 02 0f e3 15 00 00 00 01 00 02 10 02 15 00 00 00 01 00 02 11 15 15 00 00 00 01 00 02 12 02 15 00 00 00 01 00 02 13 17 15 00 00 00 01 00 02 14 02 15 00 00 00 01 00 02 15 47 15 00 00 00 01 00 02 16 02 15 00 00 00 01 00 02 17 81 15 00 00 00 01 00 02 18 02 15 00 00 00 01 00 02 19 a8 15 00 00 00 01 00 02 1a 02 15 00 00 00 01 00 02 1b dd 15 00 00 00 01 00 02 1c 03 15 00 00 00 01 00 02 1d 03 15 00 00 00 01 00 02 1e 03 15 00 00 00 01 00 02 1f 3b 15 00 00 00 01 00 02 20 03 15 00 00 00 01 00 02 21 52 15 00 00 00 01 00 02 22 03 15 00 00 00 01 00 02 23 6d 15 00 00 00 01 00 02 24 03 15 00 00 00 01 00 02 25 89 15 00 00 00 01 00 02 26 03 15 00 00 00 01 00 02 27 a3 15 00 00 00 01 00 02 28 03 15 00 00 00 01 00 02 29 c9 15 00 00 00 01 00 02 2a 03 15 00 00 00 01 00 02 2b dd 15 00 00 00 01 00 02 2d 03 15 00 00 00 01 00 02 2f f5 15 00 00 00 01 00 02 30 03 15 00 00 00 01 00 02 31 ff 15 00 00 00 01 00 02 32 00 15 00 00 00 01 00 02 33 66 15 00 00 00 01 00 02 34 00 15 00 00 00 01 00 02 35 75 15 00 00 00 01 00 02 36 00 15 01 00 00 01 00 02 37 90 15 00 00 00 01 00 02 38 00 15 00 00 00 01 00 02 39 a6 15 00 00 00 01 00 02 3a 00 15 00 00 00 01 00 02 3b ba 15 00 00 00 01 00 02 3d 00 15 00 00 00 01 00 02 3f cb 15 00 00 00 01 00 02 40 00 15 00 00 00 01 00 02 41 db 15 00 00 00 01 00 02 42 00 15 00 00 00 01 00 02 43 ea 15 00 00 00 01 00 02 44 00 15 00 00 00 01 00 02 45 f7 15 00 00 00 01 00 02 46 01 15 00 00 00 01 00 02 47 24 15 00 00 00 01 00 02 48 01 15 00 00 00 01 00 02 49 46 15 00 00 00 01 00 02 4a 01 15 00 00 00 01 00 02 4b 7c 15 00 00 00 01 00 02 4c 01 15 00 00 00 01 00 02 4d a5 15 00 00 00 01 00 02 4e 01 15 00 00 00 01 00 02 4f e3 15 00 00 00 01 00 02 50 02 15 00 00 00 01 00 02 51 15 15 00 00 00 01 00 02 52 02 15 00 00 00 01 00 02 53 17 15 00 00 00 01 00 02 54 02 15 00 00 00 01 00 02 55 47 15 00 00 00 01 00 02 56 02 15 00 00 00 01 00 02 58 81 15 00 00 00 01 00 02 59 02 15 00 00 00 01 00 02 5a a8 15 00 00 00 01 00 02 5b 02 15 00 00 00 01 00 02 5c dd 15 00 00 00 01 00 02 5d 03 15 00 00 00 01 00 02 5e 03 15 00 00 00 01 00 02 5f 03 15 00 00 00 01 00 02 60 3b 15 00 00 00 01 00 02 61 03 15 01 00 00 01 00 02 62 52 15 00 00 00 01 00 02 63 03 15 00 00 00 01 00 02 64 6d 15 00 00 00 01 00 02 65 03 15 00 00 00 01 00 02 66 89 15 00 00 00 01 00 02 67 03 15 00 00 00 01 00 02 68 a3 15 00 00 00 01 00 02 69 03 15 00 00 00 01 00 02 6a c9 15 00 00 00 01 00 02 6b 03 15 00 00 00 01 00 02 6c dd 15 00 00 00 01 00 02 6d 03 15 00 00 00 01 00 02 6e f5 15 00 00 00 01 00 02 6f 03 15 00 00 00 01 00 02 70 ff 15 00 00 00 01 00 02 71 01 15 00 00 00 01 00 02 72 77 15 00 00 00 01 00 02 73 01 15 00 00 00 01 00 02 74 79 15 00 00 00 01 00 02 75 01 15 00 00 00 01 00 02 76 7e 15 00 00 00 01 00 02 77 01 15 00 00 00 01 00 02 78 82 15 00 00 00 01 00 02 79 01 15 00 00 00 01 00 02 7a 87 15 00 00 00 01 00 02 7b 01 15 00 00 00 01 00 02 7c 8b 15 00 00 00 01 00 02 7d 01 15 00 00 00 01 00 02 7e 8f 15 00 00 00 01 00 02 7f 01 15 00 00 00 01 00 02 80 94 15 00 00 00 01 00 02 81 01 15 00 00 00 01 00 02 82 98 15 00 00 00 01 00 02 83 01 15 00 00 00 01 00 02 84 a7 15 00 00 00 01 00 02 85 01 15 00 00 00 01 00 02 86 b5 15 00 00 00 01 00 02 87 01 15 00 00 00 01 00 02 88 cf 15 01 00 00 01 00 02 89 01 15 00 00 00 01 00 02 8a e6 15 00 00 00 01 00 02 8b 02 15 00 00 00 01 00 02 8c 0e 15 00 00 00 01 00 02 8d 02 15 00 00 00 01 00 02 8e 36 15 00 00 00 01 00 02 8f 02 15 00 00 00 01 00 02 90 37 15 00 00 00 01 00 02 91 02 15 00 00 00 01 00 02 92 62 15 00 00 00 01 00 02 93 02 15 00 00 00 01 00 02 94 9b 15 00 00 00 01 00 02 95 02 15 00 00 00 01 00 02 96 c2 15 00 00 00 01 00 02 97 02 15 00 00 00 01 00 02 98 f9 15 00 00 00 01 00 02 99 03 15 00 00 00 01 00 02 9a 24 15 00 00 00 01 00 02 9b 03 15 00 00 00 01 00 02 9c 7e 15 00 00 00 01 00 02 9d 03 15 00 00 00 01 00 02 9e b0 15 00 00 00 01 00 02 9f 03 15 00 00 00 01 00 02 a0 db 15 00 00 00 01 00 02 a2 03 15 00 00 00 01 00 02 a3 e3 15 00 00 00 01 00 02 a4 03 15 00 00 00 01 00 02 a5 e7 15 00 00 00 01 00 02 a6 03 15 00 00 00 01 00 02 a7 ed 15 00 00 00 01 00 02 a9 03 15 00 00 00 10 00 02 aa f0 15 00 00 00 01 00 02 ab 03 15 00 00 00 01 00 02 ac f5 15 00 00 00 01 00 02 ad 03 15 00 00 00 01 00 02 ae ff 15 00 00 00 01 00 02 af 01 15 00 00 00 01 00 02 b0 77 15 00 00 00 01 00 02 b1 01 15 00 00 00 01 00 02 b2 79 15 00 00 00 01 00 02 b3 01 15 01 00 00 01 00 02 b4 7e 15 00 00 00 01 00 02 b5 01 15 00 00 00 01 00 02 b6 83 15 00 00 00 01 00 02 b7 01 15 00 00 00 01 00 02 b8 87 15 00 00 00 01 00 02 b9 01 15 00 00 00 01 00 02 ba 8b 15 00 00 00 01 00 02 bb 01 15 00 00 00 01 00 02 bc 8f 15 00 00 00 01 00 02 bd 01 15 00 00 00 01 00 02 be 94 15 00 00 00 01 00 02 bf 01 15 00 00 00 01 00 02 c0 98 15 00 00 00 01 00 02 c1 01 15 00 00 00 01 00 02 c2 a7 15 00 00 00 01 00 02 c3 01 15 00 00 00 01 00 02 c4 b5 15 00 00 00 01 00 02 c5 01 15 00 00 00 01 00 02 c6 cf 15 00 00 00 01 00 02 c7 01 15 00 00 00 01 00 02 c8 e6 15 00 00 00 01 00 02 c9 02 15 00 00 00 01 00 02 ca 0e 15 00 00 00 01 00 02 cb 02 15 00 00 00 01 00 02 cc 36 15 00 00 00 01 00 02 cd 02 15 00 00 00 01 00 02 ce 38 15 00 00 00 01 00 02 cf 02 15 00 00 00 01 00 02 d0 62 15 00 00 00 01 00 02 d1 02 15 00 00 00 01 00 02 d2 9b 15 00 00 00 01 00 02 d3 02 15 00 00 00 01 00 02 d4 c2 15 00 00 00 01 00 02 d5 02 15 00 00 00 01 00 02 d6 f9 15 00 00 00 01 00 02 d7 03 15 00 00 00 01 00 02 d8 24 15 00 00 00 01 00 02 d9 03 15 00 00 00 01 00 02 da 7e 15 00 00 00 01 00 02 db 03 15 01 00 00 01 00 02 dc b0 15 00 00 00 01 00 02 dd 03 15 00 00 00 01 00 02 de db 15 00 00 00 01 00 02 df 03 15 00 00 00 01 00 02 e0 e3 15 00 00 00 01 00 02 e1 03 15 00 00 00 01 00 02 e2 e7 15 00 00 00 01 00 02 e3 03 15 00 00 00 01 00 02 e4 ed 15 00 00 00 01 00 02 e5 03 15 00 00 00 01 00 02 e6 f0 15 00 00 00 01 00 02 e7 03 15 00 00 00 01 00 02 e8 f5 15 00 00 00 01 00 02 e9 03 15 00 00 00 01 00 02 ea ff 15 01 00 00 01 00 02 ff 00];
		qcom,mdss-dsi-dispparam-papermode3-command-state = "dsi_hs_mode";
		qcom,mdss-dsi-dispparam-papermode4-command = [15 01 00 00 01 00 02 ff 01 15 00 00 00 01 00 02 fb 01 15 00 00 00 01 00 02 75 00 15 00 00 00 01 00 02 76 00 15 00 00 00 01 00 02 77 00 15 00 00 00 01 00 02 78 1f 15 00 00 00 01 00 02 79 00 15 00 00 00 01 00 02 7a 46 15 00 00 00 01 00 02 7b 00 15 00 00 00 01 00 02 7c 69 15 00 00 00 01 00 02 7d 00 15 00 00 00 01 00 02 7e 84 15 00 00 00 01 00 02 7f 00 15 00 00 00 01 00 02 80 9b 15 00 00 00 01 00 02 81 00 15 00 00 00 01 00 02 82 b0 15 00 00 00 01 00 02 83 00 15 00 00 00 01 00 02 84 c3 15 00 00 00 01 00 02 85 00 15 00 00 00 01 00 02 86 d3 15 00 00 00 01 00 02 87 01 15 00 00 00 01 00 02 88 09 15 00 00 00 01 00 02 89 01 15 00 00 00 01 00 02 8a 31 15 00 00 00 01 00 02 8b 01 15 00 00 00 01 00 02 8c 6d 15 00 00 00 01 00 02 8d 01 15 00 00 00 01 00 02 8e 99 15 00 00 00 01 00 02 8f 01 15 00 00 00 01 00 02 90 db 15 00 00 00 01 00 02 91 02 15 00 00 00 01 00 02 92 0f 15 00 00 00 01 00 02 93 02 15 00 00 00 01 00 02 94 11 15 00 00 00 01 00 02 95 02 15 00 00 00 01 00 02 96 42 15 00 00 00 01 00 02 97 02 15 00 00 00 01 00 02 98 7d 15 00 00 00 01 00 02 99 02 15 01 00 00 01 00 02 9a a4 15 00 00 00 01 00 02 9b 02 15 00 00 00 01 00 02 9c d9 15 00 00 00 01 00 02 9d 02 15 00 00 00 01 00 02 9e ff 15 00 00 00 01 00 02 9f 03 15 00 00 00 01 00 02 a0 36 15 00 00 00 01 00 02 a2 03 15 00 00 00 01 00 02 a3 55 15 00 00 00 01 00 02 a4 03 15 00 00 00 01 00 02 a5 6d 15 00 00 00 01 00 02 a6 03 15 00 00 00 01 00 02 a7 89 15 00 00 00 01 00 02 a9 03 15 00 00 00 01 00 02 aa a3 15 00 00 00 01 00 02 ab 03 15 00 00 00 01 00 02 ac c9 15 00 00 00 01 00 02 ad 03 15 00 00 00 01 00 02 ae dd 15 00 00 00 01 00 02 af 03 15 00 00 00 01 00 02 b0 f5 15 00 00 00 01 00 02 b1 03 15 00 00 00 01 00 02 b2 ff 15 00 00 00 01 00 02 b3 00 15 00 00 00 01 00 02 b4 00 15 00 00 00 01 00 02 b5 00 15 00 00 00 01 00 02 b6 1f 15 00 00 00 01 00 02 b7 00 15 00 00 00 01 00 02 b8 46 15 00 00 00 01 00 02 b9 00 15 00 00 00 01 00 02 ba 69 15 00 00 00 01 00 02 bb 00 15 00 00 00 01 00 02 bc 84 15 00 00 00 01 00 02 bd 00 15 00 00 00 01 00 02 be 9b 15 00 00 00 01 00 02 bf 00 15 00 00 00 01 00 02 c0 b0 15 00 00 00 01 00 02 c1 00 15 00 00 00 01 00 02 c2 c3 15 00 00 00 01 00 02 c3 00 15 01 00 00 01 00 02 c4 d3 15 00 00 00 01 00 02 c5 01 15 00 00 00 01 00 02 c6 09 15 00 00 00 01 00 02 c7 01 15 00 00 00 01 00 02 c8 31 15 00 00 00 01 00 02 c9 01 15 00 00 00 01 00 02 ca 6d 15 00 00 00 01 00 02 cb 01 15 00 00 00 01 00 02 cc 9a 15 00 00 00 01 00 02 cd 01 15 00 00 00 01 00 02 ce dc 15 00 00 00 01 00 02 cf 02 15 00 00 00 01 00 02 d0 10 15 00 00 00 01 00 02 d1 02 15 00 00 00 01 00 02 d2 12 15 00 00 00 01 00 02 d3 02 15 00 00 00 01 00 02 d4 43 15 00 00 00 01 00 02 d5 02 15 00 00 00 01 00 02 d6 7d 15 00 00 00 01 00 02 d7 02 15 00 00 00 01 00 02 d8 a4 15 00 00 00 01 00 02 d9 02 15 00 00 00 01 00 02 da d9 15 00 00 00 01 00 02 db 02 15 00 00 00 01 00 02 dc ff 15 00 00 00 01 00 02 dd 03 15 00 00 00 01 00 02 de 36 15 00 00 00 01 00 02 df 03 15 00 00 00 01 00 02 e0 55 15 00 00 00 01 00 02 e1 03 15 00 00 00 01 00 02 e2 6d 15 00 00 00 01 00 02 e3 03 15 00 00 00 01 00 02 e4 89 15 00 00 00 01 00 02 e5 03 15 00 00 00 01 00 02 e6 a3 15 00 00 00 01 00 02 e7 03 15 00 00 00 01 00 02 e8 c9 15 00 00 00 01 00 02 e9 03 15 00 00 00 01 00 02 ea dd 15 00 00 00 01 00 02 eb 03 15 01 00 00 01 00 02 ec f5 15 00 00 00 01 00 02 ed 03 15 00 00 00 01 00 02 ee ff 15 00 00 00 01 00 02 ef 00 15 00 00 00 01 00 02 f0 66 15 00 00 00 01 00 02 f1 00 15 00 00 00 01 00 02 f2 75 15 00 00 00 01 00 02 f3 00 15 00 00 00 01 00 02 f4 90 15 00 00 00 01 00 02 f5 00 15 00 00 00 01 00 02 f6 a6 15 00 00 00 01 00 02 f7 00 15 00 00 00 01 00 02 f8 ba 15 00 00 00 01 00 02 f9 00 15 00 00 00 01 00 02 fa cb 15 01 00 00 01 00 02 ff 02 15 00 00 00 01 00 02 fb 01 15 00 00 00 01 00 02 00 00 15 00 00 00 01 00 02 01 db 15 00 00 00 01 00 02 02 00 15 00 00 00 01 00 02 03 ea 15 00 00 00 01 00 02 04 00 15 00 00 00 01 00 02 05 f7 15 00 00 00 01 00 02 06 01 15 00 00 00 01 00 02 07 24 15 00 00 00 01 00 02 08 01 15 00 00 00 01 00 02 09 46 15 00 00 00 01 00 02 0a 01 15 00 00 00 01 00 02 0b 7c 15 00 00 00 01 00 02 0c 01 15 01 00 00 01 00 02 0d a5 15 00 00 00 01 00 02 0e 01 15 00 00 00 01 00 02 0f e3 15 00 00 00 01 00 02 10 02 15 00 00 00 01 00 02 11 15 15 00 00 00 01 00 02 12 02 15 00 00 00 01 00 02 13 17 15 00 00 00 01 00 02 14 02 15 00 00 00 01 00 02 15 47 15 00 00 00 01 00 02 16 02 15 00 00 00 01 00 02 17 81 15 00 00 00 01 00 02 18 02 15 00 00 00 01 00 02 19 a8 15 00 00 00 01 00 02 1a 02 15 00 00 00 01 00 02 1b dd 15 00 00 00 01 00 02 1c 03 15 00 00 00 01 00 02 1d 03 15 00 00 00 01 00 02 1e 03 15 00 00 00 01 00 02 1f 3b 15 00 00 00 01 00 02 20 03 15 00 00 00 01 00 02 21 52 15 00 00 00 01 00 02 22 03 15 00 00 00 01 00 02 23 6d 15 00 00 00 01 00 02 24 03 15 00 00 00 01 00 02 25 89 15 00 00 00 01 00 02 26 03 15 00 00 00 01 00 02 27 a3 15 00 00 00 01 00 02 28 03 15 00 00 00 01 00 02 29 c9 15 00 00 00 01 00 02 2a 03 15 00 00 00 01 00 02 2b dd 15 00 00 00 01 00 02 2d 03 15 00 00 00 01 00 02 2f f5 15 00 00 00 01 00 02 30 03 15 00 00 00 01 00 02 31 ff 15 00 00 00 01 00 02 32 00 15 00 00 00 01 00 02 33 66 15 00 00 00 01 00 02 34 00 15 00 00 00 01 00 02 35 75 15 00 00 00 01 00 02 36 00 15 01 00 00 01 00 02 37 90 15 00 00 00 01 00 02 38 00 15 00 00 00 01 00 02 39 a6 15 00 00 00 01 00 02 3a 00 15 00 00 00 01 00 02 3b ba 15 00 00 00 01 00 02 3d 00 15 00 00 00 01 00 02 3f cb 15 00 00 00 01 00 02 40 00 15 00 00 00 01 00 02 41 db 15 00 00 00 01 00 02 42 00 15 00 00 00 01 00 02 43 ea 15 00 00 00 01 00 02 44 00 15 00 00 00 01 00 02 45 f7 15 00 00 00 01 00 02 46 01 15 00 00 00 01 00 02 47 24 15 00 00 00 01 00 02 48 01 15 00 00 00 01 00 02 49 46 15 00 00 00 01 00 02 4a 01 15 00 00 00 01 00 02 4b 7c 15 00 00 00 01 00 02 4c 01 15 00 00 00 01 00 02 4d a5 15 00 00 00 01 00 02 4e 01 15 00 00 00 01 00 02 4f e3 15 00 00 00 01 00 02 50 02 15 00 00 00 01 00 02 51 15 15 00 00 00 01 00 02 52 02 15 00 00 00 01 00 02 53 17 15 00 00 00 01 00 02 54 02 15 00 00 00 01 00 02 55 47 15 00 00 00 01 00 02 56 02 15 00 00 00 01 00 02 58 81 15 00 00 00 01 00 02 59 02 15 00 00 00 01 00 02 5a a8 15 00 00 00 01 00 02 5b 02 15 00 00 00 01 00 02 5c dd 15 00 00 00 01 00 02 5d 03 15 00 00 00 01 00 02 5e 03 15 00 00 00 01 00 02 5f 03 15 00 00 00 01 00 02 60 3b 15 00 00 00 01 00 02 61 03 15 01 00 00 01 00 02 62 52 15 00 00 00 01 00 02 63 03 15 00 00 00 01 00 02 64 6d 15 00 00 00 01 00 02 65 03 15 00 00 00 01 00 02 66 89 15 00 00 00 01 00 02 67 03 15 00 00 00 01 00 02 68 a3 15 00 00 00 01 00 02 69 03 15 00 00 00 01 00 02 6a c9 15 00 00 00 01 00 02 6b 03 15 00 00 00 01 00 02 6c dd 15 00 00 00 01 00 02 6d 03 15 00 00 00 01 00 02 6e f5 15 00 00 00 01 00 02 6f 03 15 00 00 00 01 00 02 70 ff 15 00 00 00 01 00 02 71 01 15 00 00 00 01 00 02 72 77 15 00 00 00 01 00 02 73 01 15 00 00 00 01 00 02 74 79 15 00 00 00 01 00 02 75 01 15 00 00 00 01 00 02 76 7e 15 00 00 00 01 00 02 77 01 15 00 00 00 01 00 02 78 82 15 00 00 00 01 00 02 79 01 15 00 00 00 01 00 02 7a 87 15 00 00 00 01 00 02 7b 01 15 00 00 00 01 00 02 7c 8b 15 00 00 00 01 00 02 7d 01 15 00 00 00 01 00 02 7e 8f 15 00 00 00 01 00 02 7f 01 15 00 00 00 01 00 02 80 94 15 00 00 00 01 00 02 81 01 15 00 00 00 01 00 02 82 98 15 00 00 00 01 00 02 83 01 15 00 00 00 01 00 02 84 a7 15 00 00 00 01 00 02 85 01 15 00 00 00 01 00 02 86 b5 15 00 00 00 01 00 02 87 01 15 00 00 00 01 00 02 88 cf 15 01 00 00 01 00 02 89 01 15 00 00 00 01 00 02 8a e6 15 00 00 00 01 00 02 8b 02 15 00 00 00 01 00 02 8c 0e 15 00 00 00 01 00 02 8d 02 15 00 00 00 01 00 02 8e 36 15 00 00 00 01 00 02 8f 02 15 00 00 00 01 00 02 90 37 15 00 00 00 01 00 02 91 02 15 00 00 00 01 00 02 92 62 15 00 00 00 01 00 02 93 02 15 00 00 00 01 00 02 94 9b 15 00 00 00 01 00 02 95 02 15 00 00 00 01 00 02 96 c2 15 00 00 00 01 00 02 97 02 15 00 00 00 01 00 02 98 f9 15 00 00 00 01 00 02 99 03 15 00 00 00 01 00 02 9a 24 15 00 00 00 01 00 02 9b 03 15 00 00 00 01 00 02 9c 7e 15 00 00 00 01 00 02 9d 03 15 00 00 00 01 00 02 9e b0 15 00 00 00 01 00 02 9f 03 15 00 00 00 01 00 02 a0 db 15 00 00 00 01 00 02 a2 03 15 00 00 00 01 00 02 a3 e3 15 00 00 00 01 00 02 a4 03 15 00 00 00 01 00 02 a5 e7 15 00 00 00 01 00 02 a6 03 15 00 00 00 01 00 02 a7 ed 15 00 00 00 01 00 02 a9 03 15 00 00 00 10 00 02 aa f0 15 00 00 00 01 00 02 ab 03 15 00 00 00 01 00 02 ac f5 15 00 00 00 01 00 02 ad 03 15 00 00 00 01 00 02 ae ff 15 00 00 00 01 00 02 af 01 15 00 00 00 01 00 02 b0 77 15 00 00 00 01 00 02 b1 01 15 00 00 00 01 00 02 b2 79 15 00 00 00 01 00 02 b3 01 15 01 00 00 01 00 02 b4 7e 15 00 00 00 01 00 02 b5 01 15 00 00 00 01 00 02 b6 83 15 00 00 00 01 00 02 b7 01 15 00 00 00 01 00 02 b8 87 15 00 00 00 01 00 02 b9 01 15 00 00 00 01 00 02 ba 8b 15 00 00 00 01 00 02 bb 01 15 00 00 00 01 00 02 bc 8f 15 00 00 00 01 00 02 bd 01 15 00 00 00 01 00 02 be 94 15 00 00 00 01 00 02 bf 01 15 00 00 00 01 00 02 c0 98 15 00 00 00 01 00 02 c1 01 15 00 00 00 01 00 02 c2 a7 15 00 00 00 01 00 02 c3 01 15 00 00 00 01 00 02 c4 b5 15 00 00 00 01 00 02 c5 01 15 00 00 00 01 00 02 c6 cf 15 00 00 00 01 00 02 c7 01 15 00 00 00 01 00 02 c8 e6 15 00 00 00 01 00 02 c9 02 15 00 00 00 01 00 02 ca 0e 15 00 00 00 01 00 02 cb 02 15 00 00 00 01 00 02 cc 36 15 00 00 00 01 00 02 cd 02 15 00 00 00 01 00 02 ce 38 15 00 00 00 01 00 02 cf 02 15 00 00 00 01 00 02 d0 62 15 00 00 00 01 00 02 d1 02 15 00 00 00 01 00 02 d2 9b 15 00 00 00 01 00 02 d3 02 15 00 00 00 01 00 02 d4 c2 15 00 00 00 01 00 02 d5 02 15 00 00 00 01 00 02 d6 f9 15 00 00 00 01 00 02 d7 03 15 00 00 00 01 00 02 d8 24 15 00 00 00 01 00 02 d9 03 15 00 00 00 01 00 02 da 7e 15 00 00 00 01 00 02 db 03 15 01 00 00 01 00 02 dc b0 15 00 00 00 01 00 02 dd 03 15 00 00 00 01 00 02 de db 15 00 00 00 01 00 02 df 03 15 00 00 00 01 00 02 e0 e3 15 00 00 00 01 00 02 e1 03 15 00 00 00 01 00 02 e2 e7 15 00 00 00 01 00 02 e3 03 15 00 00 00 01 00 02 e4 ed 15 00 00 00 01 00 02 e5 03 15 00 00 00 01 00 02 e6 f0 15 00 00 00 01 00 02 e7 03 15 00 00 00 01 00 02 e8 f5 15 00 00 00 01 00 02 e9 03 15 00 00 00 01 00 02 ea ff 15 01 00 00 01 00 02 ff 00];
		qcom,mdss-dsi-dispparam-papermode4-command-state = "dsi_hs_mode";
		qcom,mdss-dsi-dispparam-papermode5-command = [15 01 00 00 01 00 02 ff 01 15 00 00 00 01 00 02 fb 01 15 00 00 00 01 00 02 75 00 15 00 00 00 01 00 02 76 00 15 00 00 00 01 00 02 77 00 15 00 00 00 01 00 02 78 1f 15 00 00 00 01 00 02 79 00 15 00 00 00 01 00 02 7a 46 15 00 00 00 01 00 02 7b 00 15 00 00 00 01 00 02 7c 69 15 00 00 00 01 00 02 7d 00 15 00 00 00 01 00 02 7e 84 15 00 00 00 01 00 02 7f 00 15 00 00 00 01 00 02 80 9b 15 00 00 00 01 00 02 81 00 15 00 00 00 01 00 02 82 b0 15 00 00 00 01 00 02 83 00 15 00 00 00 01 00 02 84 c3 15 00 00 00 01 00 02 85 00 15 00 00 00 01 00 02 86 d3 15 00 00 00 01 00 02 87 01 15 00 00 00 01 00 02 88 09 15 00 00 00 01 00 02 89 01 15 00 00 00 01 00 02 8a 31 15 00 00 00 01 00 02 8b 01 15 00 00 00 01 00 02 8c 6d 15 00 00 00 01 00 02 8d 01 15 00 00 00 01 00 02 8e 99 15 00 00 00 01 00 02 8f 01 15 00 00 00 01 00 02 90 db 15 00 00 00 01 00 02 91 02 15 00 00 00 01 00 02 92 0f 15 00 00 00 01 00 02 93 02 15 00 00 00 01 00 02 94 11 15 00 00 00 01 00 02 95 02 15 00 00 00 01 00 02 96 42 15 00 00 00 01 00 02 97 02 15 00 00 00 01 00 02 98 7d 15 00 00 00 01 00 02 99 02 15 01 00 00 01 00 02 9a a4 15 00 00 00 01 00 02 9b 02 15 00 00 00 01 00 02 9c d9 15 00 00 00 01 00 02 9d 02 15 00 00 00 01 00 02 9e ff 15 00 00 00 01 00 02 9f 03 15 00 00 00 01 00 02 a0 36 15 00 00 00 01 00 02 a2 03 15 00 00 00 01 00 02 a3 55 15 00 00 00 01 00 02 a4 03 15 00 00 00 01 00 02 a5 6d 15 00 00 00 01 00 02 a6 03 15 00 00 00 01 00 02 a7 89 15 00 00 00 01 00 02 a9 03 15 00 00 00 01 00 02 aa a3 15 00 00 00 01 00 02 ab 03 15 00 00 00 01 00 02 ac c9 15 00 00 00 01 00 02 ad 03 15 00 00 00 01 00 02 ae dd 15 00 00 00 01 00 02 af 03 15 00 00 00 01 00 02 b0 f5 15 00 00 00 01 00 02 b1 03 15 00 00 00 01 00 02 b2 ff 15 00 00 00 01 00 02 b3 00 15 00 00 00 01 00 02 b4 00 15 00 00 00 01 00 02 b5 00 15 00 00 00 01 00 02 b6 1f 15 00 00 00 01 00 02 b7 00 15 00 00 00 01 00 02 b8 46 15 00 00 00 01 00 02 b9 00 15 00 00 00 01 00 02 ba 69 15 00 00 00 01 00 02 bb 00 15 00 00 00 01 00 02 bc 84 15 00 00 00 01 00 02 bd 00 15 00 00 00 01 00 02 be 9b 15 00 00 00 01 00 02 bf 00 15 00 00 00 01 00 02 c0 b0 15 00 00 00 01 00 02 c1 00 15 00 00 00 01 00 02 c2 c3 15 00 00 00 01 00 02 c3 00 15 01 00 00 01 00 02 c4 d3 15 00 00 00 01 00 02 c5 01 15 00 00 00 01 00 02 c6 09 15 00 00 00 01 00 02 c7 01 15 00 00 00 01 00 02 c8 31 15 00 00 00 01 00 02 c9 01 15 00 00 00 01 00 02 ca 6d 15 00 00 00 01 00 02 cb 01 15 00 00 00 01 00 02 cc 9a 15 00 00 00 01 00 02 cd 01 15 00 00 00 01 00 02 ce dc 15 00 00 00 01 00 02 cf 02 15 00 00 00 01 00 02 d0 10 15 00 00 00 01 00 02 d1 02 15 00 00 00 01 00 02 d2 12 15 00 00 00 01 00 02 d3 02 15 00 00 00 01 00 02 d4 43 15 00 00 00 01 00 02 d5 02 15 00 00 00 01 00 02 d6 7d 15 00 00 00 01 00 02 d7 02 15 00 00 00 01 00 02 d8 a4 15 00 00 00 01 00 02 d9 02 15 00 00 00 01 00 02 da d9 15 00 00 00 01 00 02 db 02 15 00 00 00 01 00 02 dc ff 15 00 00 00 01 00 02 dd 03 15 00 00 00 01 00 02 de 36 15 00 00 00 01 00 02 df 03 15 00 00 00 01 00 02 e0 55 15 00 00 00 01 00 02 e1 03 15 00 00 00 01 00 02 e2 6d 15 00 00 00 01 00 02 e3 03 15 00 00 00 01 00 02 e4 89 15 00 00 00 01 00 02 e5 03 15 00 00 00 01 00 02 e6 a3 15 00 00 00 01 00 02 e7 03 15 00 00 00 01 00 02 e8 c9 15 00 00 00 01 00 02 e9 03 15 00 00 00 01 00 02 ea dd 15 00 00 00 01 00 02 eb 03 15 01 00 00 01 00 02 ec f5 15 00 00 00 01 00 02 ed 03 15 00 00 00 01 00 02 ee ff 15 00 00 00 01 00 02 ef 00 15 00 00 00 01 00 02 f0 66 15 00 00 00 01 00 02 f1 00 15 00 00 00 01 00 02 f2 75 15 00 00 00 01 00 02 f3 00 15 00 00 00 01 00 02 f4 90 15 00 00 00 01 00 02 f5 00 15 00 00 00 01 00 02 f6 a6 15 00 00 00 01 00 02 f7 00 15 00 00 00 01 00 02 f8 ba 15 00 00 00 01 00 02 f9 00 15 00 00 00 01 00 02 fa cb 15 01 00 00 01 00 02 ff 02 15 00 00 00 01 00 02 fb 01 15 00 00 00 01 00 02 00 00 15 00 00 00 01 00 02 01 db 15 00 00 00 01 00 02 02 00 15 00 00 00 01 00 02 03 ea 15 00 00 00 01 00 02 04 00 15 00 00 00 01 00 02 05 f7 15 00 00 00 01 00 02 06 01 15 00 00 00 01 00 02 07 24 15 00 00 00 01 00 02 08 01 15 00 00 00 01 00 02 09 46 15 00 00 00 01 00 02 0a 01 15 00 00 00 01 00 02 0b 7c 15 00 00 00 01 00 02 0c 01 15 01 00 00 01 00 02 0d a5 15 00 00 00 01 00 02 0e 01 15 00 00 00 01 00 02 0f e3 15 00 00 00 01 00 02 10 02 15 00 00 00 01 00 02 11 15 15 00 00 00 01 00 02 12 02 15 00 00 00 01 00 02 13 17 15 00 00 00 01 00 02 14 02 15 00 00 00 01 00 02 15 47 15 00 00 00 01 00 02 16 02 15 00 00 00 01 00 02 17 81 15 00 00 00 01 00 02 18 02 15 00 00 00 01 00 02 19 a8 15 00 00 00 01 00 02 1a 02 15 00 00 00 01 00 02 1b dd 15 00 00 00 01 00 02 1c 03 15 00 00 00 01 00 02 1d 03 15 00 00 00 01 00 02 1e 03 15 00 00 00 01 00 02 1f 3b 15 00 00 00 01 00 02 20 03 15 00 00 00 01 00 02 21 52 15 00 00 00 01 00 02 22 03 15 00 00 00 01 00 02 23 6d 15 00 00 00 01 00 02 24 03 15 00 00 00 01 00 02 25 89 15 00 00 00 01 00 02 26 03 15 00 00 00 01 00 02 27 a3 15 00 00 00 01 00 02 28 03 15 00 00 00 01 00 02 29 c9 15 00 00 00 01 00 02 2a 03 15 00 00 00 01 00 02 2b dd 15 00 00 00 01 00 02 2d 03 15 00 00 00 01 00 02 2f f5 15 00 00 00 01 00 02 30 03 15 00 00 00 01 00 02 31 ff 15 00 00 00 01 00 02 32 00 15 00 00 00 01 00 02 33 66 15 00 00 00 01 00 02 34 00 15 00 00 00 01 00 02 35 75 15 00 00 00 01 00 02 36 00 15 01 00 00 01 00 02 37 90 15 00 00 00 01 00 02 38 00 15 00 00 00 01 00 02 39 a6 15 00 00 00 01 00 02 3a 00 15 00 00 00 01 00 02 3b ba 15 00 00 00 01 00 02 3d 00 15 00 00 00 01 00 02 3f cb 15 00 00 00 01 00 02 40 00 15 00 00 00 01 00 02 41 db 15 00 00 00 01 00 02 42 00 15 00 00 00 01 00 02 43 ea 15 00 00 00 01 00 02 44 00 15 00 00 00 01 00 02 45 f7 15 00 00 00 01 00 02 46 01 15 00 00 00 01 00 02 47 24 15 00 00 00 01 00 02 48 01 15 00 00 00 01 00 02 49 46 15 00 00 00 01 00 02 4a 01 15 00 00 00 01 00 02 4b 7c 15 00 00 00 01 00 02 4c 01 15 00 00 00 01 00 02 4d a5 15 00 00 00 01 00 02 4e 01 15 00 00 00 01 00 02 4f e3 15 00 00 00 01 00 02 50 02 15 00 00 00 01 00 02 51 15 15 00 00 00 01 00 02 52 02 15 00 00 00 01 00 02 53 17 15 00 00 00 01 00 02 54 02 15 00 00 00 01 00 02 55 47 15 00 00 00 01 00 02 56 02 15 00 00 00 01 00 02 58 81 15 00 00 00 01 00 02 59 02 15 00 00 00 01 00 02 5a a8 15 00 00 00 01 00 02 5b 02 15 00 00 00 01 00 02 5c dd 15 00 00 00 01 00 02 5d 03 15 00 00 00 01 00 02 5e 03 15 00 00 00 01 00 02 5f 03 15 00 00 00 01 00 02 60 3b 15 00 00 00 01 00 02 61 03 15 01 00 00 01 00 02 62 52 15 00 00 00 01 00 02 63 03 15 00 00 00 01 00 02 64 6d 15 00 00 00 01 00 02 65 03 15 00 00 00 01 00 02 66 89 15 00 00 00 01 00 02 67 03 15 00 00 00 01 00 02 68 a3 15 00 00 00 01 00 02 69 03 15 00 00 00 01 00 02 6a c9 15 00 00 00 01 00 02 6b 03 15 00 00 00 01 00 02 6c dd 15 00 00 00 01 00 02 6d 03 15 00 00 00 01 00 02 6e f5 15 00 00 00 01 00 02 6f 03 15 00 00 00 01 00 02 70 ff 15 00 00 00 01 00 02 71 01 15 00 00 00 01 00 02 72 99 15 00 00 00 01 00 02 73 01 15 00 00 00 01 00 02 74 9b 15 00 00 00 01 00 02 75 01 15 00 00 00 01 00 02 76 9e 15 00 00 00 01 00 02 77 01 15 00 00 00 01 00 02 78 a2 15 00 00 00 01 00 02 79 01 15 00 00 00 01 00 02 7a a5 15 00 00 00 01 00 02 7b 01 15 00 00 00 01 00 02 7c a9 15 00 00 00 01 00 02 7d 01 15 00 00 00 01 00 02 7e ac 15 00 00 00 01 00 02 7f 01 15 00 00 00 01 00 02 80 af 15 00 00 00 01 00 02 81 01 15 00 00 00 01 00 02 82 b2 15 00 00 00 01 00 02 83 01 15 00 00 00 01 00 02 84 bf 15 00 00 00 01 00 02 85 01 15 00 00 00 01 00 02 86 cb 15 00 00 00 01 00 02 87 01 15 00 00 00 01 00 02 88 e1 15 01 00 00 01 00 02 89 01 15 00 00 00 01 00 02 8a f4 15 00 00 00 01 00 02 8b 02 15 00 00 00 01 00 02 8c 1a 15 00 00 00 01 00 02 8d 02 15 00 00 00 01 00 02 8e 3f 15 00 00 00 01 00 02 8f 02 15 00 00 00 01 00 02 90 41 15 00 00 00 01 00 02 91 02 15 00 00 00 01 00 02 92 6b 15 00 00 00 01 00 02 93 02 15 00 00 00 01 00 02 94 a3 15 00 00 00 01 00 02 95 02 15 00 00 00 01 00 02 96 ca 15 00 00 00 01 00 02 97 03 15 00 00 00 01 00 02 98 02 15 00 00 00 01 00 02 99 03 15 00 00 00 01 00 02 9a 2e 15 00 00 00 01 00 02 9b 03 15 00 00 00 01 00 02 9c 7e 15 00 00 00 01 00 02 9d 03 15 00 00 00 01 00 02 9e b0 15 00 00 00 01 00 02 9f 03 15 00 00 00 01 00 02 a0 db 15 00 00 00 01 00 02 a2 03 15 00 00 00 01 00 02 a3 e3 15 00 00 00 01 00 02 a4 03 15 00 00 00 01 00 02 a5 e7 15 00 00 00 01 00 02 a6 03 15 00 00 00 01 00 02 a7 ed 15 00 00 00 01 00 02 a9 03 15 00 00 00 10 00 02 aa f0 15 00 00 00 01 00 02 ab 03 15 00 00 00 01 00 02 ac f5 15 00 00 00 01 00 02 ad 03 15 00 00 00 01 00 02 ae ff 15 00 00 00 01 00 02 af 01 15 00 00 00 01 00 02 b0 99 15 00 00 00 01 00 02 b1 01 15 00 00 00 01 00 02 b2 9b 15 00 00 00 01 00 02 b3 01 15 01 00 00 01 00 02 b4 9e 15 00 00 00 01 00 02 b5 01 15 00 00 00 01 00 02 b6 a2 15 00 00 00 01 00 02 b7 01 15 00 00 00 01 00 02 b8 a5 15 00 00 00 01 00 02 b9 01 15 00 00 00 01 00 02 ba a9 15 00 00 00 01 00 02 bb 01 15 00 00 00 01 00 02 bc ac 15 00 00 00 01 00 02 bd 01 15 00 00 00 01 00 02 be af 15 00 00 00 01 00 02 bf 01 15 00 00 00 01 00 02 c0 b2 15 00 00 00 01 00 02 c1 01 15 00 00 00 01 00 02 c2 bf 15 00 00 00 01 00 02 c3 01 15 00 00 00 01 00 02 c4 cb 15 00 00 00 01 00 02 c5 01 15 00 00 00 01 00 02 c6 e1 15 00 00 00 01 00 02 c7 01 15 00 00 00 01 00 02 c8 f5 15 00 00 00 01 00 02 c9 02 15 00 00 00 01 00 02 ca 1a 15 00 00 00 01 00 02 cb 02 15 00 00 00 01 00 02 cc 40 15 00 00 00 01 00 02 cd 02 15 00 00 00 01 00 02 ce 41 15 00 00 00 01 00 02 cf 02 15 00 00 00 01 00 02 d0 6b 15 00 00 00 01 00 02 d1 02 15 00 00 00 01 00 02 d2 a3 15 00 00 00 01 00 02 d3 02 15 00 00 00 01 00 02 d4 ca 15 00 00 00 01 00 02 d5 03 15 00 00 00 01 00 02 d6 02 15 00 00 00 01 00 02 d7 03 15 00 00 00 01 00 02 d8 2e 15 00 00 00 01 00 02 d9 03 15 00 00 00 01 00 02 da 7e 15 00 00 00 01 00 02 db 03 15 01 00 00 01 00 02 dc b0 15 00 00 00 01 00 02 dd 03 15 00 00 00 01 00 02 de db 15 00 00 00 01 00 02 df 03 15 00 00 00 01 00 02 e0 e3 15 00 00 00 01 00 02 e1 03 15 00 00 00 01 00 02 e2 e7 15 00 00 00 01 00 02 e3 03 15 00 00 00 01 00 02 e4 ed 15 00 00 00 01 00 02 e5 03 15 00 00 00 01 00 02 e6 f0 15 00 00 00 01 00 02 e7 03 15 00 00 00 01 00 02 e8 f5 15 00 00 00 01 00 02 e9 03 15 00 00 00 01 00 02 ea ff 15 01 00 00 01 00 02 ff 00];
		qcom,mdss-dsi-dispparam-papermode5-command-state = "dsi_hs_mode";
		qcom,mdss-dsi-dispparam-papermode6-command = [15 01 00 00 01 00 02 ff 01 15 00 00 00 01 00 02 fb 01 15 00 00 00 01 00 02 75 00 15 00 00 00 01 00 02 76 00 15 00 00 00 01 00 02 77 00 15 00 00 00 01 00 02 78 1f 15 00 00 00 01 00 02 79 00 15 00 00 00 01 00 02 7a 46 15 00 00 00 01 00 02 7b 00 15 00 00 00 01 00 02 7c 69 15 00 00 00 01 00 02 7d 00 15 00 00 00 01 00 02 7e 84 15 00 00 00 01 00 02 7f 00 15 00 00 00 01 00 02 80 9b 15 00 00 00 01 00 02 81 00 15 00 00 00 01 00 02 82 b0 15 00 00 00 01 00 02 83 00 15 00 00 00 01 00 02 84 c3 15 00 00 00 01 00 02 85 00 15 00 00 00 01 00 02 86 d3 15 00 00 00 01 00 02 87 01 15 00 00 00 01 00 02 88 09 15 00 00 00 01 00 02 89 01 15 00 00 00 01 00 02 8a 31 15 00 00 00 01 00 02 8b 01 15 00 00 00 01 00 02 8c 6d 15 00 00 00 01 00 02 8d 01 15 00 00 00 01 00 02 8e 99 15 00 00 00 01 00 02 8f 01 15 00 00 00 01 00 02 90 db 15 00 00 00 01 00 02 91 02 15 00 00 00 01 00 02 92 0f 15 00 00 00 01 00 02 93 02 15 00 00 00 01 00 02 94 11 15 00 00 00 01 00 02 95 02 15 00 00 00 01 00 02 96 42 15 00 00 00 01 00 02 97 02 15 00 00 00 01 00 02 98 7d 15 00 00 00 01 00 02 99 02 15 01 00 00 01 00 02 9a a4 15 00 00 00 01 00 02 9b 02 15 00 00 00 01 00 02 9c d9 15 00 00 00 01 00 02 9d 02 15 00 00 00 01 00 02 9e ff 15 00 00 00 01 00 02 9f 03 15 00 00 00 01 00 02 a0 36 15 00 00 00 01 00 02 a2 03 15 00 00 00 01 00 02 a3 55 15 00 00 00 01 00 02 a4 03 15 00 00 00 01 00 02 a5 6d 15 00 00 00 01 00 02 a6 03 15 00 00 00 01 00 02 a7 89 15 00 00 00 01 00 02 a9 03 15 00 00 00 01 00 02 aa a3 15 00 00 00 01 00 02 ab 03 15 00 00 00 01 00 02 ac c9 15 00 00 00 01 00 02 ad 03 15 00 00 00 01 00 02 ae dd 15 00 00 00 01 00 02 af 03 15 00 00 00 01 00 02 b0 f5 15 00 00 00 01 00 02 b1 03 15 00 00 00 01 00 02 b2 ff 15 00 00 00 01 00 02 b3 00 15 00 00 00 01 00 02 b4 00 15 00 00 00 01 00 02 b5 00 15 00 00 00 01 00 02 b6 1f 15 00 00 00 01 00 02 b7 00 15 00 00 00 01 00 02 b8 46 15 00 00 00 01 00 02 b9 00 15 00 00 00 01 00 02 ba 69 15 00 00 00 01 00 02 bb 00 15 00 00 00 01 00 02 bc 84 15 00 00 00 01 00 02 bd 00 15 00 00 00 01 00 02 be 9b 15 00 00 00 01 00 02 bf 00 15 00 00 00 01 00 02 c0 b0 15 00 00 00 01 00 02 c1 00 15 00 00 00 01 00 02 c2 c3 15 00 00 00 01 00 02 c3 00 15 01 00 00 01 00 02 c4 d3 15 00 00 00 01 00 02 c5 01 15 00 00 00 01 00 02 c6 09 15 00 00 00 01 00 02 c7 01 15 00 00 00 01 00 02 c8 31 15 00 00 00 01 00 02 c9 01 15 00 00 00 01 00 02 ca 6d 15 00 00 00 01 00 02 cb 01 15 00 00 00 01 00 02 cc 9a 15 00 00 00 01 00 02 cd 01 15 00 00 00 01 00 02 ce dc 15 00 00 00 01 00 02 cf 02 15 00 00 00 01 00 02 d0 10 15 00 00 00 01 00 02 d1 02 15 00 00 00 01 00 02 d2 12 15 00 00 00 01 00 02 d3 02 15 00 00 00 01 00 02 d4 43 15 00 00 00 01 00 02 d5 02 15 00 00 00 01 00 02 d6 7d 15 00 00 00 01 00 02 d7 02 15 00 00 00 01 00 02 d8 a4 15 00 00 00 01 00 02 d9 02 15 00 00 00 01 00 02 da d9 15 00 00 00 01 00 02 db 02 15 00 00 00 01 00 02 dc ff 15 00 00 00 01 00 02 dd 03 15 00 00 00 01 00 02 de 36 15 00 00 00 01 00 02 df 03 15 00 00 00 01 00 02 e0 55 15 00 00 00 01 00 02 e1 03 15 00 00 00 01 00 02 e2 6d 15 00 00 00 01 00 02 e3 03 15 00 00 00 01 00 02 e4 89 15 00 00 00 01 00 02 e5 03 15 00 00 00 01 00 02 e6 a3 15 00 00 00 01 00 02 e7 03 15 00 00 00 01 00 02 e8 c9 15 00 00 00 01 00 02 e9 03 15 00 00 00 01 00 02 ea dd 15 00 00 00 01 00 02 eb 03 15 01 00 00 01 00 02 ec f5 15 00 00 00 01 00 02 ed 03 15 00 00 00 01 00 02 ee ff 15 00 00 00 01 00 02 ef 00 15 00 00 00 01 00 02 f0 66 15 00 00 00 01 00 02 f1 00 15 00 00 00 01 00 02 f2 75 15 00 00 00 01 00 02 f3 00 15 00 00 00 01 00 02 f4 90 15 00 00 00 01 00 02 f5 00 15 00 00 00 01 00 02 f6 a6 15 00 00 00 01 00 02 f7 00 15 00 00 00 01 00 02 f8 ba 15 00 00 00 01 00 02 f9 00 15 00 00 00 01 00 02 fa cb 15 01 00 00 01 00 02 ff 02 15 00 00 00 01 00 02 fb 01 15 00 00 00 01 00 02 00 00 15 00 00 00 01 00 02 01 db 15 00 00 00 01 00 02 02 00 15 00 00 00 01 00 02 03 ea 15 00 00 00 01 00 02 04 00 15 00 00 00 01 00 02 05 f7 15 00 00 00 01 00 02 06 01 15 00 00 00 01 00 02 07 24 15 00 00 00 01 00 02 08 01 15 00 00 00 01 00 02 09 46 15 00 00 00 01 00 02 0a 01 15 00 00 00 01 00 02 0b 7c 15 00 00 00 01 00 02 0c 01 15 01 00 00 01 00 02 0d a5 15 00 00 00 01 00 02 0e 01 15 00 00 00 01 00 02 0f e3 15 00 00 00 01 00 02 10 02 15 00 00 00 01 00 02 11 15 15 00 00 00 01 00 02 12 02 15 00 00 00 01 00 02 13 17 15 00 00 00 01 00 02 14 02 15 00 00 00 01 00 02 15 47 15 00 00 00 01 00 02 16 02 15 00 00 00 01 00 02 17 81 15 00 00 00 01 00 02 18 02 15 00 00 00 01 00 02 19 a8 15 00 00 00 01 00 02 1a 02 15 00 00 00 01 00 02 1b dd 15 00 00 00 01 00 02 1c 03 15 00 00 00 01 00 02 1d 03 15 00 00 00 01 00 02 1e 03 15 00 00 00 01 00 02 1f 3b 15 00 00 00 01 00 02 20 03 15 00 00 00 01 00 02 21 52 15 00 00 00 01 00 02 22 03 15 00 00 00 01 00 02 23 6d 15 00 00 00 01 00 02 24 03 15 00 00 00 01 00 02 25 89 15 00 00 00 01 00 02 26 03 15 00 00 00 01 00 02 27 a3 15 00 00 00 01 00 02 28 03 15 00 00 00 01 00 02 29 c9 15 00 00 00 01 00 02 2a 03 15 00 00 00 01 00 02 2b dd 15 00 00 00 01 00 02 2d 03 15 00 00 00 01 00 02 2f f5 15 00 00 00 01 00 02 30 03 15 00 00 00 01 00 02 31 ff 15 00 00 00 01 00 02 32 00 15 00 00 00 01 00 02 33 66 15 00 00 00 01 00 02 34 00 15 00 00 00 01 00 02 35 75 15 00 00 00 01 00 02 36 00 15 01 00 00 01 00 02 37 90 15 00 00 00 01 00 02 38 00 15 00 00 00 01 00 02 39 a6 15 00 00 00 01 00 02 3a 00 15 00 00 00 01 00 02 3b ba 15 00 00 00 01 00 02 3d 00 15 00 00 00 01 00 02 3f cb 15 00 00 00 01 00 02 40 00 15 00 00 00 01 00 02 41 db 15 00 00 00 01 00 02 42 00 15 00 00 00 01 00 02 43 ea 15 00 00 00 01 00 02 44 00 15 00 00 00 01 00 02 45 f7 15 00 00 00 01 00 02 46 01 15 00 00 00 01 00 02 47 24 15 00 00 00 01 00 02 48 01 15 00 00 00 01 00 02 49 46 15 00 00 00 01 00 02 4a 01 15 00 00 00 01 00 02 4b 7c 15 00 00 00 01 00 02 4c 01 15 00 00 00 01 00 02 4d a5 15 00 00 00 01 00 02 4e 01 15 00 00 00 01 00 02 4f e3 15 00 00 00 01 00 02 50 02 15 00 00 00 01 00 02 51 15 15 00 00 00 01 00 02 52 02 15 00 00 00 01 00 02 53 17 15 00 00 00 01 00 02 54 02 15 00 00 00 01 00 02 55 47 15 00 00 00 01 00 02 56 02 15 00 00 00 01 00 02 58 81 15 00 00 00 01 00 02 59 02 15 00 00 00 01 00 02 5a a8 15 00 00 00 01 00 02 5b 02 15 00 00 00 01 00 02 5c dd 15 00 00 00 01 00 02 5d 03 15 00 00 00 01 00 02 5e 03 15 00 00 00 01 00 02 5f 03 15 00 00 00 01 00 02 60 3b 15 00 00 00 01 00 02 61 03 15 01 00 00 01 00 02 62 52 15 00 00 00 01 00 02 63 03 15 00 00 00 01 00 02 64 6d 15 00 00 00 01 00 02 65 03 15 00 00 00 01 00 02 66 89 15 00 00 00 01 00 02 67 03 15 00 00 00 01 00 02 68 a3 15 00 00 00 01 00 02 69 03 15 00 00 00 01 00 02 6a c9 15 00 00 00 01 00 02 6b 03 15 00 00 00 01 00 02 6c dd 15 00 00 00 01 00 02 6d 03 15 00 00 00 01 00 02 6e f5 15 00 00 00 01 00 02 6f 03 15 00 00 00 01 00 02 70 ff 15 00 00 00 01 00 02 71 01 15 00 00 00 01 00 02 72 99 15 00 00 00 01 00 02 73 01 15 00 00 00 01 00 02 74 9b 15 00 00 00 01 00 02 75 01 15 00 00 00 01 00 02 76 9e 15 00 00 00 01 00 02 77 01 15 00 00 00 01 00 02 78 a2 15 00 00 00 01 00 02 79 01 15 00 00 00 01 00 02 7a a5 15 00 00 00 01 00 02 7b 01 15 00 00 00 01 00 02 7c a9 15 00 00 00 01 00 02 7d 01 15 00 00 00 01 00 02 7e ac 15 00 00 00 01 00 02 7f 01 15 00 00 00 01 00 02 80 af 15 00 00 00 01 00 02 81 01 15 00 00 00 01 00 02 82 b2 15 00 00 00 01 00 02 83 01 15 00 00 00 01 00 02 84 bf 15 00 00 00 01 00 02 85 01 15 00 00 00 01 00 02 86 cb 15 00 00 00 01 00 02 87 01 15 00 00 00 01 00 02 88 e1 15 01 00 00 01 00 02 89 01 15 00 00 00 01 00 02 8a f4 15 00 00 00 01 00 02 8b 02 15 00 00 00 01 00 02 8c 1a 15 00 00 00 01 00 02 8d 02 15 00 00 00 01 00 02 8e 3f 15 00 00 00 01 00 02 8f 02 15 00 00 00 01 00 02 90 41 15 00 00 00 01 00 02 91 02 15 00 00 00 01 00 02 92 6b 15 00 00 00 01 00 02 93 02 15 00 00 00 01 00 02 94 a3 15 00 00 00 01 00 02 95 02 15 00 00 00 01 00 02 96 ca 15 00 00 00 01 00 02 97 03 15 00 00 00 01 00 02 98 02 15 00 00 00 01 00 02 99 03 15 00 00 00 01 00 02 9a 2e 15 00 00 00 01 00 02 9b 03 15 00 00 00 01 00 02 9c 7e 15 00 00 00 01 00 02 9d 03 15 00 00 00 01 00 02 9e b0 15 00 00 00 01 00 02 9f 03 15 00 00 00 01 00 02 a0 db 15 00 00 00 01 00 02 a2 03 15 00 00 00 01 00 02 a3 e3 15 00 00 00 01 00 02 a4 03 15 00 00 00 01 00 02 a5 e7 15 00 00 00 01 00 02 a6 03 15 00 00 00 01 00 02 a7 ed 15 00 00 00 01 00 02 a9 03 15 00 00 00 10 00 02 aa f0 15 00 00 00 01 00 02 ab 03 15 00 00 00 01 00 02 ac f5 15 00 00 00 01 00 02 ad 03 15 00 00 00 01 00 02 ae ff 15 00 00 00 01 00 02 af 01 15 00 00 00 01 00 02 b0 99 15 00 00 00 01 00 02 b1 01 15 00 00 00 01 00 02 b2 9b 15 00 00 00 01 00 02 b3 01 15 01 00 00 01 00 02 b4 9e 15 00 00 00 01 00 02 b5 01 15 00 00 00 01 00 02 b6 a2 15 00 00 00 01 00 02 b7 01 15 00 00 00 01 00 02 b8 a5 15 00 00 00 01 00 02 b9 01 15 00 00 00 01 00 02 ba a9 15 00 00 00 01 00 02 bb 01 15 00 00 00 01 00 02 bc ac 15 00 00 00 01 00 02 bd 01 15 00 00 00 01 00 02 be af 15 00 00 00 01 00 02 bf 01 15 00 00 00 01 00 02 c0 b2 15 00 00 00 01 00 02 c1 01 15 00 00 00 01 00 02 c2 bf 15 00 00 00 01 00 02 c3 01 15 00 00 00 01 00 02 c4 cb 15 00 00 00 01 00 02 c5 01 15 00 00 00 01 00 02 c6 e1 15 00 00 00 01 00 02 c7 01 15 00 00 00 01 00 02 c8 f5 15 00 00 00 01 00 02 c9 02 15 00 00 00 01 00 02 ca 1a 15 00 00 00 01 00 02 cb 02 15 00 00 00 01 00 02 cc 40 15 00 00 00 01 00 02 cd 02 15 00 00 00 01 00 02 ce 41 15 00 00 00 01 00 02 cf 02 15 00 00 00 01 00 02 d0 6b 15 00 00 00 01 00 02 d1 02 15 00 00 00 01 00 02 d2 a3 15 00 00 00 01 00 02 d3 02 15 00 00 00 01 00 02 d4 ca 15 00 00 00 01 00 02 d5 03 15 00 00 00 01 00 02 d6 02 15 00 00 00 01 00 02 d7 03 15 00 00 00 01 00 02 d8 2e 15 00 00 00 01 00 02 d9 03 15 00 00 00 01 00 02 da 7e 15 00 00 00 01 00 02 db 03 15 01 00 00 01 00 02 dc b0 15 00 00 00 01 00 02 dd 03 15 00 00 00 01 00 02 de db 15 00 00 00 01 00 02 df 03 15 00 00 00 01 00 02 e0 e3 15 00 00 00 01 00 02 e1 03 15 00 00 00 01 00 02 e2 e7 15 00 00 00 01 00 02 e3 03 15 00 00 00 01 00 02 e4 ed 15 00 00 00 01 00 02 e5 03 15 00 00 00 01 00 02 e6 f0 15 00 00 00 01 00 02 e7 03 15 00 00 00 01 00 02 e8 f5 15 00 00 00 01 00 02 e9 03 15 00 00 00 01 00 02 ea ff 15 01 00 00 01 00 02 ff 00];
		qcom,mdss-dsi-dispparam-papermode6-command-state = "dsi_hs_mode";
		qcom,mdss-dsi-dispparam-papermode7-command = [15 01 00 00 01 00 02 ff 01 15 00 00 00 01 00 02 fb 01 15 00 00 00 01 00 02 75 00 15 00 00 00 01 00 02 76 00 15 00 00 00 01 00 02 77 00 15 00 00 00 01 00 02 78 1f 15 00 00 00 01 00 02 79 00 15 00 00 00 01 00 02 7a 46 15 00 00 00 01 00 02 7b 00 15 00 00 00 01 00 02 7c 69 15 00 00 00 01 00 02 7d 00 15 00 00 00 01 00 02 7e 84 15 00 00 00 01 00 02 7f 00 15 00 00 00 01 00 02 80 9b 15 00 00 00 01 00 02 81 00 15 00 00 00 01 00 02 82 b0 15 00 00 00 01 00 02 83 00 15 00 00 00 01 00 02 84 c3 15 00 00 00 01 00 02 85 00 15 00 00 00 01 00 02 86 d3 15 00 00 00 01 00 02 87 01 15 00 00 00 01 00 02 88 09 15 00 00 00 01 00 02 89 01 15 00 00 00 01 00 02 8a 31 15 00 00 00 01 00 02 8b 01 15 00 00 00 01 00 02 8c 6d 15 00 00 00 01 00 02 8d 01 15 00 00 00 01 00 02 8e 99 15 00 00 00 01 00 02 8f 01 15 00 00 00 01 00 02 90 db 15 00 00 00 01 00 02 91 02 15 00 00 00 01 00 02 92 0f 15 00 00 00 01 00 02 93 02 15 00 00 00 01 00 02 94 11 15 00 00 00 01 00 02 95 02 15 00 00 00 01 00 02 96 42 15 00 00 00 01 00 02 97 02 15 00 00 00 01 00 02 98 7d 15 00 00 00 01 00 02 99 02 15 01 00 00 01 00 02 9a a4 15 00 00 00 01 00 02 9b 02 15 00 00 00 01 00 02 9c d9 15 00 00 00 01 00 02 9d 02 15 00 00 00 01 00 02 9e ff 15 00 00 00 01 00 02 9f 03 15 00 00 00 01 00 02 a0 36 15 00 00 00 01 00 02 a2 03 15 00 00 00 01 00 02 a3 55 15 00 00 00 01 00 02 a4 03 15 00 00 00 01 00 02 a5 6d 15 00 00 00 01 00 02 a6 03 15 00 00 00 01 00 02 a7 89 15 00 00 00 01 00 02 a9 03 15 00 00 00 01 00 02 aa a3 15 00 00 00 01 00 02 ab 03 15 00 00 00 01 00 02 ac c9 15 00 00 00 01 00 02 ad 03 15 00 00 00 01 00 02 ae dd 15 00 00 00 01 00 02 af 03 15 00 00 00 01 00 02 b0 f5 15 00 00 00 01 00 02 b1 03 15 00 00 00 01 00 02 b2 ff 15 00 00 00 01 00 02 b3 00 15 00 00 00 01 00 02 b4 00 15 00 00 00 01 00 02 b5 00 15 00 00 00 01 00 02 b6 1f 15 00 00 00 01 00 02 b7 00 15 00 00 00 01 00 02 b8 46 15 00 00 00 01 00 02 b9 00 15 00 00 00 01 00 02 ba 69 15 00 00 00 01 00 02 bb 00 15 00 00 00 01 00 02 bc 84 15 00 00 00 01 00 02 bd 00 15 00 00 00 01 00 02 be 9b 15 00 00 00 01 00 02 bf 00 15 00 00 00 01 00 02 c0 b0 15 00 00 00 01 00 02 c1 00 15 00 00 00 01 00 02 c2 c3 15 00 00 00 01 00 02 c3 00 15 01 00 00 01 00 02 c4 d3 15 00 00 00 01 00 02 c5 01 15 00 00 00 01 00 02 c6 09 15 00 00 00 01 00 02 c7 01 15 00 00 00 01 00 02 c8 31 15 00 00 00 01 00 02 c9 01 15 00 00 00 01 00 02 ca 6d 15 00 00 00 01 00 02 cb 01 15 00 00 00 01 00 02 cc 9a 15 00 00 00 01 00 02 cd 01 15 00 00 00 01 00 02 ce dc 15 00 00 00 01 00 02 cf 02 15 00 00 00 01 00 02 d0 10 15 00 00 00 01 00 02 d1 02 15 00 00 00 01 00 02 d2 12 15 00 00 00 01 00 02 d3 02 15 00 00 00 01 00 02 d4 43 15 00 00 00 01 00 02 d5 02 15 00 00 00 01 00 02 d6 7d 15 00 00 00 01 00 02 d7 02 15 00 00 00 01 00 02 d8 a4 15 00 00 00 01 00 02 d9 02 15 00 00 00 01 00 02 da d9 15 00 00 00 01 00 02 db 02 15 00 00 00 01 00 02 dc ff 15 00 00 00 01 00 02 dd 03 15 00 00 00 01 00 02 de 36 15 00 00 00 01 00 02 df 03 15 00 00 00 01 00 02 e0 55 15 00 00 00 01 00 02 e1 03 15 00 00 00 01 00 02 e2 6d 15 00 00 00 01 00 02 e3 03 15 00 00 00 01 00 02 e4 89 15 00 00 00 01 00 02 e5 03 15 00 00 00 01 00 02 e6 a3 15 00 00 00 01 00 02 e7 03 15 00 00 00 01 00 02 e8 c9 15 00 00 00 01 00 02 e9 03 15 00 00 00 01 00 02 ea dd 15 00 00 00 01 00 02 eb 03 15 01 00 00 01 00 02 ec f5 15 00 00 00 01 00 02 ed 03 15 00 00 00 01 00 02 ee ff 15 00 00 00 01 00 02 ef 00 15 00 00 00 01 00 02 f0 66 15 00 00 00 01 00 02 f1 00 15 00 00 00 01 00 02 f2 75 15 00 00 00 01 00 02 f3 00 15 00 00 00 01 00 02 f4 90 15 00 00 00 01 00 02 f5 00 15 00 00 00 01 00 02 f6 a6 15 00 00 00 01 00 02 f7 00 15 00 00 00 01 00 02 f8 ba 15 00 00 00 01 00 02 f9 00 15 00 00 00 01 00 02 fa cb 15 01 00 00 01 00 02 ff 02 15 00 00 00 01 00 02 fb 01 15 00 00 00 01 00 02 00 00 15 00 00 00 01 00 02 01 db 15 00 00 00 01 00 02 02 00 15 00 00 00 01 00 02 03 ea 15 00 00 00 01 00 02 04 00 15 00 00 00 01 00 02 05 f7 15 00 00 00 01 00 02 06 01 15 00 00 00 01 00 02 07 24 15 00 00 00 01 00 02 08 01 15 00 00 00 01 00 02 09 46 15 00 00 00 01 00 02 0a 01 15 00 00 00 01 00 02 0b 7c 15 00 00 00 01 00 02 0c 01 15 01 00 00 01 00 02 0d a5 15 00 00 00 01 00 02 0e 01 15 00 00 00 01 00 02 0f e3 15 00 00 00 01 00 02 10 02 15 00 00 00 01 00 02 11 15 15 00 00 00 01 00 02 12 02 15 00 00 00 01 00 02 13 17 15 00 00 00 01 00 02 14 02 15 00 00 00 01 00 02 15 47 15 00 00 00 01 00 02 16 02 15 00 00 00 01 00 02 17 81 15 00 00 00 01 00 02 18 02 15 00 00 00 01 00 02 19 a8 15 00 00 00 01 00 02 1a 02 15 00 00 00 01 00 02 1b dd 15 00 00 00 01 00 02 1c 03 15 00 00 00 01 00 02 1d 03 15 00 00 00 01 00 02 1e 03 15 00 00 00 01 00 02 1f 3b 15 00 00 00 01 00 02 20 03 15 00 00 00 01 00 02 21 52 15 00 00 00 01 00 02 22 03 15 00 00 00 01 00 02 23 6d 15 00 00 00 01 00 02 24 03 15 00 00 00 01 00 02 25 89 15 00 00 00 01 00 02 26 03 15 00 00 00 01 00 02 27 a3 15 00 00 00 01 00 02 28 03 15 00 00 00 01 00 02 29 c9 15 00 00 00 01 00 02 2a 03 15 00 00 00 01 00 02 2b dd 15 00 00 00 01 00 02 2d 03 15 00 00 00 01 00 02 2f f5 15 00 00 00 01 00 02 30 03 15 00 00 00 01 00 02 31 ff 15 00 00 00 01 00 02 32 00 15 00 00 00 01 00 02 33 66 15 00 00 00 01 00 02 34 00 15 00 00 00 01 00 02 35 75 15 00 00 00 01 00 02 36 00 15 01 00 00 01 00 02 37 90 15 00 00 00 01 00 02 38 00 15 00 00 00 01 00 02 39 a6 15 00 00 00 01 00 02 3a 00 15 00 00 00 01 00 02 3b ba 15 00 00 00 01 00 02 3d 00 15 00 00 00 01 00 02 3f cb 15 00 00 00 01 00 02 40 00 15 00 00 00 01 00 02 41 db 15 00 00 00 01 00 02 42 00 15 00 00 00 01 00 02 43 ea 15 00 00 00 01 00 02 44 00 15 00 00 00 01 00 02 45 f7 15 00 00 00 01 00 02 46 01 15 00 00 00 01 00 02 47 24 15 00 00 00 01 00 02 48 01 15 00 00 00 01 00 02 49 46 15 00 00 00 01 00 02 4a 01 15 00 00 00 01 00 02 4b 7c 15 00 00 00 01 00 02 4c 01 15 00 00 00 01 00 02 4d a5 15 00 00 00 01 00 02 4e 01 15 00 00 00 01 00 02 4f e3 15 00 00 00 01 00 02 50 02 15 00 00 00 01 00 02 51 15 15 00 00 00 01 00 02 52 02 15 00 00 00 01 00 02 53 17 15 00 00 00 01 00 02 54 02 15 00 00 00 01 00 02 55 47 15 00 00 00 01 00 02 56 02 15 00 00 00 01 00 02 58 81 15 00 00 00 01 00 02 59 02 15 00 00 00 01 00 02 5a a8 15 00 00 00 01 00 02 5b 02 15 00 00 00 01 00 02 5c dd 15 00 00 00 01 00 02 5d 03 15 00 00 00 01 00 02 5e 03 15 00 00 00 01 00 02 5f 03 15 00 00 00 01 00 02 60 3b 15 00 00 00 01 00 02 61 03 15 01 00 00 01 00 02 62 52 15 00 00 00 01 00 02 63 03 15 00 00 00 01 00 02 64 6d 15 00 00 00 01 00 02 65 03 15 00 00 00 01 00 02 66 89 15 00 00 00 01 00 02 67 03 15 00 00 00 01 00 02 68 a3 15 00 00 00 01 00 02 69 03 15 00 00 00 01 00 02 6a c9 15 00 00 00 01 00 02 6b 03 15 00 00 00 01 00 02 6c dd 15 00 00 00 01 00 02 6d 03 15 00 00 00 01 00 02 6e f5 15 00 00 00 01 00 02 6f 03 15 00 00 00 01 00 02 70 ff 15 00 00 00 01 00 02 71 01 15 00 00 00 01 00 02 72 b6 15 00 00 00 01 00 02 73 01 15 00 00 00 01 00 02 74 b8 15 00 00 00 01 00 02 75 01 15 00 00 00 01 00 02 76 bb 15 00 00 00 01 00 02 77 01 15 00 00 00 01 00 02 78 bd 15 00 00 00 01 00 02 79 01 15 00 00 00 01 00 02 7a c0 15 00 00 00 01 00 02 7b 01 15 00 00 00 01 00 02 7c c2 15 00 00 00 01 00 02 7d 01 15 00 00 00 01 00 02 7e c5 15 00 00 00 01 00 02 7f 01 15 00 00 00 01 00 02 80 c8 15 00 00 00 01 00 02 81 01 15 00 00 00 01 00 02 82 ca 15 00 00 00 01 00 02 83 01 15 00 00 00 01 00 02 84 d5 15 00 00 00 01 00 02 85 01 15 00 00 00 01 00 02 86 df 15 00 00 00 01 00 02 87 01 15 00 00 00 01 00 02 88 f2 15 01 00 00 01 00 02 89 02 15 00 00 00 01 00 02 8a 04 15 00 00 00 01 00 02 8b 02 15 00 00 00 01 00 02 8c 26 15 00 00 00 01 00 02 8d 02 15 00 00 00 01 00 02 8e 4a 15 00 00 00 01 00 02 8f 02 15 00 00 00 01 00 02 90 4b 15 00 00 00 01 00 02 91 02 15 00 00 00 01 00 02 92 74 15 00 00 00 01 00 02 93 02 15 00 00 00 01 00 02 94 ac 15 00 00 00 01 00 02 95 02 15 00 00 00 01 00 02 96 d3 15 00 00 00 01 00 02 97 03 15 00 00 00 01 00 02 98 0b 15 00 00 00 01 00 02 99 03 15 00 00 00 01 00 02 9a 31 15 00 00 00 01 00 02 9b 03 15 00 00 00 01 00 02 9c 7e 15 00 00 00 01 00 02 9d 03 15 00 00 00 01 00 02 9e b0 15 00 00 00 01 00 02 9f 03 15 00 00 00 01 00 02 a0 db 15 00 00 00 01 00 02 a2 03 15 00 00 00 01 00 02 a3 e3 15 00 00 00 01 00 02 a4 03 15 00 00 00 01 00 02 a5 e7 15 00 00 00 01 00 02 a6 03 15 00 00 00 01 00 02 a7 ed 15 00 00 00 01 00 02 a9 03 15 00 00 00 10 00 02 aa f0 15 00 00 00 01 00 02 ab 03 15 00 00 00 01 00 02 ac f5 15 00 00 00 01 00 02 ad 03 15 00 00 00 01 00 02 ae ff 15 00 00 00 01 00 02 af 01 15 00 00 00 01 00 02 b0 b6 15 00 00 00 01 00 02 b1 01 15 00 00 00 01 00 02 b2 b8 15 00 00 00 01 00 02 b3 01 15 01 00 00 01 00 02 b4 bb 15 00 00 00 01 00 02 b5 01 15 00 00 00 01 00 02 b6 bd 15 00 00 00 01 00 02 b7 01 15 00 00 00 01 00 02 b8 c0 15 00 00 00 01 00 02 b9 01 15 00 00 00 01 00 02 ba c2 15 00 00 00 01 00 02 bb 01 15 00 00 00 01 00 02 bc c5 15 00 00 00 01 00 02 bd 01 15 00 00 00 01 00 02 be c8 15 00 00 00 01 00 02 bf 01 15 00 00 00 01 00 02 c0 ca 15 00 00 00 01 00 02 c1 01 15 00 00 00 01 00 02 c2 d5 15 00 00 00 01 00 02 c3 01 15 00 00 00 01 00 02 c4 df 15 00 00 00 01 00 02 c5 01 15 00 00 00 01 00 02 c6 f2 15 00 00 00 01 00 02 c7 02 15 00 00 00 01 00 02 c8 04 15 00 00 00 01 00 02 c9 02 15 00 00 00 01 00 02 ca 26 15 00 00 00 01 00 02 cb 02 15 00 00 00 01 00 02 cc 4a 15 00 00 00 01 00 02 cd 02 15 00 00 00 01 00 02 ce 4c 15 00 00 00 01 00 02 cf 02 15 00 00 00 01 00 02 d0 74 15 00 00 00 01 00 02 d1 02 15 00 00 00 01 00 02 d2 ac 15 00 00 00 01 00 02 d3 02 15 00 00 00 01 00 02 d4 d3 15 00 00 00 01 00 02 d5 03 15 00 00 00 01 00 02 d6 0b 15 00 00 00 01 00 02 d7 03 15 00 00 00 01 00 02 d8 31 15 00 00 00 01 00 02 d9 03 15 00 00 00 01 00 02 da 7e 15 00 00 00 01 00 02 db 03 15 01 00 00 01 00 02 dc b0 15 00 00 00 01 00 02 dd 03 15 00 00 00 01 00 02 de db 15 00 00 00 01 00 02 df 03 15 00 00 00 01 00 02 e0 e3 15 00 00 00 01 00 02 e1 03 15 00 00 00 01 00 02 e2 e7 15 00 00 00 01 00 02 e3 03 15 00 00 00 01 00 02 e4 ed 15 00 00 00 01 00 02 e5 03 15 00 00 00 01 00 02 e6 f0 15 00 00 00 01 00 02 e7 03 15 00 00 00 01 00 02 e8 f5 15 00 00 00 01 00 02 e9 03 15 00 00 00 01 00 02 ea ff 15 01 00 00 01 00 02 ff 00];
		qcom,mdss-dsi-dispparam-papermode7-command-state = "dsi_hs_mode";
		};
	};

