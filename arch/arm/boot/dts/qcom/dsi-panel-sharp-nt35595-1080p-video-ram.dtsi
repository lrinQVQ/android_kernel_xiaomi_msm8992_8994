/* Copyright (c) 2015, The Linux Foundation. All rights reserved.
 * Copyright (C) 2016 XiaoMi, Inc.
 *
 * This program is free software; you can redistribute it and/or modify
 * it under the terms of the GNU General Public License version 2 and
 * only version 2 as published by the Free Software Foundation.
 *
 * This program is distributed in the hope that it will be useful,
 * but WITHOUT ANY WARRANTY; without even the implied warranty of
 * MERCHANTABILITY or FITNESS FOR A PARTICULAR PURPOSE.  See the
 * GNU General Public License for more details.
 */

 /*---------------------------------------------------------------------------
 * This file is autogenerated file using gcdb parser. Please do not edit it.
 * Update input XML file to add a new entry or update variable in this file
 * VERSION = "1.0"
 *---------------------------------------------------------------------------*/
&mdss_mdp {
	dsi_sharp_nt35595_1080_vid: qcom,mdss_dsi_sharp_nt35595_1080p_video {
		qcom,mdss-dsi-panel-name = "sharp nt35595 1080p video mode dsi panel";
		qcom,mdss-dsi-panel-id = <0>;
		qcom,mdss-dsi-panel-controller = <&mdss_dsi0>;
		qcom,mdss-dsi-panel-type = "dsi_video_mode";
		qcom,mdss-dsi-panel-destination = "display_1";
		qcom,mdss-dsi-panel-framerate = <60>;
		qcom,mdss-dsi-virtual-channel-id = <0>;
		qcom,mdss-dsi-stream = <0>;
		qcom,mdss-dsi-panel-width = <1080>;
		qcom,mdss-dsi-panel-height = <1920>;
		qcom,mdss-dsi-h-front-porch = <102>;
		qcom,mdss-dsi-h-back-porch = <48>;
		qcom,mdss-dsi-h-pulse-width = <12>;
		qcom,mdss-dsi-h-sync-skew = <0>;
		qcom,mdss-dsi-v-back-porch = <5>;
		qcom,mdss-dsi-v-front-porch = <4>;
		qcom,mdss-dsi-v-pulse-width = <2>;
		qcom,mdss-dsi-h-left-border = <0>;
		qcom,mdss-dsi-h-right-border = <0>;
		qcom,mdss-dsi-v-top-border = <0>;
		qcom,mdss-dsi-v-bottom-border = <0>;
		qcom,mdss-dsi-bpp = <24>;
		qcom,mdss-dsi-underflow-color = <0xff>;
		qcom,mdss-dsi-border-color = <0>;
		qcom,mdss-dsi-pixel-packing = "tight";
		qcom,mdss-dsi-pan-enable-dynamic-fps;
		qcom,mdss-dsi-pan-fps-update = "dfps_immediate_porch_mode_vfp";
		qcom,mdss-dsi-min-refresh-rate = <55>;
		qcom,mdss-dsi-max-refresh-rate = <60>;
		qcom,mdss-dsi-on-command = [
				15 00 00 00 01 00 02 FF 10
				15 00 00 00 01 00 02 BB 03
				15 00 00 00 01 00 02 B0 03
				39 00 00 00 01 00 06 3B 03 06 04 3C 66
				39 00 00 00 01 00 03 44 00 00
				15 00 00 00 01 00 02 FF 24
				15 00 00 00 01 00 02 C4 69
				15 00 00 00 01 00 02 C9 00
				15 00 00 00 01 00 02 FB 01

				15 00 00 00 01 00 02 FF 10
				15 01 00 00 01 00 02 34 00
				05 01 00 00 78 00 02 11 00
				15 00 00 00 01 00 02 51 FF
				15 00 00 00 01 00 02 53 2c
				15 00 00 00 01 00 02 55 81
				15 00 00 00 01 00 02 FF F0
				15 00 00 00 01 00 02 92 01
				15 00 00 00 01 00 02 13 01
				15 00 00 00 01 00 02 FF 22
				15 00 00 00 01 00 02 54 01
				15 00 00 00 01 00 02 56 00
				15 00 00 00 01 00 02 FB 01
				15 01 00 00 01 00 02 FF 10
				05 01 00 00 28 00 02 29 00

				15 01 00 00 01 00 02 FF 20
				15 00 00 00 01 00 02 FB 01
				15 00 00 00 01 00 02 75 01
				15 00 00 00 01 00 02 76 27
				15 00 00 00 01 00 02 77 01
				15 00 00 00 01 00 02 78 2D
				15 00 00 00 01 00 02 79 01
				15 00 00 00 01 00 02 7A 37
				15 00 00 00 01 00 02 7B 01
				15 00 00 00 01 00 02 7C 40
				15 00 00 00 01 00 02 7D 01
				15 00 00 00 01 00 02 7E 49
				15 00 00 00 01 00 02 7F 01
				15 00 00 00 01 00 02 80 52
				15 00 00 00 01 00 02 81 01
				15 00 00 00 01 00 02 82 5A
				15 00 00 00 01 00 02 83 01
				15 00 00 00 01 00 02 84 61
				15 00 00 00 01 00 02 85 01
				15 00 00 00 01 00 02 86 69
				15 00 00 00 01 00 02 87 01
				15 00 00 00 01 00 02 88 86
				15 00 00 00 01 00 02 89 01
				15 00 00 00 01 00 02 8A 9F
				15 00 00 00 01 00 02 8B 01
				15 00 00 00 01 00 02 8C CA
				15 00 00 00 01 00 02 8D 01
				15 00 00 00 01 00 02 8E F0
				15 00 00 00 01 00 02 8F 02
				15 00 00 00 01 00 02 90 2E
				15 00 00 00 01 00 02 91 02
				15 00 00 00 01 00 02 92 5B
				15 00 00 00 01 00 02 93 02
				15 00 00 00 01 00 02 94 5C
				15 00 00 00 01 00 02 95 02
				15 00 00 00 01 00 02 96 87
				15 00 00 00 01 00 02 97 02
				15 00 00 00 01 00 02 98 B8
				15 00 00 00 01 00 02 99 02
				15 00 00 00 01 00 02 9A D7
				15 00 00 00 01 00 02 9B 03
				15 01 00 00 01 00 02 9C 05
				15 00 00 00 01 00 02 9D 03
				15 00 00 00 01 00 02 9E 23
				15 00 00 00 01 00 02 9F 03
				15 00 00 00 01 00 02 A0 4B
				15 00 00 00 01 00 02 A2 03
				15 00 00 00 01 00 02 A3 56
				15 00 00 00 01 00 02 A4 03
				15 00 00 00 01 00 02 A5 63
				15 00 00 00 01 00 02 A6 03
				15 00 00 00 01 00 02 A7 6F
				15 00 00 00 01 00 02 A9 03
				15 00 00 00 01 00 02 AA 7D
				15 00 00 00 01 00 02 AB 03
				15 00 00 00 01 00 02 AC 8D
				15 00 00 00 01 00 02 AD 03
				15 00 00 00 01 00 02 AE 9A
				15 00 00 00 01 00 02 AF 03
				15 00 00 00 01 00 02 B0 A3
				15 00 00 00 01 00 02 B1 03
				15 00 00 00 01 00 02 B2 C6
				15 00 00 00 01 00 02 B3 01
				15 00 00 00 01 00 02 B4 5E
				15 00 00 00 01 00 02 B5 01
				15 00 00 00 01 00 02 B6 62
				15 00 00 00 01 00 02 B7 01
				15 00 00 00 01 00 02 B8 6B
				15 00 00 00 01 00 02 B9 01
				15 00 00 00 01 00 02 BA 73
				15 00 00 00 01 00 02 BB 01
				15 00 00 00 01 00 02 BC 7A
				15 00 00 00 01 00 02 BD 01
				15 00 00 00 01 00 02 BE 81
				15 00 00 00 01 00 02 BF 01
				15 00 00 00 01 00 02 C0 88
				15 00 00 00 01 00 02 C1 01
				15 00 00 00 01 00 02 C2 8E
				15 00 00 00 01 00 02 C3 01
				15 00 00 00 01 00 02 C4 94
				15 00 00 00 01 00 02 C5 01
				15 00 00 00 01 00 02 C6 AB
				15 01 00 00 01 00 02 C7 01
				15 00 00 00 01 00 02 C8 BE
				15 00 00 00 01 00 02 C9 01
				15 00 00 00 01 00 02 CA DD
				15 00 00 00 01 00 02 CB 01
				15 00 00 00 01 00 02 CC F7
				15 00 00 00 01 00 02 CD 02
				15 00 00 00 01 00 02 CE 25
				15 00 00 00 01 00 02 CF 02
				15 00 00 00 01 00 02 D0 52
				15 00 00 00 01 00 02 D1 02
				15 00 00 00 01 00 02 D2 53
				15 00 00 00 01 00 02 D3 02
				15 00 00 00 01 00 02 D4 7E
				15 00 00 00 01 00 02 D5 02
				15 00 00 00 01 00 02 D6 B7
				15 00 00 00 01 00 02 D7 02
				15 00 00 00 01 00 02 D8 DC
				15 00 00 00 01 00 02 D9 03
				15 00 00 00 01 00 02 DA 10
				15 00 00 00 01 00 02 DB 03
				15 00 00 00 01 00 02 DC 2A
				15 00 00 00 01 00 02 DD 03
				15 00 00 00 01 00 02 DE 50
				15 00 00 00 01 00 02 DF 03
				15 00 00 00 01 00 02 E0 5B
				15 00 00 00 01 00 02 E1 03
				15 00 00 00 01 00 02 E2 67
				15 00 00 00 01 00 02 E3 03
				15 00 00 00 01 00 02 E4 72
				15 00 00 00 01 00 02 E5 03
				15 00 00 00 01 00 02 E6 80
				15 00 00 00 01 00 02 E7 03
				15 00 00 00 01 00 02 E8 8F
				15 00 00 00 01 00 02 E9 03
				15 00 00 00 01 00 02 EA 9B
				15 00 00 00 01 00 02 EB 03
				15 00 00 00 01 00 02 EC A4
				15 00 00 00 01 00 02 ED 03
				15 00 00 00 01 00 02 EE C6
				15 00 00 00 01 00 02 EF 00
				15 00 00 00 01 00 02 F0 37
				15 00 00 00 01 00 02 F1 00
				15 01 00 00 01 00 02 F2 6A
				15 00 00 00 01 00 02 F3 00
				15 00 00 00 01 00 02 F4 97
				15 00 00 00 01 00 02 F5 00
				15 00 00 00 01 00 02 F6 B4
				15 00 00 00 01 00 02 F7 00
				15 00 00 00 01 00 02 F8 CB
				15 00 00 00 01 00 02 F9 00
				15 00 00 00 01 00 02 FA DE
				15 00 00 00 01 00 02 FF 21
				15 00 00 00 01 00 02 FB 01
				15 00 00 00 01 00 02 00 00
				15 00 00 00 01 00 02 01 F0
				15 00 00 00 01 00 02 02 00
				15 00 00 00 01 00 02 03 FE
				15 00 00 00 01 00 02 04 01
				15 00 00 00 01 00 02 05 0D
				15 00 00 00 01 00 02 06 01
				15 00 00 00 01 00 02 07 3B
				15 00 00 00 01 00 02 08 01
				15 00 00 00 01 00 02 09 61
				15 00 00 00 01 00 02 0A 01
				15 00 00 00 01 00 02 0B 9E
				15 00 00 00 01 00 02 0C 01
				15 00 00 00 01 00 02 0D CF
				15 00 00 00 01 00 02 0E 02
				15 00 00 00 01 00 02 0F 1A
				15 00 00 00 01 00 02 10 02
				15 00 00 00 01 00 02 11 4D
				15 00 00 00 01 00 02 12 02
				15 00 00 00 01 00 02 13 4F
				15 00 00 00 01 00 02 14 02
				15 00 00 00 01 00 02 15 7D
				15 00 00 00 01 00 02 16 02
				15 00 00 00 01 00 02 17 B1
				15 00 00 00 01 00 02 18 02
				15 00 00 00 01 00 02 19 D1
				15 00 00 00 01 00 02 1A 03
				15 00 00 00 01 00 02 1B 03
				15 00 00 00 01 00 02 1C 03
				15 00 00 00 01 00 02 1D 22
				15 01 00 00 01 00 02 1E 03
				15 00 00 00 01 00 02 1F 4A
				15 00 00 00 01 00 02 20 03
				15 00 00 00 01 00 02 21 56
				15 00 00 00 01 00 02 22 03
				15 00 00 00 01 00 02 23 62
				15 00 00 00 01 00 02 24 03
				15 00 00 00 01 00 02 25 70
				15 00 00 00 01 00 02 26 03
				15 00 00 00 01 00 02 27 82
				15 00 00 00 01 00 02 28 03
				15 00 00 00 01 00 02 29 93
				15 00 00 00 01 00 02 2A 03
				15 00 00 00 01 00 02 2B A9
				15 00 00 00 01 00 02 2D 03
				15 00 00 00 01 00 02 2F C0
				15 00 00 00 01 00 02 30 03
				15 00 00 00 01 00 02 31 C6
				15 00 00 00 01 00 02 32 00
				15 00 00 00 01 00 02 33 84
				15 00 00 00 01 00 02 34 00
				15 00 00 00 01 00 02 35 B5
				15 00 00 00 01 00 02 36 00
				15 00 00 00 01 00 02 37 E0
				15 00 00 00 01 00 02 38 00
				15 00 00 00 01 00 02 39 FB
				15 00 00 00 01 00 02 3A 01
				15 00 00 00 01 00 02 3B 11
				15 00 00 00 01 00 02 3D 01
				15 00 00 00 01 00 02 3F 23
				15 00 00 00 01 00 02 40 01
				15 00 00 00 01 00 02 41 31
				15 00 00 00 01 00 02 42 01
				15 00 00 00 01 00 02 43 3E
				15 00 00 00 01 00 02 44 01
				15 00 00 00 01 00 02 45 4B
				15 00 00 00 01 00 02 46 01
				15 00 00 00 01 00 02 47 72
				15 00 00 00 01 00 02 48 01
				15 00 00 00 01 00 02 49 90
				15 01 00 00 01 00 02 4A 01
				15 00 00 00 01 00 02 4B BD
				15 00 00 00 01 00 02 4C 01
				15 00 00 00 01 00 02 4D DE
				15 00 00 00 01 00 02 4E 02
				15 00 00 00 01 00 02 4F 15
				15 00 00 00 01 00 02 50 02
				15 00 00 00 01 00 02 51 48
				15 00 00 00 01 00 02 52 02
				15 00 00 00 01 00 02 53 4A
				15 00 00 00 01 00 02 54 02
				15 00 00 00 01 00 02 55 78
				15 00 00 00 01 00 02 56 02
				15 00 00 00 01 00 02 58 AE
				15 00 00 00 01 00 02 59 02
				15 00 00 00 01 00 02 5A D0
				15 00 00 00 01 00 02 5B 02
				15 00 00 00 01 00 02 5C FE
				15 00 00 00 01 00 02 5D 03
				15 00 00 00 01 00 02 5E 1E
				15 00 00 00 01 00 02 5F 03
				15 00 00 00 01 00 02 60 47
				15 00 00 00 01 00 02 61 03
				15 00 00 00 01 00 02 62 54
				15 00 00 00 01 00 02 63 03
				15 00 00 00 01 00 02 64 61
				15 00 00 00 01 00 02 65 03
				15 00 00 00 01 00 02 66 6F
				15 00 00 00 01 00 02 67 03
				15 00 00 00 01 00 02 68 81
				15 00 00 00 01 00 02 69 03
				15 00 00 00 01 00 02 6A 92
				15 00 00 00 01 00 02 6B 03
				15 00 00 00 01 00 02 6C A8
				15 00 00 00 01 00 02 6D 03
				15 00 00 00 01 00 02 6E BF
				15 00 00 00 01 00 02 6F 03
				15 00 00 00 01 00 02 70 C6
				15 00 00 00 01 00 02 71 01
				15 00 00 00 01 00 02 72 38
				15 01 00 00 01 00 02 73 01
				15 00 00 00 01 00 02 74 3E
				15 00 00 00 01 00 02 75 01
				15 00 00 00 01 00 02 76 46
				15 00 00 00 01 00 02 77 01
				15 00 00 00 01 00 02 78 4F
				15 00 00 00 01 00 02 79 01
				15 00 00 00 01 00 02 7A 56
				15 00 00 00 01 00 02 7B 01
				15 00 00 00 01 00 02 7C 5F
				15 00 00 00 01 00 02 7D 01
				15 00 00 00 01 00 02 7E 66
				15 00 00 00 01 00 02 7F 01
				15 00 00 00 01 00 02 80 6E
				15 00 00 00 01 00 02 81 01
				15 00 00 00 01 00 02 82 74
				15 00 00 00 01 00 02 83 01
				15 00 00 00 01 00 02 84 8F
				15 00 00 00 01 00 02 85 01
				15 00 00 00 01 00 02 86 A6
				15 00 00 00 01 00 02 87 01
				15 00 00 00 01 00 02 88 D1
				15 00 00 00 01 00 02 89 01
				15 00 00 00 01 00 02 8A F6
				15 00 00 00 01 00 02 8B 02
				15 00 00 00 01 00 02 8C 32
				15 00 00 00 01 00 02 8D 02
				15 00 00 00 01 00 02 8E 5F
				15 00 00 00 01 00 02 8F 02
				15 00 00 00 01 00 02 90 60
				15 00 00 00 01 00 02 91 02
				15 00 00 00 01 00 02 92 8A
				15 00 00 00 01 00 02 93 02
				15 00 00 00 01 00 02 94 BF
				15 00 00 00 01 00 02 95 02
				15 00 00 00 01 00 02 96 E0
				15 00 00 00 01 00 02 97 03
				15 00 00 00 01 00 02 98 17
				15 00 00 00 01 00 02 99 03
				15 00 00 00 01 00 02 9A 2D
				15 01 00 00 01 00 02 9B 03
				15 00 00 00 01 00 02 9C 53
				15 00 00 00 01 00 02 9D 03
				15 00 00 00 01 00 02 9E 5F
				15 00 00 00 01 00 02 9F 03
				15 00 00 00 01 00 02 A0 6B
				15 00 00 00 01 00 02 A2 03
				15 00 00 00 01 00 02 A3 78
				15 00 00 00 01 00 02 A4 03
				15 00 00 00 01 00 02 A5 87
				15 00 00 00 01 00 02 A6 03
				15 00 00 00 01 00 02 A7 98
				15 00 00 00 01 00 02 A9 03
				15 00 00 00 01 00 02 AA AB
				15 00 00 00 01 00 02 AB 03
				15 00 00 00 01 00 02 AC C0
				15 00 00 00 01 00 02 AD 03
				15 00 00 00 01 00 02 AE C6
				15 00 00 00 01 00 02 AF 01
				15 00 00 00 01 00 02 B0 73
				15 00 00 00 01 00 02 B1 01
				15 00 00 00 01 00 02 B2 77
				15 00 00 00 01 00 02 B3 01
				15 00 00 00 01 00 02 B4 7F
				15 00 00 00 01 00 02 B5 01
				15 00 00 00 01 00 02 B6 86
				15 00 00 00 01 00 02 B7 01
				15 00 00 00 01 00 02 B8 8B
				15 00 00 00 01 00 02 B9 01
				15 00 00 00 01 00 02 BA 92
				15 00 00 00 01 00 02 BB 01
				15 00 00 00 01 00 02 BC 99
				15 00 00 00 01 00 02 BD 01
				15 00 00 00 01 00 02 BE 9F
				15 00 00 00 01 00 02 BF 01
				15 00 00 00 01 00 02 C0 A3
				15 00 00 00 01 00 02 C1 01
				15 00 00 00 01 00 02 C2 B8
				15 00 00 00 01 00 02 C3 01
				15 00 00 00 01 00 02 C4 C9
				15 00 00 00 01 00 02 C5 01
				15 00 00 00 01 00 02 C6 E8
				15 01 00 00 01 00 02 C7 02
				15 00 00 00 01 00 02 C8 01
				15 00 00 00 01 00 02 C9 02
				15 00 00 00 01 00 02 CA 2D
				15 00 00 00 01 00 02 CB 02
				15 00 00 00 01 00 02 CC 5A
				15 00 00 00 01 00 02 CD 02
				15 00 00 00 01 00 02 CE 5B
				15 00 00 00 01 00 02 CF 02
				15 00 00 00 01 00 02 D0 85
				15 00 00 00 01 00 02 D1 02
				15 00 00 00 01 00 02 D2 BC
				15 00 00 00 01 00 02 D3 02
				15 00 00 00 01 00 02 D4 DF
				15 00 00 00 01 00 02 D5 03
				15 00 00 00 01 00 02 D6 12
				15 00 00 00 01 00 02 D7 03
				15 00 00 00 01 00 02 D8 29
				15 00 00 00 01 00 02 D9 03
				15 00 00 00 01 00 02 DA 50
				15 00 00 00 01 00 02 DB 03
				15 00 00 00 01 00 02 DC 5C
				15 00 00 00 01 00 02 DD 03
				15 00 00 00 01 00 02 DE 6A
				15 00 00 00 01 00 02 DF 03
				15 00 00 00 01 00 02 E0 77
				15 00 00 00 01 00 02 E1 03
				15 00 00 00 01 00 02 E2 86
				15 00 00 00 01 00 02 E3 03
				15 00 00 00 01 00 02 E4 97
				15 00 00 00 01 00 02 E5 03
				15 00 00 00 01 00 02 E6 AA
				15 00 00 00 01 00 02 E7 03
				15 00 00 00 01 00 02 E8 BF
				15 00 00 00 01 00 02 E9 03
				15 00 00 00 01 00 02 EA C6
				15 01 00 00 01 00 02 FF 10
		];

		qcom,mdss-dsi-off-command = [
				15 01 00 00 00 00 02 FF 10
				39 01 00 00 11 00 02 28 00
				39 01 00 00 44 00 02 10 00
				15 01 00 00 09 00 02 4F 01
		];
		qcom,mdss-dsi-on-command-state = "dsi_lp_mode";
		qcom,mdss-dsi-off-command-state = "dsi_hs_mode";
		qcom,mdss-dsi-h-sync-pulse = <0>;
		qcom,mdss-dsi-traffic-mode = "non_burst_sync_pulse";
		qcom,mdss-dsi-bllp-eof-power-mode;
		qcom,mdss-dsi-bllp-power-mode;
		qcom,mdss-dsi-lane-0-state;
		qcom,mdss-dsi-lane-1-state;
		qcom,mdss-dsi-lane-2-state;
		qcom,mdss-dsi-lane-3-state;
		qcom,mdss-dsi-lp11-init;
		qcom,mdss-dsi-panel-timings = [E0 4A 36 00 A9 AA 2B 4E 3C 03 04 00];
		qcom,mdss-dsi-t-clk-post = <0x19>;
		qcom,mdss-dsi-t-clk-pre = <0x2f>;
		qcom,mdss-dsi-bl-min-level = <1>;
		qcom,mdss-dsi-bl-max-level = <4095>;

		qcom,mdss-dsi-dma-trigger = "trigger_sw";
		qcom,mdss-dsi-mdp-trigger = "none";
		qcom,mdss-dsi-bl-pmic-control-type = "bl_ctrl_wled";
		qcom,mdss-dsi-reset-sequence = <1 5>, <0 5>, <1 10>;
		qcom,mdss-pan-physical-width-dimension = <61>;
		qcom,mdss-pan-physical-height-dimension = <109>;
		qcom,cont-splash-enabled;
		qcom,dispparam-enabled;
		qcom,mdss-night-brightness = <0xb 0x10 0x14 0x1a>;
		qcom,mdss-dsi-dispparam-ceon-command;
		qcom,mdss-dsi-dispparam-ceon-command-state = "dsi_hs_mode";
		qcom,mdss-dsi-dispparam-ceoff-command;
		qcom,mdss-dsi-dispparam-ceoff-command-state = "dsi_hs_mode";
		qcom,mdss-dsi-dispparam-warm-command = [15 00 00 00 01 00 02 ff 20 15 00 00 00 01 00 02 fb 01 15 00 00 00 01 00 02 75 00 15 00 00 00 01 00 02 76 f1 15 00 00 00 01 00 02 77 00 15 00 00 00 01 00 02 78 f8 15 00 00 00 01 00 02 79 01 15 00 00 00 01 00 02 7a 06 15 00 00 00 01 00 02 7b 01 15 00 00 00 01 00 02 7c 13 15 00 00 00 01 00 02 7d 01 15 00 00 00 01 00 02 7e 1f 15 00 00 00 01 00 02 7f 01 15 00 00 00 01 00 02 80 2a 15 00 00 00 01 00 02 81 01 15 00 00 00 01 00 02 82 35 15 00 00 00 01 00 02 83 01 15 00 00 00 01 00 02 84 3e 15 00 00 00 01 00 02 85 01 15 00 00 00 01 00 02 86 48 15 00 00 00 01 00 02 87 01 15 00 00 00 01 00 02 88 69 15 00 00 00 01 00 02 89 01 15 00 00 00 01 00 02 8a 87 15 00 00 00 01 00 02 8b 01 15 00 00 00 01 00 02 8c b8 15 00 00 00 01 00 02 8d 01 15 00 00 00 01 00 02 8e e3 15 00 00 00 01 00 02 8f 02 15 00 00 00 01 00 02 90 25 15 00 00 00 01 00 02 91 02 15 00 00 00 01 00 02 92 54 15 00 00 00 01 00 02 93 02 15 00 00 00 01 00 02 94 56 15 00 00 00 01 00 02 95 02 15 00 00 00 01 00 02 96 82 15 00 00 00 01 00 02 97 02 15 00 00 00 01 00 02 98 b5 15 00 00 00 01 00 02 99 02 15 00 00 00 01 00 02 9a d5 15 00 00 00 01 00 02 9b 03 15 01 00 00 01 00 02 9c 06 15 00 00 00 01 00 02 9d 03 15 00 00 00 01 00 02 9e 30 15 00 00 00 01 00 02 9f 03 15 00 00 00 01 00 02 a0 58 15 00 00 00 01 00 02 a2 03 15 00 00 00 01 00 02 a3 64 15 00 00 00 01 00 02 a4 03 15 00 00 00 01 00 02 a5 6f 15 00 00 00 01 00 02 a6 03 15 00 00 00 01 00 02 a7 7d 15 00 00 00 01 00 02 a9 03 15 00 00 00 01 00 02 aa 8d 15 00 00 00 01 00 02 ab 03 15 00 00 00 01 00 02 ac 9e 15 00 00 00 01 00 02 ad 03 15 00 00 00 01 00 02 ae b1 15 00 00 00 01 00 02 af 03 15 00 00 00 01 00 02 b0 c3 15 00 00 00 01 00 02 b1 03 15 00 00 00 01 00 02 b2 c6 15 00 00 00 01 00 02 b3 01 15 00 00 00 01 00 02 b4 30 15 00 00 00 01 00 02 b5 01 15 00 00 00 01 00 02 b6 35 15 00 00 00 01 00 02 b7 01 15 00 00 00 01 00 02 b8 41 15 00 00 00 01 00 02 b9 01 15 00 00 00 01 00 02 ba 4e 15 00 00 00 01 00 02 bb 01 15 00 00 00 01 00 02 bc 58 15 00 00 00 01 00 02 bd 01 15 00 00 00 01 00 02 be 61 15 00 00 00 01 00 02 bf 01 15 00 00 00 01 00 02 c0 6a 15 00 00 00 01 00 02 c1 01 15 00 00 00 01 00 02 c2 72 15 00 00 00 01 00 02 c3 01 15 00 00 00 01 00 02 c4 7b 15 00 00 00 01 00 02 c5 01 15 00 00 00 01 00 02 c6 95 15 01 00 00 01 00 02 c7 01 15 00 00 00 01 00 02 c8 ac 15 00 00 00 01 00 02 c9 01 15 00 00 00 01 00 02 ca d1 15 00 00 00 01 00 02 cb 01 15 00 00 00 01 00 02 cc ee 15 00 00 00 01 00 02 cd 02 15 00 00 00 01 00 02 ce 20 15 00 00 00 01 00 02 cf 02 15 00 00 00 01 00 02 d0 4f 15 00 00 00 01 00 02 d1 02 15 00 00 00 01 00 02 d2 51 15 00 00 00 01 00 02 d3 02 15 00 00 00 01 00 02 d4 7d 15 00 00 00 01 00 02 d5 02 15 00 00 00 01 00 02 d6 b2 15 00 00 00 01 00 02 d7 02 15 00 00 00 01 00 02 d8 d4 15 00 00 00 01 00 02 d9 03 15 00 00 00 01 00 02 da 01 15 00 00 00 01 00 02 db 03 15 00 00 00 01 00 02 dc 2c 15 00 00 00 01 00 02 dd 03 15 00 00 00 01 00 02 de 55 15 00 00 00 01 00 02 df 03 15 00 00 00 01 00 02 e0 61 15 00 00 00 01 00 02 e1 03 15 00 00 00 01 00 02 e2 6e 15 00 00 00 01 00 02 e3 03 15 00 00 00 01 00 02 e4 7c 15 00 00 00 01 00 02 e5 03 15 00 00 00 01 00 02 e6 8c 15 00 00 00 01 00 02 e7 03 15 00 00 00 01 00 02 e8 9d 15 00 00 00 01 00 02 e9 03 15 00 00 00 01 00 02 ea b0 15 00 00 00 01 00 02 eb 03 15 00 00 00 01 00 02 ec c2 15 00 00 00 01 00 02 ed 03 15 00 00 00 01 00 02 ee c6 15 00 00 00 01 00 02 ef 00 15 00 00 00 01 00 02 f0 37 15 00 00 00 01 00 02 f1 00 15 01 00 00 01 00 02 f2 73 15 00 00 00 01 00 02 f3 00 15 00 00 00 01 00 02 f4 9d 15 00 00 00 01 00 02 f5 00 15 00 00 00 01 00 02 f6 b9 15 00 00 00 01 00 02 f7 00 15 00 00 00 01 00 02 f8 cf 15 00 00 00 01 00 02 f9 00 15 00 00 00 01 00 02 fa e2 15 00 00 00 01 00 02 ff 21 15 00 00 00 01 00 02 fb 01 15 00 00 00 01 00 02 00 00 15 00 00 00 01 00 02 01 f3 15 00 00 00 01 00 02 02 01 15 00 00 00 01 00 02 03 02 15 00 00 00 01 00 02 04 01 15 00 00 00 01 00 02 05 0f 15 00 00 00 01 00 02 06 01 15 00 00 00 01 00 02 07 3d 15 00 00 00 01 00 02 08 01 15 00 00 00 01 00 02 09 62 15 00 00 00 01 00 02 0a 01 15 00 00 00 01 00 02 0b 9f 15 00 00 00 01 00 02 0c 01 15 00 00 00 01 00 02 0d d0 15 00 00 00 01 00 02 0e 02 15 00 00 00 01 00 02 0f 1a 15 00 00 00 01 00 02 10 02 15 00 00 00 01 00 02 11 4d 15 00 00 00 01 00 02 12 02 15 00 00 00 01 00 02 13 4f 15 00 00 00 01 00 02 14 02 15 00 00 00 01 00 02 15 7c 15 00 00 00 01 00 02 16 02 15 00 00 00 01 00 02 17 af 15 00 00 00 01 00 02 18 02 15 00 00 00 01 00 02 19 cf 15 00 00 00 01 00 02 1a 02 15 00 00 00 01 00 02 1b fd 15 00 00 00 01 00 02 1c 03 15 00 00 00 01 00 02 1d 21 15 01 00 00 01 00 02 1e 03 15 00 00 00 01 00 02 1f 47 15 00 00 00 01 00 02 20 03 15 00 00 00 01 00 02 21 51 15 00 00 00 01 00 02 22 03 15 00 00 00 01 00 02 23 5e 15 00 00 00 01 00 02 24 03 15 00 00 00 01 00 02 25 6d 15 00 00 00 01 00 02 26 03 15 00 00 00 01 00 02 27 7e 15 00 00 00 01 00 02 28 03 15 00 00 00 01 00 02 29 8e 15 00 00 00 01 00 02 2a 03 15 00 00 00 01 00 02 2b a3 15 00 00 00 01 00 02 2d 03 15 00 00 00 01 00 02 2f c1 15 00 00 00 01 00 02 30 03 15 00 00 00 01 00 02 31 c6 15 00 00 00 01 00 02 32 00 15 00 00 00 01 00 02 33 84 15 00 00 00 01 00 02 34 00 15 00 00 00 01 00 02 35 be 15 00 00 00 01 00 02 36 00 15 00 00 00 01 00 02 37 e6 15 00 00 00 01 00 02 38 01 15 00 00 00 01 00 02 39 01 15 00 00 00 01 00 02 3a 01 15 00 00 00 01 00 02 3b 15 15 00 00 00 01 00 02 3d 01 15 00 00 00 01 00 02 3f 26 15 00 00 00 01 00 02 40 01 15 00 00 00 01 00 02 41 34 15 00 00 00 01 00 02 42 01 15 00 00 00 01 00 02 43 42 15 00 00 00 01 00 02 44 01 15 00 00 00 01 00 02 45 4e 15 00 00 00 01 00 02 46 01 15 00 00 00 01 00 02 47 74 15 00 00 00 01 00 02 48 01 15 00 00 00 01 00 02 49 91 15 01 00 00 01 00 02 4a 01 15 00 00 00 01 00 02 4b be 15 00 00 00 01 00 02 4c 01 15 00 00 00 01 00 02 4d df 15 00 00 00 01 00 02 4e 02 15 00 00 00 01 00 02 4f 15 15 00 00 00 01 00 02 50 02 15 00 00 00 01 00 02 51 48 15 00 00 00 01 00 02 52 02 15 00 00 00 01 00 02 53 4a 15 00 00 00 01 00 02 54 02 15 00 00 00 01 00 02 55 77 15 00 00 00 01 00 02 56 02 15 00 00 00 01 00 02 58 ac 15 00 00 00 01 00 02 59 02 15 00 00 00 01 00 02 5a ce 15 00 00 00 01 00 02 5b 02 15 00 00 00 01 00 02 5c f9 15 00 00 00 01 00 02 5d 03 15 00 00 00 01 00 02 5e 1d 15 00 00 00 01 00 02 5f 03 15 00 00 00 01 00 02 60 44 15 00 00 00 01 00 02 61 03 15 00 00 00 01 00 02 62 4f 15 00 00 00 01 00 02 63 03 15 00 00 00 01 00 02 64 5d 15 00 00 00 01 00 02 65 03 15 00 00 00 01 00 02 66 6c 15 00 00 00 01 00 02 67 03 15 00 00 00 01 00 02 68 7d 15 00 00 00 01 00 02 69 03 15 00 00 00 01 00 02 6a 8d 15 00 00 00 01 00 02 6b 03 15 00 00 00 01 00 02 6c a2 15 00 00 00 01 00 02 6d 03 15 00 00 00 01 00 02 6e c0 15 00 00 00 01 00 02 6f 03 15 00 00 00 01 00 02 70 c6 15 00 00 00 01 00 02 71 01 15 00 00 00 01 00 02 72 73 15 01 00 00 01 00 02 73 01 15 00 00 00 01 00 02 74 75 15 00 00 00 01 00 02 75 01 15 00 00 00 01 00 02 76 7c 15 00 00 00 01 00 02 77 01 15 00 00 00 01 00 02 78 81 15 00 00 00 01 00 02 79 01 15 00 00 00 01 00 02 7a 87 15 00 00 00 01 00 02 7b 01 15 00 00 00 01 00 02 7c 8d 15 00 00 00 01 00 02 7d 01 15 00 00 00 01 00 02 7e 92 15 00 00 00 01 00 02 7f 01 15 00 00 00 01 00 02 80 98 15 00 00 00 01 00 02 81 01 15 00 00 00 01 00 02 82 9d 15 00 00 00 01 00 02 83 01 15 00 00 00 01 00 02 84 b2 15 00 00 00 01 00 02 85 01 15 00 00 00 01 00 02 86 c6 15 00 00 00 01 00 02 87 01 15 00 00 00 01 00 02 88 ea 15 00 00 00 01 00 02 89 02 15 00 00 00 01 00 02 8a 0c 15 00 00 00 01 00 02 8b 02 15 00 00 00 01 00 02 8c 3f 15 00 00 00 01 00 02 8d 02 15 00 00 00 01 00 02 8e 68 15 00 00 00 01 00 02 8f 02 15 00 00 00 01 00 02 90 6a 15 00 00 00 01 00 02 91 02 15 00 00 00 01 00 02 92 92 15 00 00 00 01 00 02 93 02 15 00 00 00 01 00 02 94 c1 15 00 00 00 01 00 02 95 02 15 00 00 00 01 00 02 96 e0 15 00 00 00 01 00 02 97 03 15 00 00 00 01 00 02 98 10 15 00 00 00 01 00 02 99 03 15 00 00 00 01 00 02 9a 3a 15 01 00 00 01 00 02 9b 03 15 00 00 00 01 00 02 9c 5a 15 00 00 00 01 00 02 9d 03 15 00 00 00 01 00 02 9e 66 15 00 00 00 01 00 02 9f 03 15 00 00 00 01 00 02 a0 71 15 00 00 00 01 00 02 a2 03 15 00 00 00 01 00 02 a3 7e 15 00 00 00 01 00 02 a4 03 15 00 00 00 01 00 02 a5 8b 15 00 00 00 01 00 02 a6 03 15 00 00 00 01 00 02 a7 99 15 00 00 00 01 00 02 a9 03 15 00 00 00 01 00 02 aa b0 15 00 00 00 01 00 02 ab 03 15 00 00 00 01 00 02 ac be 15 00 00 00 01 00 02 ad 03 15 00 00 00 01 00 02 ae c6 15 00 00 00 01 00 02 af 01 15 00 00 00 01 00 02 b0 a7 15 00 00 00 01 00 02 b1 01 15 00 00 00 01 00 02 b2 aa 15 00 00 00 01 00 02 b3 01 15 00 00 00 01 00 02 b4 af 15 00 00 00 01 00 02 b5 01 15 00 00 00 01 00 02 b6 b2 15 00 00 00 01 00 02 b7 01 15 00 00 00 01 00 02 b8 b8 15 00 00 00 01 00 02 b9 01 15 00 00 00 01 00 02 ba bc 15 00 00 00 01 00 02 bb 01 15 00 00 00 01 00 02 bc bf 15 00 00 00 01 00 02 bd 01 15 00 00 00 01 00 02 be c3 15 00 00 00 01 00 02 bf 01 15 00 00 00 01 00 02 c0 c7 15 00 00 00 01 00 02 c1 01 15 00 00 00 01 00 02 c2 d7 15 00 00 00 01 00 02 c3 01 15 00 00 00 01 00 02 c4 e5 15 00 00 00 01 00 02 c5 01 15 00 00 00 01 00 02 c6 fd 15 01 00 00 01 00 02 c7 02 15 00 00 00 01 00 02 c8 13 15 00 00 00 01 00 02 c9 02 15 00 00 00 01 00 02 ca 38 15 00 00 00 01 00 02 cb 02 15 00 00 00 01 00 02 cc 61 15 00 00 00 01 00 02 cd 02 15 00 00 00 01 00 02 ce 63 15 00 00 00 01 00 02 cf 02 15 00 00 00 01 00 02 d0 8b 15 00 00 00 01 00 02 d1 02 15 00 00 00 01 00 02 d2 c2 15 00 00 00 01 00 02 d3 02 15 00 00 00 01 00 02 d4 e7 15 00 00 00 01 00 02 d5 03 15 00 00 00 01 00 02 d6 1e 15 00 00 00 01 00 02 d7 03 15 00 00 00 01 00 02 d8 45 15 00 00 00 01 00 02 d9 03 15 00 00 00 01 00 02 da 61 15 00 00 00 01 00 02 db 03 15 00 00 00 01 00 02 dc 6b 15 00 00 00 01 00 02 dd 03 15 00 00 00 01 00 02 de 76 15 00 00 00 01 00 02 df 03 15 00 00 00 01 00 02 e0 81 15 00 00 00 01 00 02 e1 03 15 00 00 00 01 00 02 e2 8e 15 00 00 00 01 00 02 e3 03 15 00 00 00 01 00 02 e4 9b 15 00 00 00 01 00 02 e5 03 15 00 00 00 01 00 02 e6 b1 15 00 00 00 01 00 02 e7 03 15 00 00 00 01 00 02 e8 bf 15 00 00 00 01 00 02 e9 03 15 00 00 00 01 00 02 ea c6 15 01 00 00 01 00 02 ff 10];
		qcom,mdss-dsi-dispparam-warm-command-state = "dsi_hs_mode";
		qcom,mdss-dsi-dispparam-default-command = [15 01 00 00 01 00 02 ff 20 15 00 00 00 01 00 02 fb 01 15 00 00 00 01 00 02 75 01 15 00 00 00 01 00 02 76 27 15 00 00 00 01 00 02 77 01 15 00 00 00 01 00 02 78 2d 15 00 00 00 01 00 02 79 01 15 00 00 00 01 00 02 7a 37 15 00 00 00 01 00 02 7b 01 15 00 00 00 01 00 02 7c 40 15 00 00 00 01 00 02 7d 01 15 00 00 00 01 00 02 7e 49 15 00 00 00 01 00 02 7f 01 15 00 00 00 01 00 02 80 52 15 00 00 00 01 00 02 81 01 15 00 00 00 01 00 02 82 5a 15 00 00 00 01 00 02 83 01 15 00 00 00 01 00 02 84 61 15 00 00 00 01 00 02 85 01 15 00 00 00 01 00 02 86 69 15 00 00 00 01 00 02 87 01 15 00 00 00 01 00 02 88 86 15 00 00 00 01 00 02 89 01 15 00 00 00 01 00 02 8a 9f 15 00 00 00 01 00 02 8b 01 15 00 00 00 01 00 02 8c ca 15 00 00 00 01 00 02 8d 01 15 00 00 00 01 00 02 8e f0 15 00 00 00 01 00 02 8f 02 15 00 00 00 01 00 02 90 2e 15 00 00 00 01 00 02 91 02 15 00 00 00 01 00 02 92 5b 15 00 00 00 01 00 02 93 02 15 00 00 00 01 00 02 94 5c 15 00 00 00 01 00 02 95 02 15 00 00 00 01 00 02 96 87 15 00 00 00 01 00 02 97 02 15 00 00 00 01 00 02 98 b8 15 00 00 00 01 00 02 99 02 15 00 00 00 01 00 02 9a d7 15 00 00 00 01 00 02 9b 03 15 01 00 00 01 00 02 9c 05 15 00 00 00 01 00 02 9d 03 15 00 00 00 01 00 02 9e 23 15 00 00 00 01 00 02 9f 03 15 00 00 00 01 00 02 a0 4b 15 00 00 00 01 00 02 a2 03 15 00 00 00 01 00 02 a3 56 15 00 00 00 01 00 02 a4 03 15 00 00 00 01 00 02 a5 63 15 00 00 00 01 00 02 a6 03 15 00 00 00 01 00 02 a7 6f 15 00 00 00 01 00 02 a9 03 15 00 00 00 01 00 02 aa 7d 15 00 00 00 01 00 02 ab 03 15 00 00 00 01 00 02 ac 8d 15 00 00 00 01 00 02 ad 03 15 00 00 00 01 00 02 ae 9a 15 00 00 00 01 00 02 af 03 15 00 00 00 01 00 02 b0 a3 15 00 00 00 01 00 02 b1 03 15 00 00 00 01 00 02 b2 c6 15 00 00 00 01 00 02 b3 01 15 00 00 00 01 00 02 b4 5e 15 00 00 00 01 00 02 b5 01 15 00 00 00 01 00 02 b6 62 15 00 00 00 01 00 02 b7 01 15 00 00 00 01 00 02 b8 6b 15 00 00 00 01 00 02 b9 01 15 00 00 00 01 00 02 ba 73 15 00 00 00 01 00 02 bb 01 15 00 00 00 01 00 02 bc 7a 15 00 00 00 01 00 02 bd 01 15 00 00 00 01 00 02 be 81 15 00 00 00 01 00 02 bf 01 15 00 00 00 01 00 02 c0 88 15 00 00 00 01 00 02 c1 01 15 00 00 00 01 00 02 c2 8e 15 00 00 00 01 00 02 c3 01 15 00 00 00 01 00 02 c4 94 15 00 00 00 01 00 02 c5 01 15 00 00 00 01 00 02 c6 ab 15 01 00 00 01 00 02 c7 01 15 00 00 00 01 00 02 c8 be 15 00 00 00 01 00 02 c9 01 15 00 00 00 01 00 02 ca dd 15 00 00 00 01 00 02 cb 01 15 00 00 00 01 00 02 cc f7 15 00 00 00 01 00 02 cd 02 15 00 00 00 01 00 02 ce 25 15 00 00 00 01 00 02 cf 02 15 00 00 00 01 00 02 d0 52 15 00 00 00 01 00 02 d1 02 15 00 00 00 01 00 02 d2 53 15 00 00 00 01 00 02 d3 02 15 00 00 00 01 00 02 d4 7e 15 00 00 00 01 00 02 d5 02 15 00 00 00 01 00 02 d6 b7 15 00 00 00 01 00 02 d7 02 15 00 00 00 01 00 02 d8 dc 15 00 00 00 01 00 02 d9 03 15 00 00 00 01 00 02 da 10 15 00 00 00 01 00 02 db 03 15 00 00 00 01 00 02 dc 2a 15 00 00 00 01 00 02 dd 03 15 00 00 00 01 00 02 de 50 15 00 00 00 01 00 02 df 03 15 00 00 00 01 00 02 e0 5b 15 00 00 00 01 00 02 e1 03 15 00 00 00 01 00 02 e2 67 15 00 00 00 01 00 02 e3 03 15 00 00 00 01 00 02 e4 72 15 00 00 00 01 00 02 e5 03 15 00 00 00 01 00 02 e6 80 15 00 00 00 01 00 02 e7 03 15 00 00 00 01 00 02 e8 8f 15 00 00 00 01 00 02 e9 03 15 00 00 00 01 00 02 ea 9b 15 00 00 00 01 00 02 eb 03 15 00 00 00 01 00 02 ec a4 15 00 00 00 01 00 02 ed 03 15 00 00 00 01 00 02 ee c6 15 00 00 00 01 00 02 ef 00 15 00 00 00 01 00 02 f0 37 15 00 00 00 01 00 02 f1 00 15 01 00 00 01 00 02 f2 6a 15 00 00 00 01 00 02 f3 00 15 00 00 00 01 00 02 f4 97 15 00 00 00 01 00 02 f5 00 15 00 00 00 01 00 02 f6 b4 15 00 00 00 01 00 02 f7 00 15 00 00 00 01 00 02 f8 cb 15 00 00 00 01 00 02 f9 00 15 00 00 00 01 00 02 fa de 15 00 00 00 01 00 02 ff 21 15 00 00 00 01 00 02 fb 01 15 00 00 00 01 00 02 00 00 15 00 00 00 01 00 02 01 f0 15 00 00 00 01 00 02 02 00 15 00 00 00 01 00 02 03 fe 15 00 00 00 01 00 02 04 01 15 00 00 00 01 00 02 05 0d 15 00 00 00 01 00 02 06 01 15 00 00 00 01 00 02 07 3b 15 00 00 00 01 00 02 08 01 15 00 00 00 01 00 02 09 61 15 00 00 00 01 00 02 0a 01 15 00 00 00 01 00 02 0b 9e 15 00 00 00 01 00 02 0c 01 15 00 00 00 01 00 02 0d cf 15 00 00 00 01 00 02 0e 02 15 00 00 00 01 00 02 0f 1a 15 00 00 00 01 00 02 10 02 15 00 00 00 01 00 02 11 4d 15 00 00 00 01 00 02 12 02 15 00 00 00 01 00 02 13 4f 15 00 00 00 01 00 02 14 02 15 00 00 00 01 00 02 15 7d 15 00 00 00 01 00 02 16 02 15 00 00 00 01 00 02 17 b1 15 00 00 00 01 00 02 18 02 15 00 00 00 01 00 02 19 d1 15 00 00 00 01 00 02 1a 03 15 00 00 00 01 00 02 1b 03 15 00 00 00 01 00 02 1c 03 15 00 00 00 01 00 02 1d 22 15 01 00 00 01 00 02 1e 03 15 00 00 00 01 00 02 1f 4a 15 00 00 00 01 00 02 20 03 15 00 00 00 01 00 02 21 56 15 00 00 00 01 00 02 22 03 15 00 00 00 01 00 02 23 62 15 00 00 00 01 00 02 24 03 15 00 00 00 01 00 02 25 70 15 00 00 00 01 00 02 26 03 15 00 00 00 01 00 02 27 82 15 00 00 00 01 00 02 28 03 15 00 00 00 01 00 02 29 93 15 00 00 00 01 00 02 2a 03 15 00 00 00 01 00 02 2b a9 15 00 00 00 01 00 02 2d 03 15 00 00 00 01 00 02 2f c0 15 00 00 00 01 00 02 30 03 15 00 00 00 01 00 02 31 c6 15 00 00 00 01 00 02 32 00 15 00 00 00 01 00 02 33 84 15 00 00 00 01 00 02 34 00 15 00 00 00 01 00 02 35 b5 15 00 00 00 01 00 02 36 00 15 00 00 00 01 00 02 37 e0 15 00 00 00 01 00 02 38 00 15 00 00 00 01 00 02 39 fb 15 00 00 00 01 00 02 3a 01 15 00 00 00 01 00 02 3b 11 15 00 00 00 01 00 02 3d 01 15 00 00 00 01 00 02 3f 23 15 00 00 00 01 00 02 40 01 15 00 00 00 01 00 02 41 31 15 00 00 00 01 00 02 42 01 15 00 00 00 01 00 02 43 3e 15 00 00 00 01 00 02 44 01 15 00 00 00 01 00 02 45 4b 15 00 00 00 01 00 02 46 01 15 00 00 00 01 00 02 47 72 15 00 00 00 01 00 02 48 01 15 00 00 00 01 00 02 49 90 15 01 00 00 01 00 02 4a 01 15 00 00 00 01 00 02 4b bd 15 00 00 00 01 00 02 4c 01 15 00 00 00 01 00 02 4d de 15 00 00 00 01 00 02 4e 02 15 00 00 00 01 00 02 4f 15 15 00 00 00 01 00 02 50 02 15 00 00 00 01 00 02 51 48 15 00 00 00 01 00 02 52 02 15 00 00 00 01 00 02 53 4a 15 00 00 00 01 00 02 54 02 15 00 00 00 01 00 02 55 78 15 00 00 00 01 00 02 56 02 15 00 00 00 01 00 02 58 ae 15 00 00 00 01 00 02 59 02 15 00 00 00 01 00 02 5a d0 15 00 00 00 01 00 02 5b 02 15 00 00 00 01 00 02 5c fe 15 00 00 00 01 00 02 5d 03 15 00 00 00 01 00 02 5e 1e 15 00 00 00 01 00 02 5f 03 15 00 00 00 01 00 02 60 47 15 00 00 00 01 00 02 61 03 15 00 00 00 01 00 02 62 54 15 00 00 00 01 00 02 63 03 15 00 00 00 01 00 02 64 61 15 00 00 00 01 00 02 65 03 15 00 00 00 01 00 02 66 6f 15 00 00 00 01 00 02 67 03 15 00 00 00 01 00 02 68 81 15 00 00 00 01 00 02 69 03 15 00 00 00 01 00 02 6a 92 15 00 00 00 01 00 02 6b 03 15 00 00 00 01 00 02 6c a8 15 00 00 00 01 00 02 6d 03 15 00 00 00 01 00 02 6e bf 15 00 00 00 01 00 02 6f 03 15 00 00 00 01 00 02 70 c6 15 00 00 00 01 00 02 71 01 15 00 00 00 01 00 02 72 38 15 01 00 00 01 00 02 73 01 15 00 00 00 01 00 02 74 3e 15 00 00 00 01 00 02 75 01 15 00 00 00 01 00 02 76 46 15 00 00 00 01 00 02 77 01 15 00 00 00 01 00 02 78 4f 15 00 00 00 01 00 02 79 01 15 00 00 00 01 00 02 7a 56 15 00 00 00 01 00 02 7b 01 15 00 00 00 01 00 02 7c 5f 15 00 00 00 01 00 02 7d 01 15 00 00 00 01 00 02 7e 66 15 00 00 00 01 00 02 7f 01 15 00 00 00 01 00 02 80 6e 15 00 00 00 01 00 02 81 01 15 00 00 00 01 00 02 82 74 15 00 00 00 01 00 02 83 01 15 00 00 00 01 00 02 84 8f 15 00 00 00 01 00 02 85 01 15 00 00 00 01 00 02 86 a6 15 00 00 00 01 00 02 87 01 15 00 00 00 01 00 02 88 d1 15 00 00 00 01 00 02 89 01 15 00 00 00 01 00 02 8a f6 15 00 00 00 01 00 02 8b 02 15 00 00 00 01 00 02 8c 32 15 00 00 00 01 00 02 8d 02 15 00 00 00 01 00 02 8e 5f 15 00 00 00 01 00 02 8f 02 15 00 00 00 01 00 02 90 60 15 00 00 00 01 00 02 91 02 15 00 00 00 01 00 02 92 8a 15 00 00 00 01 00 02 93 02 15 00 00 00 01 00 02 94 bf 15 00 00 00 01 00 02 95 02 15 00 00 00 01 00 02 96 e0 15 00 00 00 01 00 02 97 03 15 00 00 00 01 00 02 98 17 15 00 00 00 01 00 02 99 03 15 00 00 00 01 00 02 9a 2d 15 01 00 00 01 00 02 9b 03 15 00 00 00 01 00 02 9c 53 15 00 00 00 01 00 02 9d 03 15 00 00 00 01 00 02 9e 5f 15 00 00 00 01 00 02 9f 03 15 00 00 00 01 00 02 a0 6b 15 00 00 00 01 00 02 a2 03 15 00 00 00 01 00 02 a3 78 15 00 00 00 01 00 02 a4 03 15 00 00 00 01 00 02 a5 87 15 00 00 00 01 00 02 a6 03 15 00 00 00 01 00 02 a7 98 15 00 00 00 01 00 02 a9 03 15 00 00 00 01 00 02 aa ab 15 00 00 00 01 00 02 ab 03 15 00 00 00 01 00 02 ac c0 15 00 00 00 01 00 02 ad 03 15 00 00 00 01 00 02 ae c6 15 00 00 00 01 00 02 af 01 15 00 00 00 01 00 02 b0 73 15 00 00 00 01 00 02 b1 01 15 00 00 00 01 00 02 b2 77 15 00 00 00 01 00 02 b3 01 15 00 00 00 01 00 02 b4 7f 15 00 00 00 01 00 02 b5 01 15 00 00 00 01 00 02 b6 86 15 00 00 00 01 00 02 b7 01 15 00 00 00 01 00 02 b8 8b 15 00 00 00 01 00 02 b9 01 15 00 00 00 01 00 02 ba 92 15 00 00 00 01 00 02 bb 01 15 00 00 00 01 00 02 bc 99 15 00 00 00 01 00 02 bd 01 15 00 00 00 01 00 02 be 9f 15 00 00 00 01 00 02 bf 01 15 00 00 00 01 00 02 c0 a3 15 00 00 00 01 00 02 c1 01 15 00 00 00 01 00 02 c2 b8 15 00 00 00 01 00 02 c3 01 15 00 00 00 01 00 02 c4 c9 15 00 00 00 01 00 02 c5 01 15 00 00 00 01 00 02 c6 e8 15 01 00 00 01 00 02 c7 02 15 00 00 00 01 00 02 c8 01 15 00 00 00 01 00 02 c9 02 15 00 00 00 01 00 02 ca 2d 15 00 00 00 01 00 02 cb 02 15 00 00 00 01 00 02 cc 5a 15 00 00 00 01 00 02 cd 02 15 00 00 00 01 00 02 ce 5b 15 00 00 00 01 00 02 cf 02 15 00 00 00 01 00 02 d0 85 15 00 00 00 01 00 02 d1 02 15 00 00 00 01 00 02 d2 bc 15 00 00 00 01 00 02 d3 02 15 00 00 00 01 00 02 d4 df 15 00 00 00 01 00 02 d5 03 15 00 00 00 01 00 02 d6 12 15 00 00 00 01 00 02 d7 03 15 00 00 00 01 00 02 d8 29 15 00 00 00 01 00 02 d9 03 15 00 00 00 01 00 02 da 50 15 00 00 00 01 00 02 db 03 15 00 00 00 01 00 02 dc 5c 15 00 00 00 01 00 02 dd 03 15 00 00 00 01 00 02 de 6a 15 00 00 00 01 00 02 df 03 15 00 00 00 01 00 02 e0 77 15 00 00 00 01 00 02 e1 03 15 00 00 00 01 00 02 e2 86 15 00 00 00 01 00 02 e3 03 15 00 00 00 01 00 02 e4 97 15 00 00 00 01 00 02 e5 03 15 00 00 00 01 00 02 e6 aa 15 00 00 00 01 00 02 e7 03 15 00 00 00 01 00 02 e8 bf 15 00 00 00 01 00 02 e9 03 15 00 00 00 01 00 02 ea c6 15 01 00 00 01 00 02 ff 10];
		qcom,mdss-dsi-dispparam-default-command-state = "dsi_hs_mode";
		qcom,mdss-dsi-dispparam-cold-command = [15 00 00 00 01 00 02 ff 20 15 00 00 00 01 00 02 fb 01 15 00 00 00 01 00 02 75 01 15 00 00 00 01 00 02 76 4c 15 00 00 00 01 00 02 77 01 15 00 00 00 01 00 02 78 4f 15 00 00 00 01 00 02 79 01 15 00 00 00 01 00 02 7a 58 15 00 00 00 01 00 02 7b 01 15 00 00 00 01 00 02 7c 60 15 00 00 00 01 00 02 7d 01 15 00 00 00 01 00 02 7e 69 15 00 00 00 01 00 02 7f 01 15 00 00 00 01 00 02 80 70 15 00 00 00 01 00 02 81 01 15 00 00 00 01 00 02 82 77 15 00 00 00 01 00 02 83 01 15 00 00 00 01 00 02 84 7e 15 00 00 00 01 00 02 85 01 15 00 00 00 01 00 02 86 86 15 00 00 00 01 00 02 87 01 15 00 00 00 01 00 02 88 a0 15 00 00 00 01 00 02 89 01 15 00 00 00 01 00 02 8a b6 15 00 00 00 01 00 02 8b 01 15 00 00 00 01 00 02 8c dc 15 00 00 00 01 00 02 8d 02 15 00 00 00 01 00 02 8e 01 15 00 00 00 01 00 02 8f 02 15 00 00 00 01 00 02 90 35 15 00 00 00 01 00 02 91 02 15 00 00 00 01 00 02 92 61 15 00 00 00 01 00 02 93 02 15 00 00 00 01 00 02 94 62 15 00 00 00 01 00 02 95 02 15 00 00 00 01 00 02 96 8f 15 00 00 00 01 00 02 97 02 15 00 00 00 01 00 02 98 be 15 00 00 00 01 00 02 99 02 15 00 00 00 01 00 02 9a dd 15 00 00 00 01 00 02 9b 03 15 01 00 00 01 00 02 9c 0a 15 00 00 00 01 00 02 9d 03 15 00 00 00 01 00 02 9e 2a 15 00 00 00 01 00 02 9f 03 15 00 00 00 01 00 02 a0 52 15 00 00 00 01 00 02 a2 03 15 00 00 00 01 00 02 a3 5d 15 00 00 00 01 00 02 a4 03 15 00 00 00 01 00 02 a5 6c 15 00 00 00 01 00 02 a6 03 15 00 00 00 01 00 02 a7 78 15 00 00 00 01 00 02 a9 03 15 00 00 00 01 00 02 aa 87 15 00 00 00 01 00 02 ab 03 15 00 00 00 01 00 02 ac 97 15 00 00 00 01 00 02 ad 03 15 00 00 00 01 00 02 ae a9 15 00 00 00 01 00 02 af 03 15 00 00 00 01 00 02 b0 b9 15 00 00 00 01 00 02 b1 03 15 00 00 00 01 00 02 b2 c6 15 00 00 00 01 00 02 b3 01 15 00 00 00 01 00 02 b4 81 15 00 00 00 01 00 02 b5 01 15 00 00 00 01 00 02 b6 83 15 00 00 00 01 00 02 b7 01 15 00 00 00 01 00 02 b8 8b 15 00 00 00 01 00 02 b9 01 15 00 00 00 01 00 02 ba 91 15 00 00 00 01 00 02 bb 01 15 00 00 00 01 00 02 bc 98 15 00 00 00 01 00 02 bd 01 15 00 00 00 01 00 02 be 9e 15 00 00 00 01 00 02 bf 01 15 00 00 00 01 00 02 c0 a4 15 00 00 00 01 00 02 c1 01 15 00 00 00 01 00 02 c2 a9 15 00 00 00 01 00 02 c3 01 15 00 00 00 01 00 02 c4 af 15 00 00 00 01 00 02 c5 01 15 00 00 00 01 00 02 c6 c3 15 01 00 00 01 00 02 c7 01 15 00 00 00 01 00 02 c8 d3 15 00 00 00 01 00 02 c9 01 15 00 00 00 01 00 02 ca ee 15 00 00 00 01 00 02 cb 02 15 00 00 00 01 00 02 cc 07 15 00 00 00 01 00 02 cd 02 15 00 00 00 01 00 02 ce 2c 15 00 00 00 01 00 02 cf 02 15 00 00 00 01 00 02 d0 58 15 00 00 00 01 00 02 d1 02 15 00 00 00 01 00 02 d2 59 15 00 00 00 01 00 02 d3 02 15 00 00 00 01 00 02 d4 85 15 00 00 00 01 00 02 d5 02 15 00 00 00 01 00 02 d6 bc 15 00 00 00 01 00 02 d7 02 15 00 00 00 01 00 02 d8 e2 15 00 00 00 01 00 02 d9 03 15 00 00 00 01 00 02 da 15 15 00 00 00 01 00 02 db 03 15 00 00 00 01 00 02 dc 33 15 00 00 00 01 00 02 dd 03 15 00 00 00 01 00 02 de 57 15 00 00 00 01 00 02 df 03 15 00 00 00 01 00 02 e0 62 15 00 00 00 01 00 02 e1 03 15 00 00 00 01 00 02 e2 70 15 00 00 00 01 00 02 e3 03 15 00 00 00 01 00 02 e4 7b 15 00 00 00 01 00 02 e5 03 15 00 00 00 01 00 02 e6 8a 15 00 00 00 01 00 02 e7 03 15 00 00 00 01 00 02 e8 98 15 00 00 00 01 00 02 e9 03 15 00 00 00 01 00 02 ea aa 15 00 00 00 01 00 02 eb 03 15 00 00 00 01 00 02 ec ba 15 00 00 00 01 00 02 ed 03 15 00 00 00 01 00 02 ee c6 15 00 00 00 01 00 02 ef 00 15 00 00 00 01 00 02 f0 37 15 00 00 00 01 00 02 f1 00 15 01 00 00 01 00 02 f2 73 15 00 00 00 01 00 02 f3 00 15 00 00 00 01 00 02 f4 9d 15 00 00 00 01 00 02 f5 00 15 00 00 00 01 00 02 f6 b9 15 00 00 00 01 00 02 f7 00 15 00 00 00 01 00 02 f8 cf 15 00 00 00 01 00 02 f9 00 15 00 00 00 01 00 02 fa e2 15 00 00 00 01 00 02 ff 21 15 00 00 00 01 00 02 fb 01 15 00 00 00 01 00 02 00 00 15 00 00 00 01 00 02 01 f3 15 00 00 00 01 00 02 02 01 15 00 00 00 01 00 02 03 02 15 00 00 00 01 00 02 04 01 15 00 00 00 01 00 02 05 0f 15 00 00 00 01 00 02 06 01 15 00 00 00 01 00 02 07 3d 15 00 00 00 01 00 02 08 01 15 00 00 00 01 00 02 09 62 15 00 00 00 01 00 02 0a 01 15 00 00 00 01 00 02 0b 9f 15 00 00 00 01 00 02 0c 01 15 00 00 00 01 00 02 0d d0 15 00 00 00 01 00 02 0e 02 15 00 00 00 01 00 02 0f 1a 15 00 00 00 01 00 02 10 02 15 00 00 00 01 00 02 11 4d 15 00 00 00 01 00 02 12 02 15 00 00 00 01 00 02 13 4f 15 00 00 00 01 00 02 14 02 15 00 00 00 01 00 02 15 7e 15 00 00 00 01 00 02 16 02 15 00 00 00 01 00 02 17 b2 15 00 00 00 01 00 02 18 02 15 00 00 00 01 00 02 19 d2 15 00 00 00 01 00 02 1a 03 15 00 00 00 01 00 02 1b 04 15 00 00 00 01 00 02 1c 03 15 00 00 00 01 00 02 1d 29 15 01 00 00 01 00 02 1e 03 15 00 00 00 01 00 02 1f 4e 15 00 00 00 01 00 02 20 03 15 00 00 00 01 00 02 21 58 15 00 00 00 01 00 02 22 03 15 00 00 00 01 00 02 23 65 15 00 00 00 01 00 02 24 03 15 00 00 00 01 00 02 25 72 15 00 00 00 01 00 02 26 03 15 00 00 00 01 00 02 27 83 15 00 00 00 01 00 02 28 03 15 00 00 00 01 00 02 29 93 15 00 00 00 01 00 02 2a 03 15 00 00 00 01 00 02 2b aa 15 00 00 00 01 00 02 2d 03 15 00 00 00 01 00 02 2f c1 15 00 00 00 01 00 02 30 03 15 00 00 00 01 00 02 31 c6 15 00 00 00 01 00 02 32 00 15 00 00 00 01 00 02 33 84 15 00 00 00 01 00 02 34 00 15 00 00 00 01 00 02 35 be 15 00 00 00 01 00 02 36 00 15 00 00 00 01 00 02 37 e6 15 00 00 00 01 00 02 38 01 15 00 00 00 01 00 02 39 01 15 00 00 00 01 00 02 3a 01 15 00 00 00 01 00 02 3b 15 15 00 00 00 01 00 02 3d 01 15 00 00 00 01 00 02 3f 26 15 00 00 00 01 00 02 40 01 15 00 00 00 01 00 02 41 34 15 00 00 00 01 00 02 42 01 15 00 00 00 01 00 02 43 42 15 00 00 00 01 00 02 44 01 15 00 00 00 01 00 02 45 4e 15 00 00 00 01 00 02 46 01 15 00 00 00 01 00 02 47 74 15 00 00 00 01 00 02 48 01 15 00 00 00 01 00 02 49 91 15 01 00 00 01 00 02 4a 01 15 00 00 00 01 00 02 4b be 15 00 00 00 01 00 02 4c 01 15 00 00 00 01 00 02 4d df 15 00 00 00 01 00 02 4e 02 15 00 00 00 01 00 02 4f 15 15 00 00 00 01 00 02 50 02 15 00 00 00 01 00 02 51 48 15 00 00 00 01 00 02 52 02 15 00 00 00 01 00 02 53 4a 15 00 00 00 01 00 02 54 02 15 00 00 00 01 00 02 55 79 15 00 00 00 01 00 02 56 02 15 00 00 00 01 00 02 58 af 15 00 00 00 01 00 02 59 02 15 00 00 00 01 00 02 5a d1 15 00 00 00 01 00 02 5b 02 15 00 00 00 01 00 02 5c ff 15 00 00 00 01 00 02 5d 03 15 00 00 00 01 00 02 5e 25 15 00 00 00 01 00 02 5f 03 15 00 00 00 01 00 02 60 4b 15 00 00 00 01 00 02 61 03 15 00 00 00 01 00 02 62 56 15 00 00 00 01 00 02 63 03 15 00 00 00 01 00 02 64 64 15 00 00 00 01 00 02 65 03 15 00 00 00 01 00 02 66 71 15 00 00 00 01 00 02 67 03 15 00 00 00 01 00 02 68 82 15 00 00 00 01 00 02 69 03 15 00 00 00 01 00 02 6a 92 15 00 00 00 01 00 02 6b 03 15 00 00 00 01 00 02 6c a9 15 00 00 00 01 00 02 6d 03 15 00 00 00 01 00 02 6e c0 15 00 00 00 01 00 02 6f 03 15 00 00 00 01 00 02 70 c6 15 00 00 00 01 00 02 71 01 15 00 00 00 01 00 02 72 27 15 01 00 00 01 00 02 73 01 15 00 00 00 01 00 02 74 2c 15 00 00 00 01 00 02 75 01 15 00 00 00 01 00 02 76 35 15 00 00 00 01 00 02 77 01 15 00 00 00 01 00 02 78 40 15 00 00 00 01 00 02 79 01 15 00 00 00 01 00 02 7a 48 15 00 00 00 01 00 02 7b 01 15 00 00 00 01 00 02 7c 51 15 00 00 00 01 00 02 7d 01 15 00 00 00 01 00 02 7e 58 15 00 00 00 01 00 02 7f 01 15 00 00 00 01 00 02 80 61 15 00 00 00 01 00 02 81 01 15 00 00 00 01 00 02 82 69 15 00 00 00 01 00 02 83 01 15 00 00 00 01 00 02 84 84 15 00 00 00 01 00 02 85 01 15 00 00 00 01 00 02 86 9d 15 00 00 00 01 00 02 87 01 15 00 00 00 01 00 02 88 c9 15 00 00 00 01 00 02 89 01 15 00 00 00 01 00 02 8a f0 15 00 00 00 01 00 02 8b 02 15 00 00 00 01 00 02 8c 2e 15 00 00 00 01 00 02 8d 02 15 00 00 00 01 00 02 8e 5b 15 00 00 00 01 00 02 8f 02 15 00 00 00 01 00 02 90 5d 15 00 00 00 01 00 02 91 02 15 00 00 00 01 00 02 92 8a 15 00 00 00 01 00 02 93 02 15 00 00 00 01 00 02 94 be 15 00 00 00 01 00 02 95 02 15 00 00 00 01 00 02 96 e1 15 00 00 00 01 00 02 97 03 15 00 00 00 01 00 02 98 17 15 00 00 00 01 00 02 99 03 15 00 00 00 01 00 02 9a 2e 15 01 00 00 01 00 02 9b 03 15 00 00 00 01 00 02 9c 55 15 00 00 00 01 00 02 9d 03 15 00 00 00 01 00 02 9e 62 15 00 00 00 01 00 02 9f 03 15 00 00 00 01 00 02 a0 6d 15 00 00 00 01 00 02 a2 03 15 00 00 00 01 00 02 a3 7b 15 00 00 00 01 00 02 a4 03 15 00 00 00 01 00 02 a5 8a 15 00 00 00 01 00 02 a6 03 15 00 00 00 01 00 02 a7 9b 15 00 00 00 01 00 02 a9 03 15 00 00 00 01 00 02 aa aa 15 00 00 00 01 00 02 ab 03 15 00 00 00 01 00 02 ac bc 15 00 00 00 01 00 02 ad 03 15 00 00 00 01 00 02 ae c6 15 00 00 00 01 00 02 af 01 15 00 00 00 01 00 02 b0 62 15 00 00 00 01 00 02 b1 01 15 00 00 00 01 00 02 b2 66 15 00 00 00 01 00 02 b3 01 15 00 00 00 01 00 02 b4 6e 15 00 00 00 01 00 02 b5 01 15 00 00 00 01 00 02 b6 77 15 00 00 00 01 00 02 b7 01 15 00 00 00 01 00 02 b8 7d 15 00 00 00 01 00 02 b9 01 15 00 00 00 01 00 02 ba 85 15 00 00 00 01 00 02 bb 01 15 00 00 00 01 00 02 bc 8b 15 00 00 00 01 00 02 bd 01 15 00 00 00 01 00 02 be 92 15 00 00 00 01 00 02 bf 01 15 00 00 00 01 00 02 c0 98 15 00 00 00 01 00 02 c1 01 15 00 00 00 01 00 02 c2 ad 15 00 00 00 01 00 02 c3 01 15 00 00 00 01 00 02 c4 c0 15 00 00 00 01 00 02 c5 01 15 00 00 00 01 00 02 c6 e0 15 01 00 00 01 00 02 c7 01 15 00 00 00 01 00 02 c8 fb 15 00 00 00 01 00 02 c9 02 15 00 00 00 01 00 02 ca 29 15 00 00 00 01 00 02 cb 02 15 00 00 00 01 00 02 cc 56 15 00 00 00 01 00 02 cd 02 15 00 00 00 01 00 02 ce 58 15 00 00 00 01 00 02 cf 02 15 00 00 00 01 00 02 d0 85 15 00 00 00 01 00 02 d1 02 15 00 00 00 01 00 02 d2 bb 15 00 00 00 01 00 02 d3 02 15 00 00 00 01 00 02 d4 e0 15 00 00 00 01 00 02 d5 03 15 00 00 00 01 00 02 d6 12 15 00 00 00 01 00 02 d7 03 15 00 00 00 01 00 02 d8 2a 15 00 00 00 01 00 02 d9 03 15 00 00 00 01 00 02 da 52 15 00 00 00 01 00 02 db 03 15 00 00 00 01 00 02 dc 60 15 00 00 00 01 00 02 dd 03 15 00 00 00 01 00 02 de 6c 15 00 00 00 01 00 02 df 03 15 00 00 00 01 00 02 e0 7a 15 00 00 00 01 00 02 e1 03 15 00 00 00 01 00 02 e2 89 15 00 00 00 01 00 02 e3 03 15 00 00 00 01 00 02 e4 9a 15 00 00 00 01 00 02 e5 03 15 00 00 00 01 00 02 e6 a9 15 00 00 00 01 00 02 e7 03 15 00 00 00 01 00 02 e8 bb 15 00 00 00 01 00 02 e9 03 15 00 00 00 01 00 02 ea c6 15 01 00 00 01 00 02 ff 10];
		qcom,mdss-dsi-dispparam-cold-command-state = "dsi_hs_mode";
		qcom,mdss-dsi-dispparam-cabcon-command = [15 00 00 00 01 00 02 ff 10 15 01 00 00 01 00 02 55 01];
		qcom,mdss-dsi-dispparam-cabcon-command-state = "dsi_hs_mode";
		qcom,mdss-dsi-dispparam-cabcguion-command = [15 00 00 00 01 00 02 ff 10 15 01 00 00 01 00 02 55 01];
		qcom,mdss-dsi-dispparam-cabcguion-command-state = "dsi_hs_mode";
		qcom,mdss-dsi-dispparam-cabcstillon-command = [15 00 00 00 01 00 02 ff 10 15 01 00 00 01 00 02 55 02];
		qcom,mdss-dsi-dispparam-cabcstillon-command-state = "dsi_hs_mode";
		qcom,mdss-dsi-dispparam-cabcmovieon-command = [15 00 00 00 01 00 02 ff 10 15 01 00 00 01 00 02 55 03];
		qcom,mdss-dsi-dispparam-cabcmovieon-command-state = "dsi_hs_mode";
		qcom,mdss-dsi-dispparam-cabcoff-command = [15 00 00 00 01 00 02 ff 10 15 01 00 00 01 00 02 55 00];
		qcom,mdss-dsi-dispparam-cabcoff-command-state = "dsi_hs_mode";
		qcom,mdss-dsi-dispparam-papermode1-command = [15 00 00 00 01 00 02 ff 20 15 00 00 00 01 00 02 fb 01 15 00 00 00 01 00 02 75 00 15 00 00 00 01 00 02 76 c9 15 00 00 00 01 00 02 77 00 15 00 00 00 01 00 02 78 d6 15 00 00 00 01 00 02 79 00 15 00 00 00 01 00 02 7a ed 15 00 00 00 01 00 02 7b 00 15 00 00 00 01 00 02 7c ff 15 00 00 00 01 00 02 7d 01 15 00 00 00 01 00 02 7e 0f 15 00 00 00 01 00 02 7f 01 15 00 00 00 01 00 02 80 1e 15 00 00 00 01 00 02 81 01 15 00 00 00 01 00 02 82 2a 15 00 00 00 01 00 02 83 01 15 00 00 00 01 00 02 84 36 15 00 00 00 01 00 02 85 01 15 00 00 00 01 00 02 86 41 15 00 00 00 01 00 02 87 01 15 00 00 00 01 00 02 88 65 15 00 00 00 01 00 02 89 01 15 00 00 00 01 00 02 8a 82 15 00 00 00 01 00 02 8b 01 15 00 00 00 01 00 02 8c b2 15 00 00 00 01 00 02 8d 01 15 00 00 00 01 00 02 8e da 15 00 00 00 01 00 02 8f 02 15 00 00 00 01 00 02 90 18 15 00 00 00 01 00 02 91 02 15 00 00 00 01 00 02 92 4a 15 00 00 00 01 00 02 93 02 15 00 00 00 01 00 02 94 4a 15 00 00 00 01 00 02 95 02 15 00 00 00 01 00 02 96 78 15 00 00 00 01 00 02 97 02 15 00 00 00 01 00 02 98 ab 15 00 00 00 01 00 02 99 02 15 00 00 00 01 00 02 9a d6 15 00 00 00 01 00 02 9b 03 15 00 00 00 01 00 02 9c 03 15 01 00 00 01 00 02 9d 03 15 00 00 00 01 00 02 9e 23 15 00 00 00 01 00 02 9f 03 15 00 00 00 01 00 02 a0 4b 15 00 00 00 01 00 02 a2 03 15 00 00 00 01 00 02 a3 59 15 00 00 00 01 00 02 a4 03 15 00 00 00 01 00 02 a5 69 15 00 00 00 01 00 02 a6 03 15 00 00 00 01 00 02 a7 7e 15 00 00 00 01 00 02 a9 03 15 00 00 00 01 00 02 aa 9b 15 00 00 00 01 00 02 ab 03 15 00 00 00 01 00 02 ac b4 15 00 00 00 01 00 02 ad 03 15 00 00 00 01 00 02 ae c3 15 00 00 00 01 00 02 af 03 15 00 00 00 01 00 02 b0 c6 15 00 00 00 01 00 02 b1 03 15 00 00 00 01 00 02 b2 ca 15 00 00 00 01 00 02 b3 00 15 00 00 00 01 00 02 b4 c9 15 00 00 00 01 00 02 b5 00 15 00 00 00 01 00 02 b6 d6 15 00 00 00 01 00 02 b7 00 15 00 00 00 01 00 02 b8 ed 15 00 00 00 01 00 02 b9 00 15 00 00 00 01 00 02 ba ff 15 00 00 00 01 00 02 bb 01 15 00 00 00 01 00 02 bc 0f 15 00 00 00 01 00 02 bd 01 15 00 00 00 01 00 02 be 1e 15 00 00 00 01 00 02 bf 01 15 00 00 00 01 00 02 c0 2a 15 00 00 00 01 00 02 c1 01 15 00 00 00 01 00 02 c2 36 15 00 00 00 01 00 02 c3 01 15 00 00 00 01 00 02 c4 41 15 00 00 00 01 00 02 c5 01 15 00 00 00 01 00 02 c6 65 15 00 00 00 01 00 02 c7 01 15 00 00 00 01 00 02 c8 82 15 01 00 00 01 00 02 c9 01 15 00 00 00 01 00 02 ca b2 15 00 00 00 01 00 02 cb 01 15 00 00 00 01 00 02 cc da 15 00 00 00 01 00 02 cd 02 15 00 00 00 01 00 02 ce 18 15 00 00 00 01 00 02 cf 02 15 00 00 00 01 00 02 d0 4a 15 00 00 00 01 00 02 d1 02 15 00 00 00 01 00 02 d2 4a 15 00 00 00 01 00 02 d3 02 15 00 00 00 01 00 02 d4 78 15 00 00 00 01 00 02 d5 02 15 00 00 00 01 00 02 d6 ab 15 00 00 00 01 00 02 d7 02 15 00 00 00 01 00 02 d8 d6 15 00 00 00 01 00 02 d9 03 15 00 00 00 01 00 02 da 03 15 00 00 00 01 00 02 db 03 15 00 00 00 01 00 02 dc 23 15 00 00 00 01 00 02 dd 03 15 00 00 00 01 00 02 de 4b 15 00 00 00 01 00 02 df 03 15 00 00 00 01 00 02 e0 59 15 00 00 00 01 00 02 e1 03 15 00 00 00 01 00 02 e2 69 15 00 00 00 01 00 02 e3 03 15 00 00 00 01 00 02 e4 7e 15 00 00 00 01 00 02 e5 03 15 00 00 00 01 00 02 e6 9b 15 00 00 00 01 00 02 e7 03 15 00 00 00 01 00 02 e8 b4 15 00 00 00 01 00 02 e9 03 15 00 00 00 01 00 02 ea c3 15 00 00 00 01 00 02 eb 03 15 00 00 00 01 00 02 ec c6 15 00 00 00 01 00 02 ed 03 15 00 00 00 01 00 02 ee ca 15 00 00 00 01 00 02 ef 00 15 00 00 00 01 00 02 f0 37 15 00 00 00 01 00 02 f1 00 15 00 00 00 01 00 02 f2 73 15 00 00 00 01 00 02 f3 00 15 01 00 00 01 00 02 f4 a5 15 00 00 00 01 00 02 f5 00 15 00 00 00 01 00 02 f6 c6 15 00 00 00 01 00 02 f7 00 15 00 00 00 01 00 02 f8 df 15 00 00 00 01 00 02 f9 00 15 00 00 00 01 00 02 fa f3 15 00 00 00 01 00 02 ff 21 15 00 00 00 01 00 02 fb 01 15 00 00 00 01 00 02 00 01 15 00 00 00 01 00 02 01 05 15 00 00 00 01 00 02 02 01 15 00 00 00 01 00 02 03 14 15 00 00 00 01 00 02 04 01 15 00 00 00 01 00 02 05 22 15 00 00 00 01 00 02 06 01 15 00 00 00 01 00 02 07 4e 15 00 00 00 01 00 02 08 01 15 00 00 00 01 00 02 09 70 15 00 00 00 01 00 02 0a 01 15 00 00 00 01 00 02 0b a5 15 00 00 00 01 00 02 0c 01 15 00 00 00 01 00 02 0d d0 15 00 00 00 01 00 02 0e 02 15 00 00 00 01 00 02 0f 12 15 00 00 00 01 00 02 10 02 15 00 00 00 01 00 02 11 46 15 00 00 00 01 00 02 12 02 15 00 00 00 01 00 02 13 46 15 00 00 00 01 00 02 14 02 15 00 00 00 01 00 02 15 76 15 00 00 00 01 00 02 16 02 15 00 00 00 01 00 02 17 a9 15 00 00 00 01 00 02 18 02 15 00 00 00 01 00 02 19 d3 15 00 00 00 01 00 02 1a 03 15 00 00 00 01 00 02 1b 00 15 00 00 00 01 00 02 1c 03 15 00 00 00 01 00 02 1d 21 15 00 00 00 01 00 02 1e 03 15 00 00 00 01 00 02 1f 49 15 00 00 00 01 00 02 20 03 15 01 00 00 01 00 02 21 55 15 00 00 00 01 00 02 22 03 15 00 00 00 01 00 02 23 63 15 00 00 00 01 00 02 24 03 15 00 00 00 01 00 02 25 75 15 00 00 00 01 00 02 26 03 15 00 00 00 01 00 02 27 8e 15 00 00 00 01 00 02 28 03 15 00 00 00 01 00 02 29 ac 15 00 00 00 01 00 02 2a 03 15 00 00 00 01 00 02 2b c0 15 00 00 00 01 00 02 2d 03 15 00 00 00 01 00 02 2f c6 15 00 00 00 01 00 02 30 03 15 00 00 00 01 00 02 31 ca 15 00 00 00 01 00 02 32 00 15 00 00 00 01 00 02 33 37 15 00 00 00 01 00 02 34 00 15 00 00 00 01 00 02 35 73 15 00 00 00 01 00 02 36 00 15 00 00 00 01 00 02 37 a5 15 00 00 00 01 00 02 38 00 15 00 00 00 01 00 02 39 c6 15 00 00 00 01 00 02 3a 00 15 00 00 00 01 00 02 3b df 15 00 00 00 01 00 02 3d 00 15 00 00 00 01 00 02 3f f3 15 00 00 00 01 00 02 40 01 15 00 00 00 01 00 02 41 05 15 00 00 00 01 00 02 42 01 15 00 00 00 01 00 02 43 14 15 00 00 00 01 00 02 44 01 15 00 00 00 01 00 02 45 22 15 00 00 00 01 00 02 46 01 15 00 00 00 01 00 02 47 4e 15 00 00 00 01 00 02 48 01 15 00 00 00 01 00 02 49 70 15 00 00 00 01 00 02 4a 01 15 00 00 00 01 00 02 4b a5 15 00 00 00 01 00 02 4c 01 15 00 00 00 01 00 02 4d d0 15 01 00 00 01 00 02 4e 02 15 00 00 00 01 00 02 4f 12 15 00 00 00 01 00 02 50 02 15 00 00 00 01 00 02 51 46 15 00 00 00 01 00 02 52 02 15 00 00 00 01 00 02 53 46 15 00 00 00 01 00 02 54 02 15 00 00 00 01 00 02 55 76 15 00 00 00 01 00 02 56 02 15 00 00 00 01 00 02 58 a9 15 00 00 00 01 00 02 59 02 15 00 00 00 01 00 02 5a d3 15 00 00 00 01 00 02 5b 03 15 00 00 00 01 00 02 5c 00 15 00 00 00 01 00 02 5d 03 15 00 00 00 01 00 02 5e 21 15 00 00 00 01 00 02 5f 03 15 00 00 00 01 00 02 60 49 15 00 00 00 01 00 02 61 03 15 00 00 00 01 00 02 62 55 15 00 00 00 01 00 02 63 03 15 00 00 00 01 00 02 64 63 15 00 00 00 01 00 02 65 03 15 00 00 00 01 00 02 66 75 15 00 00 00 01 00 02 67 03 15 00 00 00 01 00 02 68 8e 15 00 00 00 01 00 02 69 03 15 00 00 00 01 00 02 6a ac 15 00 00 00 01 00 02 6b 03 15 00 00 00 01 00 02 6c c0 15 00 00 00 01 00 02 6d 03 15 00 00 00 01 00 02 6e c6 15 00 00 00 01 00 02 6f 03 15 00 00 00 01 00 02 70 ca 15 00 00 00 01 00 02 71 01 15 00 00 00 01 00 02 72 90 15 00 00 00 01 00 02 73 01 15 00 00 00 01 00 02 74 93 15 00 00 00 01 00 02 75 01 15 00 00 00 01 00 02 76 98 15 01 00 00 01 00 02 77 01 15 00 00 00 01 00 02 78 9d 15 00 00 00 01 00 02 79 01 15 00 00 00 01 00 02 7a a2 15 00 00 00 01 00 02 7b 01 15 00 00 00 01 00 02 7c a7 15 00 00 00 01 00 02 7d 01 15 00 00 00 01 00 02 7e ac 15 00 00 00 01 00 02 7f 01 15 00 00 00 01 00 02 80 b1 15 00 00 00 01 00 02 81 01 15 00 00 00 01 00 02 82 b6 15 00 00 00 01 00 02 83 01 15 00 00 00 01 00 02 84 c7 15 00 00 00 01 00 02 85 01 15 00 00 00 01 00 02 86 d7 15 00 00 00 01 00 02 87 01 15 00 00 00 01 00 02 88 f3 15 00 00 00 01 00 02 89 02 15 00 00 00 01 00 02 8a 0f 15 00 00 00 01 00 02 8b 02 15 00 00 00 01 00 02 8c 3c 15 00 00 00 01 00 02 8d 02 15 00 00 00 01 00 02 8e 64 15 00 00 00 01 00 02 8f 02 15 00 00 00 01 00 02 90 64 15 00 00 00 01 00 02 91 02 15 00 00 00 01 00 02 92 8e 15 00 00 00 01 00 02 93 02 15 00 00 00 01 00 02 94 c0 15 00 00 00 01 00 02 95 02 15 00 00 00 01 00 02 96 e5 15 00 00 00 01 00 02 97 03 15 00 00 00 01 00 02 98 14 15 00 00 00 01 00 02 99 03 15 00 00 00 01 00 02 9a 32 15 00 00 00 01 00 02 9b 03 15 00 00 00 01 00 02 9c 5d 15 00 00 00 01 00 02 9d 03 15 00 00 00 01 00 02 9e 6e 15 01 00 00 01 00 02 9f 03 15 00 00 00 01 00 02 a0 85 15 00 00 00 01 00 02 a2 03 15 00 00 00 01 00 02 a3 9e 15 00 00 00 01 00 02 a4 03 15 00 00 00 01 00 02 a5 b1 15 00 00 00 01 00 02 a6 03 15 00 00 00 01 00 02 a7 be 15 00 00 00 01 00 02 a9 03 15 00 00 00 01 00 02 aa c4 15 00 00 00 01 00 02 ab 03 15 00 00 00 01 00 02 ac c6 15 00 00 00 01 00 02 ad 03 15 00 00 00 01 00 02 ae ca 15 00 00 00 01 00 02 af 01 15 00 00 00 01 00 02 b0 90 15 00 00 00 01 00 02 b1 01 15 00 00 00 01 00 02 b2 93 15 00 00 00 01 00 02 b3 01 15 00 00 00 01 00 02 b4 98 15 00 00 00 01 00 02 b5 01 15 00 00 00 01 00 02 b6 9d 15 00 00 00 01 00 02 b7 01 15 00 00 00 01 00 02 b8 a2 15 00 00 00 01 00 02 b9 01 15 00 00 00 01 00 02 ba a7 15 00 00 00 01 00 02 bb 01 15 00 00 00 01 00 02 bc ac 15 00 00 00 01 00 02 bd 01 15 00 00 00 01 00 02 be b1 15 00 00 00 01 00 02 bf 01 15 00 00 00 01 00 02 c0 b6 15 00 00 00 01 00 02 c1 01 15 00 00 00 01 00 02 c2 c7 15 00 00 00 01 00 02 c3 01 15 00 00 00 01 00 02 c4 d7 15 00 00 00 01 00 02 c5 01 15 00 00 00 01 00 02 c6 f3 15 00 00 00 01 00 02 c7 02 15 00 00 00 01 00 02 c8 0f 15 01 00 00 01 00 02 c9 02 15 00 00 00 01 00 02 ca 3c 15 00 00 00 01 00 02 cb 02 15 00 00 00 01 00 02 cc 64 15 00 00 00 01 00 02 cd 02 15 00 00 00 01 00 02 ce 64 15 00 00 00 01 00 02 cf 02 15 00 00 00 01 00 02 d0 8e 15 00 00 00 01 00 02 d1 02 15 00 00 00 01 00 02 d2 c0 15 00 00 00 01 00 02 d3 02 15 00 00 00 01 00 02 d4 e5 15 00 00 00 01 00 02 d5 03 15 00 00 00 01 00 02 d6 14 15 00 00 00 01 00 02 d7 03 15 00 00 00 01 00 02 d8 32 15 00 00 00 01 00 02 d9 03 15 00 00 00 01 00 02 da 5d 15 00 00 00 01 00 02 db 03 15 00 00 00 01 00 02 dc 6e 15 00 00 00 01 00 02 dd 03 15 00 00 00 01 00 02 de 85 15 00 00 00 01 00 02 df 03 15 00 00 00 01 00 02 e0 9e 15 00 00 00 01 00 02 e1 03 15 00 00 00 01 00 02 e2 b1 15 00 00 00 01 00 02 e3 03 15 00 00 00 01 00 02 e4 be 15 00 00 00 01 00 02 e5 03 15 00 00 00 01 00 02 e6 c4 15 00 00 00 01 00 02 e7 03 15 00 00 00 01 00 02 e8 c6 15 00 00 00 01 00 02 e9 03 15 00 00 00 01 00 02 ea ca 15 00 00 00 01 00 02 fb 01 15 01 00 00 01 00 02 ff 10];
		qcom,mdss-dsi-dispparam-papermode1-command-state = "dsi_hs_mode";
		qcom,mdss-dsi-dispparam-papermode2-command = [15 00 00 00 00 00 02 ff 20 15 00 00 00 01 00 02 fb 01 15 00 00 00 01 00 02 75 00 15 00 00 00 01 00 02 76 c9 15 00 00 00 01 00 02 77 00 15 00 00 00 01 00 02 78 d6 15 00 00 00 01 00 02 79 00 15 00 00 00 01 00 02 7a ed 15 00 00 00 01 00 02 7b 00 15 00 00 00 01 00 02 7c ff 15 00 00 00 01 00 02 7d 01 15 00 00 00 01 00 02 7e 0f 15 00 00 00 01 00 02 7f 01 15 00 00 00 01 00 02 80 1e 15 00 00 00 01 00 02 81 01 15 00 00 00 01 00 02 82 2a 15 00 00 00 01 00 02 83 01 15 00 00 00 01 00 02 84 36 15 00 00 00 01 00 02 85 01 15 00 00 00 01 00 02 86 41 15 00 00 00 01 00 02 87 01 15 00 00 00 01 00 02 88 65 15 00 00 00 01 00 02 89 01 15 00 00 00 01 00 02 8a 82 15 00 00 00 01 00 02 8b 01 15 00 00 00 01 00 02 8c b2 15 00 00 00 01 00 02 8d 01 15 00 00 00 01 00 02 8e da 15 00 00 00 01 00 02 8f 02 15 00 00 00 01 00 02 90 18 15 00 00 00 01 00 02 91 02 15 00 00 00 01 00 02 92 4a 15 00 00 00 01 00 02 93 02 15 00 00 00 01 00 02 94 4a 15 00 00 00 01 00 02 95 02 15 00 00 00 01 00 02 96 78 15 00 00 00 01 00 02 97 02 15 00 00 00 01 00 02 98 ab 15 00 00 00 01 00 02 99 02 15 00 00 00 01 00 02 9a d6 15 00 00 00 01 00 02 9b 03 15 01 00 00 01 00 02 9c 03 15 00 00 00 01 00 02 9d 03 15 00 00 00 01 00 02 9e 23 15 00 00 00 01 00 02 9f 03 15 00 00 00 01 00 02 a0 4b 15 00 00 00 01 00 02 a2 03 15 00 00 00 01 00 02 a3 59 15 00 00 00 01 00 02 a4 03 15 00 00 00 01 00 02 a5 69 15 00 00 00 01 00 02 a6 03 15 00 00 00 01 00 02 a7 7e 15 00 00 00 01 00 02 a9 03 15 00 00 00 01 00 02 aa 9b 15 00 00 00 01 00 02 ab 03 15 00 00 00 01 00 02 ac b4 15 00 00 00 01 00 02 ad 03 15 00 00 00 01 00 02 ae c3 15 00 00 00 01 00 02 af 03 15 00 00 00 01 00 02 b0 c6 15 00 00 00 01 00 02 b1 03 15 00 00 00 01 00 02 b2 ca 15 00 00 00 01 00 02 b3 00 15 00 00 00 01 00 02 b4 c9 15 00 00 00 01 00 02 b5 00 15 00 00 00 01 00 02 b6 d6 15 00 00 00 01 00 02 b7 00 15 00 00 00 01 00 02 b8 ed 15 00 00 00 01 00 02 b9 00 15 00 00 00 01 00 02 ba ff 15 00 00 00 01 00 02 bb 01 15 00 00 00 01 00 02 bc 0f 15 00 00 00 01 00 02 bd 01 15 00 00 00 01 00 02 be 1e 15 00 00 00 01 00 02 bf 01 15 00 00 00 01 00 02 c0 2a 15 00 00 00 01 00 02 c1 01 15 00 00 00 01 00 02 c2 36 15 00 00 00 01 00 02 c3 01 15 00 00 00 01 00 02 c4 41 15 00 00 00 01 00 02 c5 01 15 00 00 00 01 00 02 c6 65 15 00 00 00 01 00 02 c7 01 15 01 00 00 01 00 02 c8 82 15 00 00 00 01 00 02 c9 01 15 00 00 00 01 00 02 ca b2 15 00 00 00 01 00 02 cb 01 15 00 00 00 01 00 02 cc da 15 00 00 00 01 00 02 cd 02 15 00 00 00 01 00 02 ce 18 15 00 00 00 01 00 02 cf 02 15 00 00 00 01 00 02 d0 4a 15 00 00 00 01 00 02 d1 02 15 00 00 00 01 00 02 d2 4a 15 00 00 00 01 00 02 d3 02 15 00 00 00 01 00 02 d4 78 15 00 00 00 01 00 02 d5 02 15 00 00 00 01 00 02 d6 ab 15 00 00 00 01 00 02 d7 02 15 00 00 00 01 00 02 d8 d6 15 00 00 00 01 00 02 d9 03 15 00 00 00 01 00 02 da 03 15 00 00 00 01 00 02 db 03 15 00 00 00 01 00 02 dc 23 15 00 00 00 01 00 02 dd 03 15 00 00 00 01 00 02 de 4b 15 00 00 00 01 00 02 df 03 15 00 00 00 01 00 02 e0 59 15 00 00 00 01 00 02 e1 03 15 00 00 00 01 00 02 e2 69 15 00 00 00 01 00 02 e3 03 15 00 00 00 01 00 02 e4 7e 15 00 00 00 01 00 02 e5 03 15 00 00 00 01 00 02 e6 9b 15 00 00 00 01 00 02 e7 03 15 00 00 00 01 00 02 e8 b4 15 00 00 00 01 00 02 e9 03 15 00 00 00 01 00 02 ea c3 15 00 00 00 01 00 02 eb 03 15 00 00 00 01 00 02 ec c6 15 00 00 00 01 00 02 ed 03 15 00 00 00 01 00 02 ee ca 15 00 00 00 01 00 02 ef 00 15 01 00 00 01 00 02 f0 37 15 00 00 00 01 00 02 f1 00 15 00 00 00 01 00 02 f2 73 15 00 00 00 01 00 02 f3 00 15 00 00 00 01 00 02 f4 a5 15 00 00 00 01 00 02 f5 00 15 00 00 00 01 00 02 f6 c6 15 00 00 00 01 00 02 f7 00 15 00 00 00 01 00 02 f8 df 15 00 00 00 01 00 02 f9 00 15 00 00 00 01 00 02 fa f3 15 00 00 00 01 00 02 ff 21 15 00 00 00 01 00 02 fb 01 15 00 00 00 01 00 02 00 01 15 00 00 00 01 00 02 01 05 15 00 00 00 01 00 02 02 01 15 00 00 00 01 00 02 03 14 15 00 00 00 01 00 02 04 01 15 00 00 00 01 00 02 05 22 15 00 00 00 01 00 02 06 01 15 00 00 00 01 00 02 07 4e 15 00 00 00 01 00 02 08 01 15 00 00 00 01 00 02 09 70 15 00 00 00 01 00 02 0a 01 15 00 00 00 01 00 02 0b a5 15 00 00 00 01 00 02 0c 01 15 00 00 00 01 00 02 0d d0 15 00 00 00 01 00 02 0e 02 15 00 00 00 01 00 02 0f 12 15 00 00 00 01 00 02 10 02 15 00 00 00 01 00 02 11 46 15 00 00 00 01 00 02 12 02 15 00 00 00 01 00 02 13 46 15 00 00 00 01 00 02 14 02 15 00 00 00 01 00 02 15 76 15 00 00 00 01 00 02 16 02 15 00 00 00 01 00 02 17 a9 15 00 00 00 01 00 02 18 02 15 00 00 00 01 00 02 19 d3 15 00 00 00 01 00 02 1a 03 15 00 00 00 01 00 02 1b 00 15 00 00 00 01 00 02 1c 03 15 01 00 00 01 00 02 1d 21 15 00 00 00 01 00 02 1e 03 15 00 00 00 01 00 02 1f 49 15 00 00 00 01 00 02 20 03 15 00 00 00 01 00 02 21 55 15 00 00 00 01 00 02 22 03 15 00 00 00 01 00 02 23 63 15 00 00 00 01 00 02 24 03 15 00 00 00 01 00 02 25 75 15 00 00 00 01 00 02 26 03 15 00 00 00 01 00 02 27 8e 15 00 00 00 01 00 02 28 03 15 00 00 00 01 00 02 29 ac 15 00 00 00 01 00 02 2a 03 15 00 00 00 01 00 02 2b c0 15 00 00 00 01 00 02 2d 03 15 00 00 00 01 00 02 2f c6 15 00 00 00 01 00 02 30 03 15 00 00 00 01 00 02 31 ca 15 00 00 00 01 00 02 32 00 15 00 00 00 01 00 02 33 37 15 00 00 00 01 00 02 34 00 15 00 00 00 01 00 02 35 73 15 00 00 00 01 00 02 36 00 15 00 00 00 01 00 02 37 a5 15 00 00 00 01 00 02 38 00 15 00 00 00 01 00 02 39 c6 15 00 00 00 01 00 02 3a 00 15 00 00 00 01 00 02 3b df 15 00 00 00 01 00 02 3d 00 15 00 00 00 01 00 02 3f f3 15 00 00 00 01 00 02 40 01 15 00 00 00 01 00 02 41 05 15 00 00 00 01 00 02 42 01 15 00 00 00 01 00 02 43 14 15 00 00 00 01 00 02 44 01 15 00 00 00 01 00 02 45 22 15 00 00 00 01 00 02 46 01 15 00 00 00 01 00 02 47 4e 15 00 00 00 01 00 02 48 01 15 00 00 00 01 00 02 49 70 15 00 00 00 01 00 02 4a 01 15 01 00 00 01 00 02 4b a5 15 00 00 00 01 00 02 4c 01 15 00 00 00 01 00 02 4d d0 15 00 00 00 01 00 02 4e 02 15 00 00 00 01 00 02 4f 12 15 00 00 00 01 00 02 50 02 15 00 00 00 01 00 02 51 46 15 00 00 00 01 00 02 52 02 15 00 00 00 01 00 02 53 46 15 00 00 00 01 00 02 54 02 15 00 00 00 01 00 02 55 76 15 00 00 00 01 00 02 56 02 15 00 00 00 01 00 02 58 a9 15 00 00 00 01 00 02 59 02 15 00 00 00 01 00 02 5a d3 15 00 00 00 01 00 02 5b 03 15 00 00 00 01 00 02 5c 00 15 00 00 00 01 00 02 5d 03 15 00 00 00 01 00 02 5e 21 15 00 00 00 01 00 02 5f 03 15 00 00 00 01 00 02 60 49 15 00 00 00 01 00 02 61 03 15 00 00 00 01 00 02 62 55 15 00 00 00 01 00 02 63 03 15 00 00 00 01 00 02 64 63 15 00 00 00 01 00 02 65 03 15 00 00 00 01 00 02 66 75 15 00 00 00 01 00 02 67 03 15 00 00 00 01 00 02 68 8e 15 00 00 00 01 00 02 69 03 15 00 00 00 01 00 02 6a ac 15 00 00 00 01 00 02 6b 03 15 00 00 00 01 00 02 6c c0 15 00 00 00 01 00 02 6d 03 15 00 00 00 01 00 02 6e c6 15 00 00 00 01 00 02 6f 03 15 00 00 00 01 00 02 70 ca 15 00 00 00 01 00 02 71 01 15 00 00 00 01 00 02 72 b0 15 00 00 00 01 00 02 73 01 15 00 00 00 01 00 02 74 b2 15 01 00 00 01 00 02 75 01 15 00 00 00 01 00 02 76 b7 15 00 00 00 01 00 02 77 01 15 00 00 00 01 00 02 78 bb 15 00 00 00 01 00 02 79 01 15 00 00 00 01 00 02 7a bf 15 00 00 00 01 00 02 7b 01 15 00 00 00 01 00 02 7c c3 15 00 00 00 01 00 02 7d 01 15 00 00 00 01 00 02 7e c7 15 00 00 00 01 00 02 7f 01 15 00 00 00 01 00 02 80 cb 15 00 00 00 01 00 02 81 01 15 00 00 00 01 00 02 82 cf 15 00 00 00 01 00 02 83 01 15 00 00 00 01 00 02 84 de 15 00 00 00 01 00 02 85 01 15 00 00 00 01 00 02 86 ec 15 00 00 00 01 00 02 87 02 15 00 00 00 01 00 02 88 06 15 00 00 00 01 00 02 89 02 15 00 00 00 01 00 02 8a 1e 15 00 00 00 01 00 02 8b 02 15 00 00 00 01 00 02 8c 46 15 00 00 00 01 00 02 8d 02 15 00 00 00 01 00 02 8e 6b 15 00 00 00 01 00 02 8f 02 15 00 00 00 01 00 02 90 6d 15 00 00 00 01 00 02 91 02 15 00 00 00 01 00 02 92 94 15 00 00 00 01 00 02 93 02 15 00 00 00 01 00 02 94 c7 15 00 00 00 01 00 02 95 02 15 00 00 00 01 00 02 96 eb 15 00 00 00 01 00 02 97 03 15 00 00 00 01 00 02 98 19 15 00 00 00 01 00 02 99 03 15 00 00 00 01 00 02 9a 37 15 00 00 00 01 00 02 9b 03 15 00 00 00 01 00 02 9c 63 15 00 00 00 01 00 02 9d 03 15 01 00 00 01 00 02 9e 74 15 00 00 00 01 00 02 9f 03 15 00 00 00 01 00 02 a0 8c 15 00 00 00 01 00 02 a2 03 15 00 00 00 01 00 02 a3 a3 15 00 00 00 01 00 02 a4 03 15 00 00 00 01 00 02 a5 b4 15 00 00 00 01 00 02 a6 03 15 00 00 00 01 00 02 a7 c0 15 00 00 00 01 00 02 a9 03 15 00 00 00 01 00 02 aa c4 15 00 00 00 01 00 02 ab 03 15 00 00 00 01 00 02 ac c6 15 00 00 00 01 00 02 ad 03 15 00 00 00 01 00 02 ae ca 15 00 00 00 01 00 02 af 01 15 00 00 00 01 00 02 b0 b0 15 00 00 00 01 00 02 b1 01 15 00 00 00 01 00 02 b2 b2 15 00 00 00 01 00 02 b3 01 15 00 00 00 01 00 02 b4 b7 15 00 00 00 01 00 02 b5 01 15 00 00 00 01 00 02 b6 bb 15 00 00 00 01 00 02 b7 01 15 00 00 00 01 00 02 b8 bf 15 00 00 00 01 00 02 b9 01 15 00 00 00 01 00 02 ba c3 15 00 00 00 01 00 02 bb 01 15 00 00 00 01 00 02 bc c7 15 00 00 00 01 00 02 bd 01 15 00 00 00 01 00 02 be cb 15 00 00 00 01 00 02 bf 01 15 00 00 00 01 00 02 c0 cf 15 00 00 00 01 00 02 c1 01 15 00 00 00 01 00 02 c2 de 15 00 00 00 01 00 02 c3 01 15 00 00 00 01 00 02 c4 ec 15 00 00 00 01 00 02 c5 02 15 00 00 00 01 00 02 c6 06 15 00 00 00 01 00 02 c7 02 15 00 00 00 01 00 02 c8 1e 15 00 00 00 01 00 02 c9 02 15 01 00 00 01 00 02 ca 46 15 00 00 00 01 00 02 cb 02 15 00 00 00 01 00 02 cc 6b 15 00 00 00 01 00 02 cd 02 15 00 00 00 01 00 02 ce 6d 15 00 00 00 01 00 02 cf 02 15 00 00 00 01 00 02 d0 94 15 00 00 00 01 00 02 d1 02 15 00 00 00 01 00 02 d2 c7 15 00 00 00 01 00 02 d3 02 15 00 00 00 01 00 02 d4 eb 15 00 00 00 01 00 02 d5 03 15 00 00 00 01 00 02 d6 19 15 00 00 00 01 00 02 d7 03 15 00 00 00 01 00 02 d8 37 15 00 00 00 01 00 02 d9 03 15 00 00 00 01 00 02 da 63 15 00 00 00 01 00 02 db 03 15 00 00 00 01 00 02 dc 74 15 00 00 00 01 00 02 dd 03 15 00 00 00 01 00 02 de 8c 15 00 00 00 01 00 02 df 03 15 00 00 00 01 00 02 e0 a3 15 00 00 00 01 00 02 e1 03 15 00 00 00 01 00 02 e2 b4 15 00 00 00 01 00 02 e3 03 15 00 00 00 01 00 02 e4 c0 15 00 00 00 01 00 02 e5 03 15 00 00 00 01 00 02 e6 c4 15 00 00 00 01 00 02 e7 03 15 00 00 00 01 00 02 e8 c6 15 00 00 00 01 00 02 e9 03 15 00 00 00 01 00 02 ea ca 15 00 00 00 01 00 02 fb 01 15 01 00 00 01 00 02 ff 10];
		qcom,mdss-dsi-dispparam-papermode2-command-state = "dsi_hs_mode";
		qcom,mdss-dsi-dispparam-papermode3-command = [15 00 00 00 01 00 02 ff 20 15 00 00 00 01 00 02 fb 01 15 00 00 00 01 00 02 75 00 15 00 00 00 01 00 02 76 c9 15 00 00 00 01 00 02 77 00 15 00 00 00 01 00 02 78 d6 15 00 00 00 01 00 02 79 00 15 00 00 00 01 00 02 7a ed 15 00 00 00 01 00 02 7b 00 15 00 00 00 01 00 02 7c ff 15 00 00 00 01 00 02 7d 01 15 00 00 00 01 00 02 7e 0f 15 00 00 00 01 00 02 7f 01 15 00 00 00 01 00 02 80 1e 15 00 00 00 01 00 02 81 01 15 00 00 00 01 00 02 82 2a 15 00 00 00 01 00 02 83 01 15 00 00 00 01 00 02 84 36 15 00 00 00 01 00 02 85 01 15 00 00 00 01 00 02 86 41 15 00 00 00 01 00 02 87 01 15 00 00 00 01 00 02 88 65 15 00 00 00 01 00 02 89 01 15 00 00 00 01 00 02 8a 82 15 00 00 00 01 00 02 8b 01 15 00 00 00 01 00 02 8c b2 15 00 00 00 01 00 02 8d 01 15 00 00 00 01 00 02 8e da 15 00 00 00 01 00 02 8f 02 15 00 00 00 01 00 02 90 18 15 00 00 00 01 00 02 91 02 15 00 00 00 01 00 02 92 4a 15 00 00 00 01 00 02 93 02 15 00 00 00 01 00 02 94 4a 15 00 00 00 01 00 02 95 02 15 00 00 00 01 00 02 96 78 15 00 00 00 01 00 02 97 02 15 00 00 00 01 00 02 98 ab 15 00 00 00 01 00 02 99 02 15 00 00 00 01 00 02 9a d6 15 00 00 00 01 00 02 9b 03 15 00 00 00 01 00 02 9c 03 15 01 00 00 01 00 02 9d 03 15 00 00 00 01 00 02 9e 23 15 00 00 00 01 00 02 9f 03 15 00 00 00 01 00 02 a0 4b 15 00 00 00 01 00 02 a2 03 15 00 00 00 01 00 02 a3 59 15 00 00 00 01 00 02 a4 03 15 00 00 00 01 00 02 a5 69 15 00 00 00 01 00 02 a6 03 15 00 00 00 01 00 02 a7 7e 15 00 00 00 01 00 02 a9 03 15 00 00 00 01 00 02 aa 9b 15 00 00 00 01 00 02 ab 03 15 00 00 00 01 00 02 ac b4 15 00 00 00 01 00 02 ad 03 15 00 00 00 01 00 02 ae c3 15 00 00 00 01 00 02 af 03 15 00 00 00 01 00 02 b0 c6 15 00 00 00 01 00 02 b1 03 15 00 00 00 01 00 02 b2 ca 15 00 00 00 01 00 02 b3 00 15 00 00 00 01 00 02 b4 c9 15 00 00 00 01 00 02 b5 00 15 00 00 00 01 00 02 b6 d6 15 00 00 00 01 00 02 b7 00 15 00 00 00 01 00 02 b8 ed 15 00 00 00 01 00 02 b9 00 15 00 00 00 01 00 02 ba ff 15 00 00 00 01 00 02 bb 01 15 00 00 00 01 00 02 bc 0f 15 00 00 00 01 00 02 bd 01 15 00 00 00 01 00 02 be 1e 15 00 00 00 01 00 02 bf 01 15 00 00 00 01 00 02 c0 2a 15 00 00 00 01 00 02 c1 01 15 00 00 00 01 00 02 c2 36 15 00 00 00 01 00 02 c3 01 15 00 00 00 01 00 02 c4 41 15 00 00 00 01 00 02 c5 01 15 00 00 00 01 00 02 c6 65 15 00 00 00 01 00 02 c7 01 15 01 00 00 01 00 02 c8 82 15 00 00 00 01 00 02 c9 01 15 00 00 00 01 00 02 ca b2 15 00 00 00 01 00 02 cb 01 15 00 00 00 01 00 02 cc da 15 00 00 00 01 00 02 cd 02 15 00 00 00 01 00 02 ce 18 15 00 00 00 01 00 02 cf 02 15 00 00 00 01 00 02 d0 4a 15 00 00 00 01 00 02 d1 02 15 00 00 00 01 00 02 d2 4a 15 00 00 00 01 00 02 d3 02 15 00 00 00 01 00 02 d4 78 15 00 00 00 01 00 02 d5 02 15 00 00 00 01 00 02 d6 ab 15 00 00 00 01 00 02 d7 02 15 00 00 00 01 00 02 d8 d6 15 00 00 00 01 00 02 d9 03 15 00 00 00 01 00 02 da 03 15 00 00 00 01 00 02 db 03 15 00 00 00 01 00 02 dc 23 15 00 00 00 01 00 02 dd 03 15 00 00 00 01 00 02 de 4b 15 00 00 00 01 00 02 df 03 15 00 00 00 01 00 02 e0 59 15 00 00 00 01 00 02 e1 03 15 00 00 00 01 00 02 e2 69 15 00 00 00 01 00 02 e3 03 15 00 00 00 01 00 02 e4 7e 15 00 00 00 01 00 02 e5 03 15 00 00 00 01 00 02 e6 9b 15 00 00 00 01 00 02 e7 03 15 00 00 00 01 00 02 e8 b4 15 00 00 00 01 00 02 e9 03 15 00 00 00 01 00 02 ea c3 15 00 00 00 01 00 02 eb 03 15 00 00 00 01 00 02 ec c6 15 00 00 00 01 00 02 ed 03 15 00 00 00 01 00 02 ee ca 15 00 00 00 01 00 02 ef 00 15 00 00 00 01 00 02 f0 37 15 01 00 00 01 00 02 f1 00 15 00 00 00 01 00 02 f2 73 15 00 00 00 01 00 02 f3 00 15 00 00 00 01 00 02 f4 a5 15 00 00 00 01 00 02 f5 00 15 00 00 00 01 00 02 f6 c6 15 00 00 00 01 00 02 f7 00 15 00 00 00 01 00 02 f8 df 15 00 00 00 01 00 02 f9 00 15 00 00 00 01 00 02 fa f3 15 00 00 00 01 00 02 ff 21 15 00 00 00 01 00 02 fb 01 15 00 00 00 01 00 02 00 01 15 00 00 00 01 00 02 01 05 15 00 00 00 01 00 02 02 01 15 00 00 00 01 00 02 03 14 15 00 00 00 01 00 02 04 01 15 00 00 00 01 00 02 05 22 15 00 00 00 01 00 02 06 01 15 00 00 00 01 00 02 07 4e 15 00 00 00 01 00 02 08 01 15 00 00 00 01 00 02 09 70 15 00 00 00 01 00 02 0a 01 15 00 00 00 01 00 02 0b a5 15 00 00 00 01 00 02 0c 01 15 00 00 00 01 00 02 0d d0 15 00 00 00 01 00 02 0e 02 15 00 00 00 01 00 02 0f 12 15 00 00 00 01 00 02 10 02 15 00 00 00 01 00 02 11 46 15 00 00 00 01 00 02 12 02 15 00 00 00 01 00 02 13 46 15 00 00 00 01 00 02 14 02 15 00 00 00 01 00 02 15 76 15 00 00 00 01 00 02 16 02 15 00 00 00 01 00 02 17 a9 15 00 00 00 01 00 02 18 02 15 00 00 00 01 00 02 19 d3 15 00 00 00 01 00 02 1a 03 15 00 00 00 01 00 02 1b 00 15 01 00 00 01 00 02 1c 03 15 00 00 00 01 00 02 1d 21 15 00 00 00 01 00 02 1e 03 15 00 00 00 01 00 02 1f 49 15 00 00 00 01 00 02 20 03 15 00 00 00 01 00 02 21 55 15 00 00 00 01 00 02 22 03 15 00 00 00 01 00 02 23 63 15 00 00 00 01 00 02 24 03 15 00 00 00 01 00 02 25 75 15 00 00 00 01 00 02 26 03 15 00 00 00 01 00 02 27 8e 15 00 00 00 01 00 02 28 03 15 00 00 00 01 00 02 29 ac 15 00 00 00 01 00 02 2a 03 15 00 00 00 01 00 02 2b c0 15 00 00 00 01 00 02 2d 03 15 00 00 00 01 00 02 2f c6 15 00 00 00 01 00 02 30 03 15 00 00 00 01 00 02 31 ca 15 00 00 00 01 00 02 32 00 15 00 00 00 01 00 02 33 37 15 00 00 00 01 00 02 34 00 15 00 00 00 01 00 02 35 73 15 00 00 00 01 00 02 36 00 15 00 00 00 01 00 02 37 a5 15 00 00 00 01 00 02 38 00 15 00 00 00 01 00 02 39 c6 15 00 00 00 01 00 02 3a 00 15 00 00 00 01 00 02 3b df 15 00 00 00 01 00 02 3d 00 15 00 00 00 01 00 02 3f f3 15 00 00 00 01 00 02 40 01 15 00 00 00 01 00 02 41 05 15 00 00 00 01 00 02 42 01 15 00 00 00 01 00 02 43 14 15 00 00 00 01 00 02 44 01 15 00 00 00 01 00 02 45 22 15 00 00 00 01 00 02 46 01 15 00 00 00 01 00 02 47 4e 15 00 00 00 01 00 02 48 01 15 01 00 00 01 00 02 49 70 15 00 00 00 01 00 02 4a 01 15 00 00 00 01 00 02 4b a5 15 00 00 00 01 00 02 4c 01 15 00 00 00 01 00 02 4d d0 15 00 00 00 01 00 02 4e 02 15 00 00 00 01 00 02 4f 12 15 00 00 00 01 00 02 50 02 15 00 00 00 01 00 02 51 46 15 00 00 00 01 00 02 52 02 15 00 00 00 01 00 02 53 46 15 00 00 00 01 00 02 54 02 15 00 00 00 01 00 02 55 76 15 00 00 00 01 00 02 56 02 15 00 00 00 01 00 02 58 a9 15 00 00 00 01 00 02 59 02 15 00 00 00 01 00 02 5a d3 15 00 00 00 01 00 02 5b 03 15 00 00 00 01 00 02 5c 00 15 00 00 00 01 00 02 5d 03 15 00 00 00 01 00 02 5e 21 15 00 00 00 01 00 02 5f 03 15 00 00 00 01 00 02 60 49 15 00 00 00 01 00 02 61 03 15 00 00 00 01 00 02 62 55 15 00 00 00 01 00 02 63 03 15 00 00 00 01 00 02 64 63 15 00 00 00 01 00 02 65 03 15 00 00 00 01 00 02 66 75 15 00 00 00 01 00 02 67 03 15 00 00 00 01 00 02 68 8e 15 00 00 00 01 00 02 69 03 15 00 00 00 01 00 02 6a ac 15 00 00 00 01 00 02 6b 03 15 00 00 00 01 00 02 6c c0 15 00 00 00 01 00 02 6d 03 15 00 00 00 01 00 02 6e c6 15 00 00 00 01 00 02 6f 03 15 00 00 00 01 00 02 70 ca 15 00 00 00 01 00 02 71 01 15 01 00 00 01 00 02 72 d0 15 00 00 00 01 00 02 73 01 15 00 00 00 01 00 02 74 d2 15 00 00 00 01 00 02 75 01 15 00 00 00 01 00 02 76 d5 15 00 00 00 01 00 02 77 01 15 00 00 00 01 00 02 78 d9 15 00 00 00 01 00 02 79 01 15 00 00 00 01 00 02 7a dc 15 00 00 00 01 00 02 7b 01 15 00 00 00 01 00 02 7c e0 15 00 00 00 01 00 02 7d 01 15 00 00 00 01 00 02 7e e3 15 00 00 00 01 00 02 7f 01 15 00 00 00 01 00 02 80 e6 15 00 00 00 01 00 02 81 01 15 00 00 00 01 00 02 82 e9 15 00 00 00 01 00 02 83 01 15 00 00 00 01 00 02 84 f5 15 00 00 00 01 00 02 85 02 15 00 00 00 01 00 02 86 02 15 00 00 00 01 00 02 87 02 15 00 00 00 01 00 02 88 19 15 00 00 00 01 00 02 89 02 15 00 00 00 01 00 02 8a 2d 15 00 00 00 01 00 02 8b 02 15 00 00 00 01 00 02 8c 51 15 00 00 00 01 00 02 8d 02 15 00 00 00 01 00 02 8e 75 15 00 00 00 01 00 02 8f 02 15 00 00 00 01 00 02 90 75 15 00 00 00 01 00 02 91 02 15 00 00 00 01 00 02 92 9c 15 00 00 00 01 00 02 93 02 15 00 00 00 01 00 02 94 cf 15 00 00 00 01 00 02 95 02 15 00 00 00 01 00 02 96 f2 15 00 00 00 01 00 02 97 03 15 00 00 00 01 00 02 98 20 15 00 00 00 01 00 02 99 03 15 00 00 00 01 00 02 9a 3d 15 01 00 00 01 00 02 9b 03 15 00 00 00 01 00 02 9c 6a 15 00 00 00 01 00 02 9d 03 15 00 00 00 01 00 02 9e 7d 15 00 00 00 01 00 02 9f 03 15 00 00 00 01 00 02 a0 94 15 00 00 00 01 00 02 a2 03 15 00 00 00 01 00 02 a3 a8 15 00 00 00 01 00 02 a4 03 15 00 00 00 01 00 02 a5 b7 15 00 00 00 01 00 02 a6 03 15 00 00 00 01 00 02 a7 c1 15 00 00 00 01 00 02 a9 03 15 00 00 00 01 00 02 aa c4 15 00 00 00 01 00 02 ab 03 15 00 00 00 01 00 02 ac c6 15 00 00 00 01 00 02 ad 03 15 00 00 00 01 00 02 ae ca 15 00 00 00 01 00 02 af 01 15 00 00 00 01 00 02 b0 d0 15 00 00 00 01 00 02 b1 01 15 00 00 00 01 00 02 b2 d2 15 00 00 00 01 00 02 b3 01 15 00 00 00 01 00 02 b4 d5 15 00 00 00 01 00 02 b5 01 15 00 00 00 01 00 02 b6 d9 15 00 00 00 01 00 02 b7 01 15 00 00 00 01 00 02 b8 dc 15 00 00 00 01 00 02 b9 01 15 00 00 00 01 00 02 ba e0 15 00 00 00 01 00 02 bb 01 15 00 00 00 01 00 02 bc e3 15 00 00 00 01 00 02 bd 01 15 00 00 00 01 00 02 be e6 15 00 00 00 01 00 02 bf 01 15 00 00 00 01 00 02 c0 e9 15 00 00 00 01 00 02 c1 01 15 00 00 00 01 00 02 c2 f5 15 00 00 00 01 00 02 c3 02 15 00 00 00 01 00 02 c4 02 15 00 00 00 01 00 02 c5 02 15 01 00 00 01 00 02 c6 19 15 00 00 00 01 00 02 c7 02 15 00 00 00 01 00 02 c8 2d 15 00 00 00 01 00 02 c9 02 15 00 00 00 01 00 02 ca 51 15 00 00 00 01 00 02 cb 02 15 00 00 00 01 00 02 cc 75 15 00 00 00 01 00 02 cd 02 15 00 00 00 01 00 02 ce 75 15 00 00 00 01 00 02 cf 02 15 00 00 00 01 00 02 d0 9c 15 00 00 00 01 00 02 d1 02 15 00 00 00 01 00 02 d2 cf 15 00 00 00 01 00 02 d3 02 15 00 00 00 01 00 02 d4 f2 15 00 00 00 01 00 02 d5 03 15 00 00 00 01 00 02 d6 20 15 00 00 00 01 00 02 d7 03 15 00 00 00 01 00 02 d8 3d 15 00 00 00 01 00 02 d9 03 15 00 00 00 01 00 02 da 6a 15 00 00 00 01 00 02 db 03 15 00 00 00 01 00 02 dc 7d 15 00 00 00 01 00 02 dd 03 15 00 00 00 01 00 02 de 94 15 00 00 00 01 00 02 df 03 15 00 00 00 01 00 02 e0 a8 15 00 00 00 01 00 02 e1 03 15 00 00 00 01 00 02 e2 b7 15 00 00 00 01 00 02 e3 03 15 00 00 00 01 00 02 e4 c1 15 00 00 00 01 00 02 e5 03 15 00 00 00 01 00 02 e6 c4 15 00 00 00 01 00 02 e7 03 15 00 00 00 01 00 02 e8 c6 15 00 00 00 01 00 02 e9 03 15 00 00 00 01 00 02 ea ca 15 00 00 00 01 00 02 fb 01 15 01 00 00 01 00 02 ff 10];
		qcom,mdss-dsi-dispparam-papermode3-command-state = "dsi_hs_mode";
		qcom,mdss-dsi-dispparam-papermode4-command = [15 00 00 00 01 00 02 ff 20 15 00 00 00 01 00 02 fb 01 15 00 00 00 01 00 02 75 00 15 00 00 00 01 00 02 76 c9 15 00 00 00 01 00 02 77 00 15 00 00 00 01 00 02 78 d7 15 00 00 00 01 00 02 79 00 15 00 00 00 01 00 02 7a ee 15 00 00 00 01 00 02 7b 01 15 00 00 00 01 00 02 7c 01 15 00 00 00 01 00 02 7d 01 15 00 00 00 01 00 02 7e 11 15 00 00 00 01 00 02 7f 01 15 00 00 00 01 00 02 80 20 15 00 00 00 01 00 02 81 01 15 00 00 00 01 00 02 82 2d 15 00 00 00 01 00 02 83 01 15 00 00 00 01 00 02 84 39 15 00 00 00 01 00 02 85 01 15 00 00 00 01 00 02 86 44 15 00 00 00 01 00 02 87 01 15 00 00 00 01 00 02 88 68 15 00 00 00 01 00 02 89 01 15 00 00 00 01 00 02 8a 86 15 00 00 00 01 00 02 8b 01 15 00 00 00 01 00 02 8c b7 15 00 00 00 01 00 02 8d 01 15 00 00 00 01 00 02 8e df 15 00 00 00 01 00 02 8f 02 15 00 00 00 01 00 02 90 1e 15 00 00 00 01 00 02 91 02 15 00 00 00 01 00 02 92 4f 15 00 00 00 01 00 02 93 02 15 00 00 00 01 00 02 94 51 15 00 00 00 01 00 02 95 02 15 00 00 00 01 00 02 96 7e 15 00 00 00 01 00 02 97 02 15 00 00 00 01 00 02 98 b3 15 00 00 00 01 00 02 99 02 15 00 00 00 01 00 02 9a e0 15 00 00 00 01 00 02 9b 03 15 00 00 00 01 00 02 9c 0d 15 00 00 00 01 00 02 9d 03 15 01 00 00 01 00 02 9e 2d 15 00 00 00 01 00 02 9f 03 15 00 00 00 01 00 02 a0 58 15 00 00 00 01 00 02 a2 03 15 00 00 00 01 00 02 a3 67 15 00 00 00 01 00 02 a4 03 15 00 00 00 01 00 02 a5 7b 15 00 00 00 01 00 02 a6 03 15 00 00 00 01 00 02 a7 96 15 00 00 00 01 00 02 a9 03 15 00 00 00 01 00 02 aa b2 15 00 00 00 01 00 02 ab 03 15 00 00 00 01 00 02 ac c4 15 00 00 00 01 00 02 ad 03 15 00 00 00 01 00 02 ae d1 15 00 00 00 01 00 02 af 03 15 00 00 00 01 00 02 b0 d7 15 00 00 00 01 00 02 b1 03 15 00 00 00 01 00 02 b2 d8 15 00 00 00 01 00 02 b3 00 15 00 00 00 01 00 02 b4 c9 15 00 00 00 01 00 02 b5 00 15 00 00 00 01 00 02 b6 d7 15 00 00 00 01 00 02 b7 00 15 00 00 00 01 00 02 b8 ee 15 00 00 00 01 00 02 b9 01 15 00 00 00 01 00 02 ba 01 15 00 00 00 01 00 02 bb 01 15 00 00 00 01 00 02 bc 11 15 00 00 00 01 00 02 bd 01 15 00 00 00 01 00 02 be 20 15 00 00 00 01 00 02 bf 01 15 00 00 00 01 00 02 c0 2d 15 00 00 00 01 00 02 c1 01 15 00 00 00 01 00 02 c2 39 15 00 00 00 01 00 02 c3 01 15 00 00 00 01 00 02 c4 44 15 00 00 00 01 00 02 c5 01 15 00 00 00 01 00 02 c6 68 15 00 00 00 01 00 02 c7 01 15 01 00 00 01 00 02 c8 86 15 00 00 00 01 00 02 c9 01 15 00 00 00 01 00 02 ca b7 15 00 00 00 01 00 02 cb 01 15 00 00 00 01 00 02 cc df 15 00 00 00 01 00 02 cd 02 15 00 00 00 01 00 02 ce 1e 15 00 00 00 01 00 02 cf 02 15 00 00 00 01 00 02 d0 4f 15 00 00 00 01 00 02 d1 02 15 00 00 00 01 00 02 d2 51 15 00 00 00 01 00 02 d3 02 15 00 00 00 01 00 02 d4 7e 15 00 00 00 01 00 02 d5 02 15 00 00 00 01 00 02 d6 b3 15 00 00 00 01 00 02 d7 02 15 00 00 00 01 00 02 d8 e0 15 00 00 00 01 00 02 d9 03 15 00 00 00 01 00 02 da 0d 15 00 00 00 01 00 02 db 03 15 00 00 00 01 00 02 dc 2d 15 00 00 00 01 00 02 dd 03 15 00 00 00 01 00 02 de 58 15 00 00 00 01 00 02 df 03 15 00 00 00 01 00 02 e0 67 15 00 00 00 01 00 02 e1 03 15 00 00 00 01 00 02 e2 7b 15 00 00 00 01 00 02 e3 03 15 00 00 00 01 00 02 e4 96 15 00 00 00 01 00 02 e5 03 15 00 00 00 01 00 02 e6 b2 15 00 00 00 01 00 02 e7 03 15 00 00 00 01 00 02 e8 c4 15 00 00 00 01 00 02 e9 03 15 00 00 00 01 00 02 ea d1 15 00 00 00 01 00 02 eb 03 15 00 00 00 01 00 02 ec d7 15 00 00 00 01 00 02 ed 03 15 00 00 00 01 00 02 ee d8 15 00 00 00 01 00 02 ef 00 15 00 00 00 01 00 02 f0 37 15 00 00 00 01 00 02 f1 00 15 01 00 00 01 00 02 f2 75 15 00 00 00 01 00 02 f3 00 15 00 00 00 01 00 02 f4 a8 15 00 00 00 01 00 02 f5 00 15 00 00 00 01 00 02 f6 c9 15 00 00 00 01 00 02 f7 00 15 00 00 00 01 00 02 f8 e2 15 00 00 00 01 00 02 f9 00 15 00 00 00 01 00 02 fa f7 15 00 00 00 01 00 02 ff 21 15 00 00 00 01 00 02 fb 01 15 00 00 00 01 00 02 00 01 15 00 00 00 01 00 02 01 09 15 00 00 00 01 00 02 02 01 15 00 00 00 01 00 02 03 18 15 00 00 00 01 00 02 04 01 15 00 00 00 01 00 02 05 26 15 00 00 00 01 00 02 06 01 15 00 00 00 01 00 02 07 52 15 00 00 00 01 00 02 08 01 15 00 00 00 01 00 02 09 75 15 00 00 00 01 00 02 0a 01 15 00 00 00 01 00 02 0b aa 15 00 00 00 01 00 02 0c 01 15 00 00 00 01 00 02 0d d5 15 00 00 00 01 00 02 0e 02 15 00 00 00 01 00 02 0f 18 15 00 00 00 01 00 02 10 02 15 00 00 00 01 00 02 11 4b 15 00 00 00 01 00 02 12 02 15 00 00 00 01 00 02 13 4d 15 00 00 00 01 00 02 14 02 15 00 00 00 01 00 02 15 7b 15 00 00 00 01 00 02 16 02 15 00 00 00 01 00 02 17 b1 15 00 00 00 01 00 02 18 02 15 00 00 00 01 00 02 19 dd 15 00 00 00 01 00 02 1a 03 15 00 00 00 01 00 02 1b 0a 15 00 00 00 01 00 02 1c 03 15 00 00 00 01 00 02 1d 2b 15 01 00 00 01 00 02 1e 03 15 00 00 00 01 00 02 1f 54 15 00 00 00 01 00 02 20 03 15 00 00 00 01 00 02 21 61 15 00 00 00 01 00 02 22 03 15 00 00 00 01 00 02 23 72 15 00 00 00 01 00 02 24 03 15 00 00 00 01 00 02 25 87 15 00 00 00 01 00 02 26 03 15 00 00 00 01 00 02 27 a5 15 00 00 00 01 00 02 28 03 15 00 00 00 01 00 02 29 be 15 00 00 00 01 00 02 2a 03 15 00 00 00 01 00 02 2b cf 15 00 00 00 01 00 02 2d 03 15 00 00 00 01 00 02 2f d7 15 00 00 00 01 00 02 30 03 15 00 00 00 01 00 02 31 d8 15 00 00 00 01 00 02 32 00 15 00 00 00 01 00 02 33 37 15 00 00 00 01 00 02 34 00 15 00 00 00 01 00 02 35 75 15 00 00 00 01 00 02 36 00 15 00 00 00 01 00 02 37 a8 15 00 00 00 01 00 02 38 00 15 00 00 00 01 00 02 39 c9 15 00 00 00 01 00 02 3a 00 15 00 00 00 01 00 02 3b e2 15 00 00 00 01 00 02 3d 00 15 00 00 00 01 00 02 3f f7 15 00 00 00 01 00 02 40 01 15 00 00 00 01 00 02 41 09 15 00 00 00 01 00 02 42 01 15 00 00 00 01 00 02 43 18 15 00 00 00 01 00 02 44 01 15 00 00 00 01 00 02 45 26 15 00 00 00 01 00 02 46 01 15 00 00 00 01 00 02 47 52 15 00 00 00 01 00 02 48 01 15 00 00 00 01 00 02 49 75 15 01 00 00 01 00 02 4a 01 15 00 00 00 01 00 02 4b aa 15 00 00 00 01 00 02 4c 01 15 00 00 00 01 00 02 4d d5 15 00 00 00 01 00 02 4e 02 15 00 00 00 01 00 02 4f 18 15 00 00 00 01 00 02 50 02 15 00 00 00 01 00 02 51 4b 15 00 00 00 01 00 02 52 02 15 00 00 00 01 00 02 53 4d 15 00 00 00 01 00 02 54 02 15 00 00 00 01 00 02 55 7b 15 00 00 00 01 00 02 56 02 15 00 00 00 01 00 02 58 b1 15 00 00 00 01 00 02 59 02 15 00 00 00 01 00 02 5a dd 15 00 00 00 01 00 02 5b 03 15 00 00 00 01 00 02 5c 0a 15 00 00 00 01 00 02 5d 03 15 00 00 00 01 00 02 5e 2b 15 00 00 00 01 00 02 5f 03 15 00 00 00 01 00 02 60 54 15 00 00 00 01 00 02 61 03 15 00 00 00 01 00 02 62 61 15 00 00 00 01 00 02 63 03 15 00 00 00 01 00 02 64 72 15 00 00 00 01 00 02 65 03 15 00 00 00 01 00 02 66 87 15 00 00 00 01 00 02 67 03 15 00 00 00 01 00 02 68 a5 15 00 00 00 01 00 02 69 03 15 00 00 00 01 00 02 6a be 15 00 00 00 01 00 02 6b 03 15 00 00 00 01 00 02 6c cf 15 00 00 00 01 00 02 6d 03 15 00 00 00 01 00 02 6e d7 15 00 00 00 01 00 02 6f 03 15 00 00 00 01 00 02 70 d8 15 00 00 00 01 00 02 71 01 15 00 00 00 01 00 02 72 ec 15 00 00 00 01 00 02 73 01 15 01 00 00 01 00 02 74 ee 15 00 00 00 01 00 02 75 01 15 00 00 00 01 00 02 76 f1 15 00 00 00 01 00 02 77 01 15 00 00 00 01 00 02 78 f3 15 00 00 00 01 00 02 79 01 15 00 00 00 01 00 02 7a f6 15 00 00 00 01 00 02 7b 01 15 00 00 00 01 00 02 7c f9 15 00 00 00 01 00 02 7d 01 15 00 00 00 01 00 02 7e fd 15 00 00 00 01 00 02 7f 02 15 00 00 00 01 00 02 80 00 15 00 00 00 01 00 02 81 02 15 00 00 00 01 00 02 82 03 15 00 00 00 01 00 02 83 02 15 00 00 00 01 00 02 84 0e 15 00 00 00 01 00 02 85 02 15 00 00 00 01 00 02 86 19 15 00 00 00 01 00 02 87 02 15 00 00 00 01 00 02 88 2c 15 00 00 00 01 00 02 89 02 15 00 00 00 01 00 02 8a 3e 15 00 00 00 01 00 02 8b 02 15 00 00 00 01 00 02 8c 60 15 00 00 00 01 00 02 8d 02 15 00 00 00 01 00 02 8e 82 15 00 00 00 01 00 02 8f 02 15 00 00 00 01 00 02 90 83 15 00 00 00 01 00 02 91 02 15 00 00 00 01 00 02 92 a9 15 00 00 00 01 00 02 93 02 15 00 00 00 01 00 02 94 df 15 00 00 00 01 00 02 95 03 15 00 00 00 01 00 02 96 03 15 00 00 00 01 00 02 97 03 15 00 00 00 01 00 02 98 30 15 00 00 00 01 00 02 99 03 15 00 00 00 01 00 02 9a 4f 15 00 00 00 01 00 02 9b 03 15 00 00 00 01 00 02 9c 8b 15 00 00 00 01 00 02 9d 03 15 01 00 00 01 00 02 9e a0 15 00 00 00 01 00 02 9f 03 15 00 00 00 01 00 02 a0 b1 15 00 00 00 01 00 02 a2 03 15 00 00 00 01 00 02 a3 be 15 00 00 00 01 00 02 a4 03 15 00 00 00 01 00 02 a5 c8 15 00 00 00 01 00 02 a6 03 15 00 00 00 01 00 02 a7 cf 15 00 00 00 01 00 02 a9 03 15 00 00 00 01 00 02 aa d5 15 00 00 00 01 00 02 ab 03 15 00 00 00 01 00 02 ac d8 15 00 00 00 01 00 02 ad 03 15 00 00 00 01 00 02 ae d9 15 00 00 00 01 00 02 af 01 15 00 00 00 01 00 02 b0 ec 15 00 00 00 01 00 02 b1 01 15 00 00 00 01 00 02 b2 ee 15 00 00 00 01 00 02 b3 01 15 00 00 00 01 00 02 b4 f1 15 00 00 00 01 00 02 b5 01 15 00 00 00 01 00 02 b6 f3 15 00 00 00 01 00 02 b7 01 15 00 00 00 01 00 02 b8 f6 15 00 00 00 01 00 02 b9 01 15 00 00 00 01 00 02 ba f9 15 00 00 00 01 00 02 bb 01 15 00 00 00 01 00 02 bc fd 15 00 00 00 01 00 02 bd 02 15 00 00 00 01 00 02 be 00 15 00 00 00 01 00 02 bf 02 15 00 00 00 01 00 02 c0 03 15 00 00 00 01 00 02 c1 02 15 00 00 00 01 00 02 c2 0e 15 00 00 00 01 00 02 c3 02 15 00 00 00 01 00 02 c4 19 15 00 00 00 01 00 02 c5 02 15 00 00 00 01 00 02 c6 2c 15 00 00 00 01 00 02 c7 02 15 00 00 00 01 00 02 c8 3e 15 00 00 00 01 00 02 c9 02 15 00 00 00 01 00 02 ca 60 15 01 00 00 01 00 02 cb 02 15 00 00 00 01 00 02 cc 82 15 00 00 00 01 00 02 cd 02 15 00 00 00 01 00 02 ce 83 15 00 00 00 01 00 02 cf 02 15 00 00 00 01 00 02 d0 a9 15 00 00 00 01 00 02 d1 02 15 00 00 00 01 00 02 d2 df 15 00 00 00 01 00 02 d3 03 15 00 00 00 01 00 02 d4 03 15 00 00 00 01 00 02 d5 03 15 00 00 00 01 00 02 d6 30 15 00 00 00 01 00 02 d7 03 15 00 00 00 01 00 02 d8 4f 15 00 00 00 01 00 02 d9 03 15 00 00 00 01 00 02 da 8b 15 00 00 00 01 00 02 db 03 15 00 00 00 01 00 02 dc a0 15 00 00 00 01 00 02 dd 03 15 00 00 00 01 00 02 de b1 15 00 00 00 01 00 02 df 03 15 00 00 00 01 00 02 e0 be 15 00 00 00 01 00 02 e1 03 15 00 00 00 01 00 02 e2 c8 15 00 00 00 01 00 02 e3 03 15 00 00 00 01 00 02 e4 cf 15 00 00 00 01 00 02 e5 03 15 00 00 00 01 00 02 e6 d5 15 00 00 00 01 00 02 e7 03 15 00 00 00 01 00 02 e8 d8 15 00 00 00 01 00 02 e9 03 15 00 00 00 01 00 02 ea d9 15 00 00 00 01 00 02 fb 01 15 01 00 00 01 00 02 ff 10];
		qcom,mdss-dsi-dispparam-papermode4-command-state = "dsi_hs_mode";
		qcom,mdss-dsi-dispparam-papermode5-command = [15 00 00 00 01 00 02 ff 20 15 00 00 00 01 00 02 fb 01 15 00 00 00 01 00 02 75 00 15 00 00 00 01 00 02 76 c9 15 00 00 00 01 00 02 77 00 15 00 00 00 01 00 02 78 d7 15 00 00 00 01 00 02 79 00 15 00 00 00 01 00 02 7a ee 15 00 00 00 01 00 02 7b 01 15 00 00 00 01 00 02 7c 01 15 00 00 00 01 00 02 7d 01 15 00 00 00 01 00 02 7e 11 15 00 00 00 01 00 02 7f 01 15 00 00 00 01 00 02 80 20 15 00 00 00 01 00 02 81 01 15 00 00 00 01 00 02 82 2d 15 00 00 00 01 00 02 83 01 15 00 00 00 01 00 02 84 39 15 00 00 00 01 00 02 85 01 15 00 00 00 01 00 02 86 44 15 00 00 00 01 00 02 87 01 15 00 00 00 01 00 02 88 68 15 00 00 00 01 00 02 89 01 15 00 00 00 01 00 02 8a 86 15 00 00 00 01 00 02 8b 01 15 00 00 00 01 00 02 8c b7 15 00 00 00 01 00 02 8d 01 15 00 00 00 01 00 02 8e df 15 00 00 00 01 00 02 8f 02 15 00 00 00 01 00 02 90 1e 15 00 00 00 01 00 02 91 02 15 00 00 00 01 00 02 92 4f 15 00 00 00 01 00 02 93 02 15 00 00 00 01 00 02 94 51 15 00 00 00 01 00 02 95 02 15 00 00 00 01 00 02 96 7e 15 00 00 00 01 00 02 97 02 15 00 00 00 01 00 02 98 b3 15 00 00 00 01 00 02 99 02 15 00 00 00 01 00 02 9a e0 15 00 00 00 01 00 02 9b 03 15 01 00 00 01 00 02 9c 0d 15 00 00 00 01 00 02 9d 03 15 00 00 00 01 00 02 9e 2d 15 00 00 00 01 00 02 9f 03 15 00 00 00 01 00 02 a0 58 15 00 00 00 01 00 02 a2 03 15 00 00 00 01 00 02 a3 67 15 00 00 00 01 00 02 a4 03 15 00 00 00 01 00 02 a5 7b 15 00 00 00 01 00 02 a6 03 15 00 00 00 01 00 02 a7 96 15 00 00 00 01 00 02 a9 03 15 00 00 00 01 00 02 aa b2 15 00 00 00 01 00 02 ab 03 15 00 00 00 01 00 02 ac c4 15 00 00 00 01 00 02 ad 03 15 00 00 00 01 00 02 ae d1 15 00 00 00 01 00 02 af 03 15 00 00 00 01 00 02 b0 d7 15 00 00 00 01 00 02 b1 03 15 00 00 00 01 00 02 b2 d8 15 00 00 00 01 00 02 b3 00 15 00 00 00 01 00 02 b4 c9 15 00 00 00 01 00 02 b5 00 15 00 00 00 01 00 02 b6 d7 15 00 00 00 01 00 02 b7 00 15 00 00 00 01 00 02 b8 ee 15 00 00 00 01 00 02 b9 01 15 00 00 00 01 00 02 ba 01 15 00 00 00 01 00 02 bb 01 15 00 00 00 01 00 02 bc 11 15 00 00 00 01 00 02 bd 01 15 00 00 00 01 00 02 be 20 15 00 00 00 01 00 02 bf 01 15 00 00 00 01 00 02 c0 2d 15 00 00 00 01 00 02 c1 01 15 00 00 00 01 00 02 c2 39 15 00 00 00 01 00 02 c3 01 15 00 00 00 01 00 02 c4 44 15 00 00 00 01 00 02 c5 01 15 00 00 00 01 00 02 c6 68 15 01 00 00 01 00 02 c7 01 15 00 00 00 01 00 02 c8 86 15 00 00 00 01 00 02 c9 01 15 00 00 00 01 00 02 ca b7 15 00 00 00 01 00 02 cb 01 15 00 00 00 01 00 02 cc df 15 00 00 00 01 00 02 cd 02 15 00 00 00 01 00 02 ce 1e 15 00 00 00 01 00 02 cf 02 15 00 00 00 01 00 02 d0 4f 15 00 00 00 01 00 02 d1 02 15 00 00 00 01 00 02 d2 51 15 00 00 00 01 00 02 d3 02 15 00 00 00 01 00 02 d4 7e 15 00 00 00 01 00 02 d5 02 15 00 00 00 01 00 02 d6 b3 15 00 00 00 01 00 02 d7 02 15 00 00 00 01 00 02 d8 e0 15 00 00 00 01 00 02 d9 03 15 00 00 00 01 00 02 da 0d 15 00 00 00 01 00 02 db 03 15 00 00 00 01 00 02 dc 2d 15 00 00 00 01 00 02 dd 03 15 00 00 00 01 00 02 de 58 15 00 00 00 01 00 02 df 03 15 00 00 00 01 00 02 e0 67 15 00 00 00 01 00 02 e1 03 15 00 00 00 01 00 02 e2 7b 15 00 00 00 01 00 02 e3 03 15 00 00 00 01 00 02 e4 96 15 00 00 00 01 00 02 e5 03 15 00 00 00 01 00 02 e6 b2 15 00 00 00 01 00 02 e7 03 15 00 00 00 01 00 02 e8 c4 15 00 00 00 01 00 02 e9 03 15 00 00 00 01 00 02 ea d1 15 00 00 00 01 00 02 eb 03 15 00 00 00 01 00 02 ec d7 15 00 00 00 01 00 02 ed 03 15 00 00 00 01 00 02 ee d8 15 00 00 00 01 00 02 ef 00 15 01 00 00 01 00 02 f0 37 15 00 00 00 01 00 02 f1 00 15 00 00 00 01 00 02 f2 75 15 00 00 00 01 00 02 f3 00 15 00 00 00 01 00 02 f4 a8 15 00 00 00 01 00 02 f5 00 15 00 00 00 01 00 02 f6 c9 15 00 00 00 01 00 02 f7 00 15 00 00 00 01 00 02 f8 e2 15 00 00 00 01 00 02 f9 00 15 00 00 00 01 00 02 fa f7 15 00 00 00 01 00 02 ff 21 15 00 00 00 01 00 02 fb 01 15 00 00 00 01 00 02 00 01 15 00 00 00 01 00 02 01 09 15 00 00 00 01 00 02 02 01 15 00 00 00 01 00 02 03 18 15 00 00 00 01 00 02 04 01 15 00 00 00 01 00 02 05 26 15 00 00 00 01 00 02 06 01 15 00 00 00 01 00 02 07 52 15 00 00 00 01 00 02 08 01 15 00 00 00 01 00 02 09 75 15 00 00 00 01 00 02 0a 01 15 00 00 00 01 00 02 0b aa 15 00 00 00 01 00 02 0c 01 15 00 00 00 01 00 02 0d d5 15 00 00 00 01 00 02 0e 02 15 00 00 00 01 00 02 0f 18 15 00 00 00 01 00 02 10 02 15 00 00 00 01 00 02 11 4b 15 00 00 00 01 00 02 12 02 15 00 00 00 01 00 02 13 4d 15 00 00 00 01 00 02 14 02 15 00 00 00 01 00 02 15 7b 15 00 00 00 01 00 02 16 02 15 00 00 00 01 00 02 17 b1 15 00 00 00 01 00 02 18 02 15 00 00 00 01 00 02 19 dd 15 00 00 00 01 00 02 1a 03 15 00 00 00 01 00 02 1b 0a 15 00 00 00 01 00 02 1c 03 15 01 00 00 01 00 02 1d 2b 15 00 00 00 01 00 02 1e 03 15 00 00 00 01 00 02 1f 54 15 00 00 00 01 00 02 20 03 15 00 00 00 01 00 02 21 61 15 00 00 00 01 00 02 22 03 15 00 00 00 01 00 02 23 72 15 00 00 00 01 00 02 24 03 15 00 00 00 01 00 02 25 87 15 00 00 00 01 00 02 26 03 15 00 00 00 01 00 02 27 a5 15 00 00 00 01 00 02 28 03 15 00 00 00 01 00 02 29 be 15 00 00 00 01 00 02 2a 03 15 00 00 00 01 00 02 2b cf 15 00 00 00 01 00 02 2d 03 15 00 00 00 01 00 02 2f d7 15 00 00 00 01 00 02 30 03 15 00 00 00 01 00 02 31 d8 15 00 00 00 01 00 02 32 00 15 00 00 00 01 00 02 33 37 15 00 00 00 01 00 02 34 00 15 00 00 00 01 00 02 35 75 15 00 00 00 01 00 02 36 00 15 00 00 00 01 00 02 37 a8 15 00 00 00 01 00 02 38 00 15 00 00 00 01 00 02 39 c9 15 00 00 00 01 00 02 3a 00 15 00 00 00 01 00 02 3b e2 15 00 00 00 01 00 02 3d 00 15 00 00 00 01 00 02 3f f7 15 00 00 00 01 00 02 40 01 15 00 00 00 01 00 02 41 09 15 00 00 00 01 00 02 42 01 15 00 00 00 01 00 02 43 18 15 00 00 00 01 00 02 44 01 15 00 00 00 01 00 02 45 26 15 00 00 00 01 00 02 46 01 15 00 00 00 01 00 02 47 52 15 00 00 00 01 00 02 48 01 15 00 00 00 01 00 02 49 75 15 00 00 00 01 00 02 4a 01 15 01 00 00 01 00 02 4b aa 15 00 00 00 01 00 02 4c 01 15 00 00 00 01 00 02 4d d5 15 00 00 00 01 00 02 4e 02 15 00 00 00 01 00 02 4f 18 15 00 00 00 01 00 02 50 02 15 00 00 00 01 00 02 51 4b 15 00 00 00 01 00 02 52 02 15 00 00 00 01 00 02 53 4d 15 00 00 00 01 00 02 54 02 15 00 00 00 01 00 02 55 7b 15 00 00 00 01 00 02 56 02 15 00 00 00 01 00 02 58 b1 15 00 00 00 01 00 02 59 02 15 00 00 00 01 00 02 5a dd 15 00 00 00 01 00 02 5b 03 15 00 00 00 01 00 02 5c 0a 15 00 00 00 01 00 02 5d 03 15 00 00 00 01 00 02 5e 2b 15 00 00 00 01 00 02 5f 03 15 00 00 00 01 00 02 60 54 15 00 00 00 01 00 02 61 03 15 00 00 00 01 00 02 62 61 15 00 00 00 01 00 02 63 03 15 00 00 00 01 00 02 64 72 15 00 00 00 01 00 02 65 03 15 00 00 00 01 00 02 66 87 15 00 00 00 01 00 02 67 03 15 00 00 00 01 00 02 68 a5 15 00 00 00 01 00 02 69 03 15 00 00 00 01 00 02 6a be 15 00 00 00 01 00 02 6b 03 15 00 00 00 01 00 02 6c cf 15 00 00 00 01 00 02 6d 03 15 00 00 00 01 00 02 6e d7 15 00 00 00 01 00 02 6f 03 15 00 00 00 01 00 02 70 d8 15 00 00 00 01 00 02 71 02 15 00 00 00 01 00 02 72 01 15 00 00 00 01 00 02 73 02 15 00 00 00 01 00 02 74 02 15 00 00 00 01 00 02 75 02 15 01 00 00 01 00 02 76 05 15 00 00 00 01 00 02 77 02 15 00 00 00 01 00 02 78 08 15 00 00 00 01 00 02 79 02 15 00 00 00 01 00 02 7a 0b 15 00 00 00 01 00 02 7b 02 15 00 00 00 01 00 02 7c 0d 15 00 00 00 01 00 02 7d 02 15 00 00 00 01 00 02 7e 10 15 00 00 00 01 00 02 7f 02 15 00 00 00 01 00 02 80 12 15 00 00 00 01 00 02 81 02 15 00 00 00 01 00 02 82 15 15 00 00 00 01 00 02 83 02 15 00 00 00 01 00 02 84 1e 15 00 00 00 01 00 02 85 02 15 00 00 00 01 00 02 86 27 15 00 00 00 01 00 02 87 02 15 00 00 00 01 00 02 88 39 15 00 00 00 01 00 02 89 02 15 00 00 00 01 00 02 8a 49 15 00 00 00 01 00 02 8b 02 15 00 00 00 01 00 02 8c 69 15 00 00 00 01 00 02 8d 02 15 00 00 00 01 00 02 8e 8a 15 00 00 00 01 00 02 8f 02 15 00 00 00 01 00 02 90 8b 15 00 00 00 01 00 02 91 02 15 00 00 00 01 00 02 92 b0 15 00 00 00 01 00 02 93 02 15 00 00 00 01 00 02 94 e6 15 00 00 00 01 00 02 95 03 15 00 00 00 01 00 02 96 09 15 00 00 00 01 00 02 97 03 15 00 00 00 01 00 02 98 36 15 00 00 00 01 00 02 99 03 15 00 00 00 01 00 02 9a 56 15 00 00 00 01 00 02 9b 03 15 00 00 00 01 00 02 9c 93 15 00 00 00 01 00 02 9d 03 15 00 00 00 01 00 02 9e a6 15 01 00 00 01 00 02 9f 03 15 00 00 00 01 00 02 a0 b5 15 00 00 00 01 00 02 a2 03 15 00 00 00 01 00 02 a3 c0 15 00 00 00 01 00 02 a4 03 15 00 00 00 01 00 02 a5 c9 15 00 00 00 01 00 02 a6 03 15 00 00 00 01 00 02 a7 d0 15 00 00 00 01 00 02 a9 03 15 00 00 00 01 00 02 aa d5 15 00 00 00 01 00 02 ab 03 15 00 00 00 01 00 02 ac d8 15 00 00 00 01 00 02 ad 03 15 00 00 00 01 00 02 ae d9 15 00 00 00 01 00 02 af 02 15 00 00 00 01 00 02 b0 01 15 00 00 00 01 00 02 b1 02 15 00 00 00 01 00 02 b2 02 15 00 00 00 01 00 02 b3 02 15 00 00 00 01 00 02 b4 05 15 00 00 00 01 00 02 b5 02 15 00 00 00 01 00 02 b6 08 15 00 00 00 01 00 02 b7 02 15 00 00 00 01 00 02 b8 0b 15 00 00 00 01 00 02 b9 02 15 00 00 00 01 00 02 ba 0d 15 00 00 00 01 00 02 bb 02 15 00 00 00 01 00 02 bc 10 15 00 00 00 01 00 02 bd 02 15 00 00 00 01 00 02 be 12 15 00 00 00 01 00 02 bf 02 15 00 00 00 01 00 02 c0 15 15 00 00 00 01 00 02 c1 02 15 00 00 00 01 00 02 c2 1e 15 00 00 00 01 00 02 c3 02 15 00 00 00 01 00 02 c4 27 15 00 00 00 01 00 02 c5 02 15 00 00 00 01 00 02 c6 39 15 00 00 00 01 00 02 c7 02 15 00 00 00 01 00 02 c8 49 15 00 00 00 01 00 02 c9 02 15 01 00 00 01 00 02 ca 69 15 00 00 00 01 00 02 cb 02 15 00 00 00 01 00 02 cc 8a 15 00 00 00 01 00 02 cd 02 15 00 00 00 01 00 02 ce 8b 15 00 00 00 01 00 02 cf 02 15 00 00 00 01 00 02 d0 b0 15 00 00 00 01 00 02 d1 02 15 00 00 00 01 00 02 d2 e6 15 00 00 00 01 00 02 d3 03 15 00 00 00 01 00 02 d4 09 15 00 00 00 01 00 02 d5 03 15 00 00 00 01 00 02 d6 36 15 00 00 00 01 00 02 d7 03 15 00 00 00 01 00 02 d8 56 15 00 00 00 01 00 02 d9 03 15 00 00 00 01 00 02 da 93 15 00 00 00 01 00 02 db 03 15 00 00 00 01 00 02 dc a6 15 00 00 00 01 00 02 dd 03 15 00 00 00 01 00 02 de b5 15 00 00 00 01 00 02 df 03 15 00 00 00 01 00 02 e0 c0 15 00 00 00 01 00 02 e1 03 15 00 00 00 01 00 02 e2 c9 15 00 00 00 01 00 02 e3 03 15 00 00 00 01 00 02 e4 d0 15 00 00 00 01 00 02 e5 03 15 00 00 00 01 00 02 e6 d5 15 00 00 00 01 00 02 e7 03 15 00 00 00 01 00 02 e8 d8 15 00 00 00 01 00 02 e9 03 15 00 00 00 01 00 02 ea d9 15 00 00 00 01 00 02 fb 01 15 01 00 00 01 00 02 ff 10];
		qcom,mdss-dsi-dispparam-papermode5-command-state = "dsi_hs_mode";
		qcom,mdss-dsi-dispparam-papermode6-command = [15 00 00 00 01 00 02 ff 20 15 00 00 00 01 00 02 fb 01 15 00 00 00 01 00 02 75 00 15 00 00 00 01 00 02 76 c9 15 00 00 00 01 00 02 77 00 15 00 00 00 01 00 02 78 d6 15 00 00 00 01 00 02 79 00 15 00 00 00 01 00 02 7a ed 15 00 00 00 01 00 02 7b 00 15 00 00 00 01 00 02 7c ff 15 00 00 00 01 00 02 7d 01 15 00 00 00 01 00 02 7e 0f 15 00 00 00 01 00 02 7f 01 15 00 00 00 01 00 02 80 1e 15 00 00 00 01 00 02 81 01 15 00 00 00 01 00 02 82 2a 15 00 00 00 01 00 02 83 01 15 00 00 00 01 00 02 84 36 15 00 00 00 01 00 02 85 01 15 00 00 00 01 00 02 86 41 15 00 00 00 01 00 02 87 01 15 00 00 00 01 00 02 88 65 15 00 00 00 01 00 02 89 01 15 00 00 00 01 00 02 8a 82 15 00 00 00 01 00 02 8b 01 15 00 00 00 01 00 02 8c b2 15 00 00 00 01 00 02 8d 01 15 00 00 00 01 00 02 8e da 15 00 00 00 01 00 02 8f 02 15 00 00 00 01 00 02 90 18 15 00 00 00 01 00 02 91 02 15 00 00 00 01 00 02 92 4a 15 00 00 00 01 00 02 93 02 15 00 00 00 01 00 02 94 4a 15 00 00 00 01 00 02 95 02 15 00 00 00 01 00 02 96 78 15 00 00 00 01 00 02 97 02 15 00 00 00 01 00 02 98 ab 15 00 00 00 01 00 02 99 02 15 00 00 00 01 00 02 9a d6 15 01 00 00 01 00 02 9b 03 15 00 00 00 01 00 02 9c 03 15 00 00 00 01 00 02 9d 03 15 00 00 00 01 00 02 9e 23 15 00 00 00 01 00 02 9f 03 15 00 00 00 01 00 02 a0 4b 15 00 00 00 01 00 02 a2 03 15 00 00 00 01 00 02 a3 59 15 00 00 00 01 00 02 a4 03 15 00 00 00 01 00 02 a5 69 15 00 00 00 01 00 02 a6 03 15 00 00 00 01 00 02 a7 7e 15 00 00 00 01 00 02 a9 03 15 00 00 00 01 00 02 aa 9b 15 00 00 00 01 00 02 ab 03 15 00 00 00 01 00 02 ac b4 15 00 00 00 01 00 02 ad 03 15 00 00 00 01 00 02 ae c3 15 00 00 00 01 00 02 af 03 15 00 00 00 01 00 02 b0 c6 15 00 00 00 01 00 02 b1 03 15 00 00 00 01 00 02 b2 ca 15 00 00 00 01 00 02 b3 00 15 00 00 00 01 00 02 b4 c9 15 00 00 00 01 00 02 b5 00 15 00 00 00 01 00 02 b6 d6 15 00 00 00 01 00 02 b7 00 15 00 00 00 01 00 02 b8 ed 15 00 00 00 01 00 02 b9 00 15 00 00 00 01 00 02 ba ff 15 00 00 00 01 00 02 bb 01 15 00 00 00 01 00 02 bc 0f 15 00 00 00 01 00 02 bd 01 15 00 00 00 01 00 02 be 1e 15 00 00 00 01 00 02 bf 01 15 00 00 00 01 00 02 c0 2a 15 00 00 00 01 00 02 c1 01 15 00 00 00 01 00 02 c2 36 15 00 00 00 01 00 02 c3 01 15 00 00 00 01 00 02 c4 41 15 00 00 00 01 00 02 c5 01 15 01 00 00 01 00 02 c6 65 15 00 00 00 01 00 02 c7 01 15 00 00 00 01 00 02 c8 82 15 00 00 00 01 00 02 c9 01 15 00 00 00 01 00 02 ca b2 15 00 00 00 01 00 02 cb 01 15 00 00 00 01 00 02 cc da 15 00 00 00 01 00 02 cd 02 15 00 00 00 01 00 02 ce 18 15 00 00 00 01 00 02 cf 02 15 00 00 00 01 00 02 d0 4a 15 00 00 00 01 00 02 d1 02 15 00 00 00 01 00 02 d2 4a 15 00 00 00 01 00 02 d3 02 15 00 00 00 01 00 02 d4 78 15 00 00 00 01 00 02 d5 02 15 00 00 00 01 00 02 d6 ab 15 00 00 00 01 00 02 d7 02 15 00 00 00 01 00 02 d8 d6 15 00 00 00 01 00 02 d9 03 15 00 00 00 01 00 02 da 03 15 00 00 00 01 00 02 db 03 15 00 00 00 01 00 02 dc 23 15 00 00 00 01 00 02 dd 03 15 00 00 00 01 00 02 de 4b 15 00 00 00 01 00 02 df 03 15 00 00 00 01 00 02 e0 59 15 00 00 00 01 00 02 e1 03 15 00 00 00 01 00 02 e2 69 15 00 00 00 01 00 02 e3 03 15 00 00 00 01 00 02 e4 7e 15 00 00 00 01 00 02 e5 03 15 00 00 00 01 00 02 e6 9b 15 00 00 00 01 00 02 e7 03 15 00 00 00 01 00 02 e8 b4 15 00 00 00 01 00 02 e9 03 15 00 00 00 01 00 02 ea c3 15 00 00 00 01 00 02 eb 03 15 00 00 00 01 00 02 ec c6 15 00 00 00 01 00 02 ed 03 15 00 00 00 01 00 02 ee ca 15 01 00 00 01 00 02 ef 00 15 00 00 00 01 00 02 f0 37 15 00 00 00 01 00 02 f1 00 15 00 00 00 01 00 02 f2 73 15 00 00 00 01 00 02 f3 00 15 00 00 00 01 00 02 f4 a5 15 00 00 00 01 00 02 f5 00 15 00 00 00 01 00 02 f6 c6 15 00 00 00 01 00 02 f7 00 15 00 00 00 01 00 02 f8 df 15 00 00 00 01 00 02 f9 00 15 00 00 00 01 00 02 fa f3 15 00 00 00 01 00 02 ff 21 15 00 00 00 01 00 02 fb 01 15 00 00 00 01 00 02 00 01 15 00 00 00 01 00 02 01 05 15 00 00 00 01 00 02 02 01 15 00 00 00 01 00 02 03 14 15 00 00 00 01 00 02 04 01 15 00 00 00 01 00 02 05 22 15 00 00 00 01 00 02 06 01 15 00 00 00 01 00 02 07 4e 15 00 00 00 01 00 02 08 01 15 00 00 00 01 00 02 09 70 15 00 00 00 01 00 02 0a 01 15 00 00 00 01 00 02 0b a5 15 00 00 00 01 00 02 0c 01 15 00 00 00 01 00 02 0d d0 15 00 00 00 01 00 02 0e 02 15 00 00 00 01 00 02 0f 12 15 00 00 00 01 00 02 10 02 15 00 00 00 01 00 02 11 46 15 00 00 00 01 00 02 12 02 15 00 00 00 01 00 02 13 46 15 00 00 00 01 00 02 14 02 15 00 00 00 01 00 02 15 76 15 00 00 00 01 00 02 16 02 15 00 00 00 01 00 02 17 a9 15 00 00 00 01 00 02 18 02 15 00 00 00 01 00 02 19 d3 15 01 00 00 01 00 02 1a 03 15 00 00 00 01 00 02 1b 00 15 00 00 00 01 00 02 1c 03 15 00 00 00 01 00 02 1d 21 15 00 00 00 01 00 02 1e 03 15 00 00 00 01 00 02 1f 49 15 00 00 00 01 00 02 20 03 15 00 00 00 01 00 02 21 55 15 00 00 00 01 00 02 22 03 15 00 00 00 01 00 02 23 63 15 00 00 00 01 00 02 24 03 15 00 00 00 01 00 02 25 75 15 00 00 00 01 00 02 26 03 15 00 00 00 01 00 02 27 8e 15 00 00 00 01 00 02 28 03 15 00 00 00 01 00 02 29 ac 15 00 00 00 01 00 02 2a 03 15 00 00 00 01 00 02 2b c0 15 00 00 00 01 00 02 2d 03 15 00 00 00 01 00 02 2f c6 15 00 00 00 01 00 02 30 03 15 00 00 00 01 00 02 31 ca 15 00 00 00 01 00 02 32 00 15 00 00 00 01 00 02 33 37 15 00 00 00 01 00 02 34 00 15 00 00 00 01 00 02 35 73 15 00 00 00 01 00 02 36 00 15 00 00 00 01 00 02 37 a5 15 00 00 00 01 00 02 38 00 15 00 00 00 01 00 02 39 c6 15 00 00 00 01 00 02 3a 00 15 00 00 00 01 00 02 3b df 15 00 00 00 01 00 02 3d 00 15 00 00 00 01 00 02 3f f3 15 00 00 00 01 00 02 40 01 15 00 00 00 01 00 02 41 05 15 00 00 00 01 00 02 42 01 15 00 00 00 01 00 02 43 14 15 00 00 00 01 00 02 44 01 15 00 00 00 01 00 02 45 22 15 00 00 00 01 00 02 46 01 15 01 00 00 01 00 02 47 4e 15 00 00 00 01 00 02 48 01 15 00 00 00 01 00 02 49 70 15 00 00 00 01 00 02 4a 01 15 00 00 00 01 00 02 4b a5 15 00 00 00 01 00 02 4c 01 15 00 00 00 01 00 02 4d d0 15 00 00 00 01 00 02 4e 02 15 00 00 00 01 00 02 4f 12 15 00 00 00 01 00 02 50 02 15 00 00 00 01 00 02 51 46 15 00 00 00 01 00 02 52 02 15 00 00 00 01 00 02 53 46 15 00 00 00 01 00 02 54 02 15 00 00 00 01 00 02 55 76 15 00 00 00 01 00 02 56 02 15 00 00 00 01 00 02 58 a9 15 00 00 00 01 00 02 59 02 15 00 00 00 01 00 02 5a d3 15 00 00 00 01 00 02 5b 03 15 00 00 00 01 00 02 5c 00 15 00 00 00 01 00 02 5d 03 15 00 00 00 01 00 02 5e 21 15 00 00 00 01 00 02 5f 03 15 00 00 00 01 00 02 60 49 15 00 00 00 01 00 02 61 03 15 00 00 00 01 00 02 62 55 15 00 00 00 01 00 02 63 03 15 00 00 00 01 00 02 64 63 15 00 00 00 01 00 02 65 03 15 00 00 00 01 00 02 66 75 15 00 00 00 01 00 02 67 03 15 00 00 00 01 00 02 68 8e 15 00 00 00 01 00 02 69 03 15 00 00 00 01 00 02 6a ac 15 00 00 00 01 00 02 6b 03 15 00 00 00 01 00 02 6c c0 15 00 00 00 01 00 02 6d 03 15 00 00 00 01 00 02 6e c6 15 00 00 00 01 00 02 6f 03 15 01 00 00 01 00 02 70 ca 15 00 00 00 01 00 02 71 02 15 00 00 00 01 00 02 72 15 15 00 00 00 01 00 02 73 02 15 00 00 00 01 00 02 74 15 15 00 00 00 01 00 02 75 02 15 00 00 00 01 00 02 76 18 15 00 00 00 01 00 02 77 02 15 00 00 00 01 00 02 78 1a 15 00 00 00 01 00 02 79 02 15 00 00 00 01 00 02 7a 1d 15 00 00 00 01 00 02 7b 02 15 00 00 00 01 00 02 7c 1f 15 00 00 00 01 00 02 7d 02 15 00 00 00 01 00 02 7e 21 15 00 00 00 01 00 02 7f 02 15 00 00 00 01 00 02 80 23 15 00 00 00 01 00 02 81 02 15 00 00 00 01 00 02 82 25 15 00 00 00 01 00 02 83 02 15 00 00 00 01 00 02 84 2d 15 00 00 00 01 00 02 85 02 15 00 00 00 01 00 02 86 35 15 00 00 00 01 00 02 87 02 15 00 00 00 01 00 02 88 44 15 00 00 00 01 00 02 89 02 15 00 00 00 01 00 02 8a 53 15 00 00 00 01 00 02 8b 02 15 00 00 00 01 00 02 8c 70 15 00 00 00 01 00 02 8d 02 15 00 00 00 01 00 02 8e 8e 15 00 00 00 01 00 02 8f 02 15 00 00 00 01 00 02 90 8e 15 00 00 00 01 00 02 91 02 15 00 00 00 01 00 02 92 b3 15 00 00 00 01 00 02 93 02 15 00 00 00 01 00 02 94 e6 15 00 00 00 01 00 02 95 03 15 00 00 00 01 00 02 96 08 15 00 00 00 01 00 02 97 03 15 00 00 00 01 00 02 98 32 15 01 00 00 01 00 02 99 03 15 00 00 00 01 00 02 9a 50 15 00 00 00 01 00 02 9b 03 15 00 00 00 01 00 02 9c 83 15 00 00 00 01 00 02 9d 03 15 00 00 00 01 00 02 9e 97 15 00 00 00 01 00 02 9f 03 15 00 00 00 01 00 02 a0 a7 15 00 00 00 01 00 02 a2 03 15 00 00 00 01 00 02 a3 b4 15 00 00 00 01 00 02 a4 03 15 00 00 00 01 00 02 a5 bd 15 00 00 00 01 00 02 a6 03 15 00 00 00 01 00 02 a7 c2 15 00 00 00 01 00 02 a9 03 15 00 00 00 01 00 02 aa c4 15 00 00 00 01 00 02 ab 03 15 00 00 00 01 00 02 ac c6 15 00 00 00 01 00 02 ad 03 15 00 00 00 01 00 02 ae ca 15 00 00 00 01 00 02 af 02 15 00 00 00 01 00 02 b0 15 15 00 00 00 01 00 02 b1 02 15 00 00 00 01 00 02 b2 15 15 00 00 00 01 00 02 b3 02 15 00 00 00 01 00 02 b4 18 15 00 00 00 01 00 02 b5 02 15 00 00 00 01 00 02 b6 1a 15 00 00 00 01 00 02 b7 02 15 00 00 00 01 00 02 b8 1d 15 00 00 00 01 00 02 b9 02 15 00 00 00 01 00 02 ba 1f 15 00 00 00 01 00 02 bb 02 15 00 00 00 01 00 02 bc 21 15 00 00 00 01 00 02 bd 02 15 00 00 00 01 00 02 be 23 15 00 00 00 01 00 02 bf 02 15 00 00 00 01 00 02 c0 25 15 00 00 00 01 00 02 c1 02 15 00 00 00 01 00 02 c2 2d 15 01 00 00 01 00 02 c3 02 15 00 00 00 01 00 02 c4 35 15 00 00 00 01 00 02 c5 02 15 00 00 00 01 00 02 c6 44 15 00 00 00 01 00 02 c7 02 15 00 00 00 01 00 02 c8 53 15 00 00 00 01 00 02 c9 02 15 00 00 00 01 00 02 ca 70 15 00 00 00 01 00 02 cb 02 15 00 00 00 01 00 02 cc 8e 15 00 00 00 01 00 02 cd 02 15 00 00 00 01 00 02 ce 8e 15 00 00 00 01 00 02 cf 02 15 00 00 00 01 00 02 d0 b3 15 00 00 00 01 00 02 d1 02 15 00 00 00 01 00 02 d2 e6 15 00 00 00 01 00 02 d3 03 15 00 00 00 01 00 02 d4 08 15 00 00 00 01 00 02 d5 03 15 00 00 00 01 00 02 d6 32 15 00 00 00 01 00 02 d7 03 15 00 00 00 01 00 02 d8 50 15 00 00 00 01 00 02 d9 03 15 00 00 00 01 00 02 da 83 15 00 00 00 01 00 02 db 03 15 00 00 00 01 00 02 dc 97 15 00 00 00 01 00 02 dd 03 15 00 00 00 01 00 02 de a7 15 00 00 00 01 00 02 df 03 15 00 00 00 01 00 02 e0 b4 15 00 00 00 01 00 02 e1 03 15 00 00 00 01 00 02 e2 bd 15 00 00 00 01 00 02 e3 03 15 00 00 00 01 00 02 e4 c2 15 00 00 00 01 00 02 e5 03 15 00 00 00 01 00 02 e6 c4 15 00 00 00 01 00 02 e7 03 15 00 00 00 01 00 02 e8 c6 15 00 00 00 01 00 02 e9 03 15 00 00 00 01 00 02 ea ca 15 00 00 00 01 00 02 fb 01 15 01 00 00 01 00 02 ff 10];
		qcom,mdss-dsi-dispparam-papermode6-command-state = "dsi_hs_mode";
		qcom,mdss-dsi-dispparam-papermode7-command = [15 00 00 00 01 00 02 ff 20 15 00 00 00 01 00 02 fb 01 15 00 00 00 01 00 02 75 00 15 00 00 00 01 00 02 76 c9 15 00 00 00 01 00 02 77 00 15 00 00 00 01 00 02 78 d6 15 00 00 00 01 00 02 79 00 15 00 00 00 01 00 02 7a ed 15 00 00 00 01 00 02 7b 00 15 00 00 00 01 00 02 7c ff 15 00 00 00 01 00 02 7d 01 15 00 00 00 01 00 02 7e 0f 15 00 00 00 01 00 02 7f 01 15 00 00 00 01 00 02 80 1e 15 00 00 00 01 00 02 81 01 15 00 00 00 01 00 02 82 2a 15 00 00 00 01 00 02 83 01 15 00 00 00 01 00 02 84 36 15 00 00 00 01 00 02 85 01 15 00 00 00 01 00 02 86 41 15 00 00 00 01 00 02 87 01 15 00 00 00 01 00 02 88 65 15 00 00 00 01 00 02 89 01 15 00 00 00 01 00 02 8a 82 15 00 00 00 01 00 02 8b 01 15 00 00 00 01 00 02 8c b2 15 00 00 00 01 00 02 8d 01 15 00 00 00 01 00 02 8e da 15 00 00 00 01 00 02 8f 02 15 00 00 00 01 00 02 90 18 15 00 00 00 01 00 02 91 02 15 00 00 00 01 00 02 92 4a 15 00 00 00 01 00 02 93 02 15 00 00 00 01 00 02 94 4a 15 00 00 00 01 00 02 95 02 15 00 00 00 01 00 02 96 78 15 00 00 00 01 00 02 97 02 15 00 00 00 01 00 02 98 ab 15 00 00 00 01 00 02 99 02 15 00 00 00 01 00 02 9a d6 15 01 00 00 01 00 02 9b 03 15 00 00 00 01 00 02 9c 03 15 00 00 00 01 00 02 9d 03 15 00 00 00 01 00 02 9e 23 15 00 00 00 01 00 02 9f 03 15 00 00 00 01 00 02 a0 4b 15 00 00 00 01 00 02 a2 03 15 00 00 00 01 00 02 a3 59 15 00 00 00 01 00 02 a4 03 15 00 00 00 01 00 02 a5 69 15 00 00 00 01 00 02 a6 03 15 00 00 00 01 00 02 a7 7e 15 00 00 00 01 00 02 a9 03 15 00 00 00 01 00 02 aa 9b 15 00 00 00 01 00 02 ab 03 15 00 00 00 01 00 02 ac b4 15 00 00 00 01 00 02 ad 03 15 00 00 00 01 00 02 ae c3 15 00 00 00 01 00 02 af 03 15 00 00 00 01 00 02 b0 c6 15 00 00 00 01 00 02 b1 03 15 00 00 00 01 00 02 b2 ca 15 00 00 00 01 00 02 b3 00 15 00 00 00 01 00 02 b4 c9 15 00 00 00 01 00 02 b5 00 15 00 00 00 01 00 02 b6 d6 15 00 00 00 01 00 02 b7 00 15 00 00 00 01 00 02 b8 ed 15 00 00 00 01 00 02 b9 00 15 00 00 00 01 00 02 ba ff 15 00 00 00 01 00 02 bb 01 15 00 00 00 01 00 02 bc 0f 15 00 00 00 01 00 02 bd 01 15 00 00 00 01 00 02 be 1e 15 00 00 00 01 00 02 bf 01 15 00 00 00 01 00 02 c0 2a 15 00 00 00 01 00 02 c1 01 15 00 00 00 01 00 02 c2 36 15 00 00 00 01 00 02 c3 01 15 00 00 00 01 00 02 c4 41 15 01 00 00 01 00 02 c5 01 15 00 00 00 01 00 02 c6 65 15 00 00 00 01 00 02 c7 01 15 00 00 00 01 00 02 c8 82 15 00 00 00 01 00 02 c9 01 15 00 00 00 01 00 02 ca b2 15 00 00 00 01 00 02 cb 01 15 00 00 00 01 00 02 cc da 15 00 00 00 01 00 02 cd 02 15 00 00 00 01 00 02 ce 18 15 00 00 00 01 00 02 cf 02 15 00 00 00 01 00 02 d0 4a 15 00 00 00 01 00 02 d1 02 15 00 00 00 01 00 02 d2 4a 15 00 00 00 01 00 02 d3 02 15 00 00 00 01 00 02 d4 78 15 00 00 00 01 00 02 d5 02 15 00 00 00 01 00 02 d6 ab 15 00 00 00 01 00 02 d7 02 15 00 00 00 01 00 02 d8 d6 15 00 00 00 01 00 02 d9 03 15 00 00 00 01 00 02 da 03 15 00 00 00 01 00 02 db 03 15 00 00 00 01 00 02 dc 23 15 00 00 00 01 00 02 dd 03 15 00 00 00 01 00 02 de 4b 15 00 00 00 01 00 02 df 03 15 00 00 00 01 00 02 e0 59 15 00 00 00 01 00 02 e1 03 15 00 00 00 01 00 02 e2 69 15 00 00 00 01 00 02 e3 03 15 00 00 00 01 00 02 e4 7e 15 00 00 00 01 00 02 e5 03 15 00 00 00 01 00 02 e6 9b 15 00 00 00 01 00 02 e7 03 15 00 00 00 01 00 02 e8 b4 15 00 00 00 01 00 02 e9 03 15 00 00 00 01 00 02 ea c3 15 00 00 00 01 00 02 eb 03 15 00 00 00 01 00 02 ec c6 15 00 00 00 01 00 02 ed 03 15 01 00 00 01 00 02 ee ca 15 00 00 00 01 00 02 ef 00 15 00 00 00 01 00 02 f0 37 15 00 00 00 01 00 02 f1 00 15 00 00 00 01 00 02 f2 73 15 00 00 00 01 00 02 f3 00 15 00 00 00 01 00 02 f4 a5 15 00 00 00 01 00 02 f5 00 15 00 00 00 01 00 02 f6 c6 15 00 00 00 01 00 02 f7 00 15 00 00 00 01 00 02 f8 df 15 00 00 00 01 00 02 f9 00 15 00 00 00 01 00 02 fa f3 15 00 00 00 01 00 02 ff 21 15 00 00 00 01 00 02 fb 01 15 00 00 00 01 00 02 00 01 15 00 00 00 01 00 02 01 05 15 00 00 00 01 00 02 02 01 15 00 00 00 01 00 02 03 14 15 00 00 00 01 00 02 04 01 15 00 00 00 01 00 02 05 22 15 00 00 00 01 00 02 06 01 15 00 00 00 01 00 02 07 4e 15 00 00 00 01 00 02 08 01 15 00 00 00 01 00 02 09 70 15 00 00 00 01 00 02 0a 01 15 00 00 00 01 00 02 0b a5 15 00 00 00 01 00 02 0c 01 15 00 00 00 01 00 02 0d d0 15 00 00 00 01 00 02 0e 02 15 00 00 00 01 00 02 0f 12 15 00 00 00 01 00 02 10 02 15 00 00 00 01 00 02 11 46 15 00 00 00 01 00 02 12 02 15 00 00 00 01 00 02 13 46 15 00 00 00 01 00 02 14 02 15 00 00 00 01 00 02 15 76 15 00 00 00 01 00 02 16 02 15 00 00 00 01 00 02 17 a9 15 00 00 00 01 00 02 18 02 15 01 00 00 01 00 02 19 d3 15 00 00 00 01 00 02 1a 03 15 00 00 00 01 00 02 1b 00 15 00 00 00 01 00 02 1c 03 15 00 00 00 01 00 02 1d 21 15 00 00 00 01 00 02 1e 03 15 00 00 00 01 00 02 1f 49 15 00 00 00 01 00 02 20 03 15 00 00 00 01 00 02 21 55 15 00 00 00 01 00 02 22 03 15 00 00 00 01 00 02 23 63 15 00 00 00 01 00 02 24 03 15 00 00 00 01 00 02 25 75 15 00 00 00 01 00 02 26 03 15 00 00 00 01 00 02 27 8e 15 00 00 00 01 00 02 28 03 15 00 00 00 01 00 02 29 ac 15 00 00 00 01 00 02 2a 03 15 00 00 00 01 00 02 2b c0 15 00 00 00 01 00 02 2d 03 15 00 00 00 01 00 02 2f c6 15 00 00 00 01 00 02 30 03 15 00 00 00 01 00 02 31 ca 15 00 00 00 01 00 02 32 00 15 00 00 00 01 00 02 33 37 15 00 00 00 01 00 02 34 00 15 00 00 00 01 00 02 35 73 15 00 00 00 01 00 02 36 00 15 00 00 00 01 00 02 37 a5 15 00 00 00 01 00 02 38 00 15 00 00 00 01 00 02 39 c6 15 00 00 00 01 00 02 3a 00 15 00 00 00 01 00 02 3b df 15 00 00 00 01 00 02 3d 00 15 00 00 00 01 00 02 3f f3 15 00 00 00 01 00 02 40 01 15 00 00 00 01 00 02 41 05 15 00 00 00 01 00 02 42 01 15 00 00 00 01 00 02 43 14 15 00 00 00 01 00 02 44 01 15 01 00 00 01 00 02 45 22 15 00 00 00 01 00 02 46 01 15 00 00 00 01 00 02 47 4e 15 00 00 00 01 00 02 48 01 15 00 00 00 01 00 02 49 70 15 00 00 00 01 00 02 4a 01 15 00 00 00 01 00 02 4b a5 15 00 00 00 01 00 02 4c 01 15 00 00 00 01 00 02 4d d0 15 00 00 00 01 00 02 4e 02 15 00 00 00 01 00 02 4f 12 15 00 00 00 01 00 02 50 02 15 00 00 00 01 00 02 51 46 15 00 00 00 01 00 02 52 02 15 00 00 00 01 00 02 53 46 15 00 00 00 01 00 02 54 02 15 00 00 00 01 00 02 55 76 15 00 00 00 01 00 02 56 02 15 00 00 00 01 00 02 58 a9 15 00 00 00 01 00 02 59 02 15 00 00 00 01 00 02 5a d3 15 00 00 00 01 00 02 5b 03 15 00 00 00 01 00 02 5c 00 15 00 00 00 01 00 02 5d 03 15 00 00 00 01 00 02 5e 21 15 00 00 00 01 00 02 5f 03 15 00 00 00 01 00 02 60 49 15 00 00 00 01 00 02 61 03 15 00 00 00 01 00 02 62 55 15 00 00 00 01 00 02 63 03 15 00 00 00 01 00 02 64 63 15 00 00 00 01 00 02 65 03 15 00 00 00 01 00 02 66 75 15 00 00 00 01 00 02 67 03 15 00 00 00 01 00 02 68 8e 15 00 00 00 01 00 02 69 03 15 00 00 00 01 00 02 6a ac 15 00 00 00 01 00 02 6b 03 15 00 00 00 01 00 02 6c c0 15 00 00 00 01 00 02 6d 03 15 01 00 00 01 00 02 6e c6 15 00 00 00 01 00 02 6f 03 15 00 00 00 01 00 02 70 ca 15 00 00 00 01 00 02 71 02 15 00 00 00 01 00 02 72 28 15 00 00 00 01 00 02 73 02 15 00 00 00 01 00 02 74 28 15 00 00 00 01 00 02 75 02 15 00 00 00 01 00 02 76 2b 15 00 00 00 01 00 02 77 02 15 00 00 00 01 00 02 78 2d 15 00 00 00 01 00 02 79 02 15 00 00 00 01 00 02 7a 2f 15 00 00 00 01 00 02 7b 02 15 00 00 00 01 00 02 7c 2f 15 00 00 00 01 00 02 7d 02 15 00 00 00 01 00 02 7e 32 15 00 00 00 01 00 02 7f 02 15 00 00 00 01 00 02 80 34 15 00 00 00 01 00 02 81 02 15 00 00 00 01 00 02 82 36 15 00 00 00 01 00 02 83 02 15 00 00 00 01 00 02 84 3d 15 00 00 00 01 00 02 85 02 15 00 00 00 01 00 02 86 44 15 00 00 00 01 00 02 87 02 15 00 00 00 01 00 02 88 52 15 00 00 00 01 00 02 89 02 15 00 00 00 01 00 02 8a 5f 15 00 00 00 01 00 02 8b 02 15 00 00 00 01 00 02 8c 7a 15 00 00 00 01 00 02 8d 02 15 00 00 00 01 00 02 8e 96 15 00 00 00 01 00 02 8f 02 15 00 00 00 01 00 02 90 96 15 00 00 00 01 00 02 91 02 15 00 00 00 01 00 02 92 bb 15 00 00 00 01 00 02 93 02 15 00 00 00 01 00 02 94 ed 15 00 00 00 01 00 02 95 03 15 01 00 00 01 00 02 96 0f 15 00 00 00 01 00 02 97 03 15 00 00 00 01 00 02 98 39 15 00 00 00 01 00 02 99 03 15 00 00 00 01 00 02 9a 53 15 00 00 00 01 00 02 9b 03 15 00 00 00 01 00 02 9c 79 15 00 00 00 01 00 02 9d 03 15 00 00 00 01 00 02 9e 87 15 00 00 00 01 00 02 9f 03 15 00 00 00 01 00 02 a0 98 15 00 00 00 01 00 02 a2 03 15 00 00 00 01 00 02 a3 a9 15 00 00 00 01 00 02 a4 03 15 00 00 00 01 00 02 a5 b7 15 00 00 00 01 00 02 a6 03 15 00 00 00 01 00 02 a7 c1 15 00 00 00 01 00 02 a9 03 15 00 00 00 01 00 02 aa c4 15 00 00 00 01 00 02 ab 03 15 00 00 00 01 00 02 ac c6 15 00 00 00 01 00 02 ad 03 15 00 00 00 01 00 02 ae ca 15 00 00 00 01 00 02 af 02 15 00 00 00 01 00 02 b0 28 15 00 00 00 01 00 02 b1 02 15 00 00 00 01 00 02 b2 28 15 00 00 00 01 00 02 b3 02 15 00 00 00 01 00 02 b4 2b 15 00 00 00 01 00 02 b5 02 15 00 00 00 01 00 02 b6 2d 15 00 00 00 01 00 02 b7 02 15 00 00 00 01 00 02 b8 2f 15 00 00 00 01 00 02 b9 02 15 00 00 00 01 00 02 ba 2f 15 00 00 00 01 00 02 bb 02 15 00 00 00 01 00 02 bc 32 15 00 00 00 01 00 02 bd 02 15 00 00 00 01 00 02 be 34 15 00 00 00 01 00 02 bf 02 15 00 00 00 01 00 02 c0 36 15 01 00 00 01 00 02 c1 02 15 00 00 00 01 00 02 c2 3d 15 00 00 00 01 00 02 c3 02 15 00 00 00 01 00 02 c4 44 15 00 00 00 01 00 02 c5 02 15 00 00 00 01 00 02 c6 52 15 00 00 00 01 00 02 c7 02 15 00 00 00 01 00 02 c8 5f 15 00 00 00 01 00 02 c9 02 15 00 00 00 01 00 02 ca 7a 15 00 00 00 01 00 02 cb 02 15 00 00 00 01 00 02 cc 96 15 00 00 00 01 00 02 cd 02 15 00 00 00 01 00 02 ce 96 15 00 00 00 01 00 02 cf 02 15 00 00 00 01 00 02 d0 bb 15 00 00 00 01 00 02 d1 02 15 00 00 00 01 00 02 d2 ed 15 00 00 00 01 00 02 d3 03 15 00 00 00 01 00 02 d4 0f 15 00 00 00 01 00 02 d5 03 15 00 00 00 01 00 02 d6 39 15 00 00 00 01 00 02 d7 03 15 00 00 00 01 00 02 d8 53 15 00 00 00 01 00 02 d9 03 15 00 00 00 01 00 02 da 79 15 00 00 00 01 00 02 db 03 15 00 00 00 01 00 02 dc 87 15 00 00 00 01 00 02 dd 03 15 00 00 00 01 00 02 de 98 15 00 00 00 01 00 02 df 03 15 00 00 00 01 00 02 e0 a9 15 00 00 00 01 00 02 e1 03 15 00 00 00 01 00 02 e2 b7 15 00 00 00 01 00 02 e3 03 15 00 00 00 01 00 02 e4 c1 15 00 00 00 01 00 02 e5 03 15 00 00 00 01 00 02 e6 c4 15 00 00 00 01 00 02 e7 03 15 00 00 00 01 00 02 e8 c6 15 00 00 00 01 00 02 e9 03 15 00 00 00 01 00 02 ea ca 15 00 00 00 01 00 02 fb 01 15 01 00 00 01 00 02 ff 10];
		qcom,mdss-dsi-dispparam-papermode7-command-state = "dsi_hs_mode";
		qcom,mdss-dsi-dispparam-papermode-command = [15 00 00 00 01 00 02 ff 20 15 00 00 00 01 00 02 fb 01 15 00 00 00 01 00 02 75 00 15 00 00 00 01 00 02 76 c9 15 00 00 00 01 00 02 77 00 15 00 00 00 01 00 02 78 d6 15 00 00 00 01 00 02 79 00 15 00 00 00 01 00 02 7a ed 15 00 00 00 01 00 02 7b 00 15 00 00 00 01 00 02 7c ff 15 00 00 00 01 00 02 7d 01 15 00 00 00 01 00 02 7e 0f 15 00 00 00 01 00 02 7f 01 15 00 00 00 01 00 02 80 1e 15 00 00 00 01 00 02 81 01 15 00 00 00 01 00 02 82 2a 15 00 00 00 01 00 02 83 01 15 00 00 00 01 00 02 84 36 15 00 00 00 01 00 02 85 01 15 00 00 00 01 00 02 86 41 15 00 00 00 01 00 02 87 01 15 00 00 00 01 00 02 88 65 15 00 00 00 01 00 02 89 01 15 00 00 00 01 00 02 8a 82 15 00 00 00 01 00 02 8b 01 15 00 00 00 01 00 02 8c b2 15 00 00 00 01 00 02 8d 01 15 00 00 00 01 00 02 8e da 15 00 00 00 01 00 02 8f 02 15 00 00 00 01 00 02 90 18 15 00 00 00 01 00 02 91 02 15 00 00 00 01 00 02 92 4a 15 00 00 00 01 00 02 93 02 15 00 00 00 01 00 02 94 4a 15 00 00 00 01 00 02 95 02 15 00 00 00 01 00 02 96 78 15 00 00 00 01 00 02 97 02 15 00 00 00 01 00 02 98 ab 15 00 00 00 01 00 02 99 02 15 01 00 00 01 00 02 9a d6 15 00 00 00 01 00 02 9b 03 15 00 00 00 01 00 02 9c 03 15 00 00 00 01 00 02 9d 03 15 00 00 00 01 00 02 9e 23 15 00 00 00 01 00 02 9f 03 15 00 00 00 01 00 02 a0 4b 15 00 00 00 01 00 02 a2 03 15 00 00 00 01 00 02 a3 59 15 00 00 00 01 00 02 a4 03 15 00 00 00 01 00 02 a5 69 15 00 00 00 01 00 02 a6 03 15 00 00 00 01 00 02 a7 7e 15 00 00 00 01 00 02 a9 03 15 00 00 00 01 00 02 aa 9b 15 00 00 00 01 00 02 ab 03 15 00 00 00 01 00 02 ac b4 15 00 00 00 01 00 02 ad 03 15 00 00 00 01 00 02 ae c3 15 00 00 00 01 00 02 af 03 15 00 00 00 01 00 02 b0 c6 15 00 00 00 01 00 02 b1 03 15 00 00 00 01 00 02 b2 ca 15 00 00 00 01 00 02 b3 00 15 00 00 00 01 00 02 b4 c9 15 00 00 00 01 00 02 b5 00 15 00 00 00 01 00 02 b6 d6 15 00 00 00 01 00 02 b7 00 15 00 00 00 01 00 02 b8 ed 15 00 00 00 01 00 02 b9 00 15 00 00 00 01 00 02 ba ff 15 00 00 00 01 00 02 bb 01 15 00 00 00 01 00 02 bc 0f 15 00 00 00 01 00 02 bd 01 15 00 00 00 01 00 02 be 1e 15 00 00 00 01 00 02 bf 01 15 00 00 00 01 00 02 c0 2a 15 00 00 00 01 00 02 c1 01 15 00 00 00 01 00 02 c2 36 15 00 00 00 01 00 02 c3 01 15 00 00 00 01 00 02 c4 41 15 01 00 00 01 00 02 c5 01 15 00 00 00 01 00 02 c6 65 15 00 00 00 01 00 02 c7 01 15 00 00 00 01 00 02 c8 82 15 00 00 00 01 00 02 c9 01 15 00 00 00 01 00 02 ca b2 15 00 00 00 01 00 02 cb 01 15 00 00 00 01 00 02 cc da 15 00 00 00 01 00 02 cd 02 15 00 00 00 01 00 02 ce 18 15 00 00 00 01 00 02 cf 02 15 00 00 00 01 00 02 d0 4a 15 00 00 00 01 00 02 d1 02 15 00 00 00 01 00 02 d2 4a 15 00 00 00 01 00 02 d3 02 15 00 00 00 01 00 02 d4 78 15 00 00 00 01 00 02 d5 02 15 00 00 00 01 00 02 d6 ab 15 00 00 00 01 00 02 d7 02 15 00 00 00 01 00 02 d8 d6 15 00 00 00 01 00 02 d9 03 15 00 00 00 01 00 02 da 03 15 00 00 00 01 00 02 db 03 15 00 00 00 01 00 02 dc 23 15 00 00 00 01 00 02 dd 03 15 00 00 00 01 00 02 de 4b 15 00 00 00 01 00 02 df 03 15 00 00 00 01 00 02 e0 59 15 00 00 00 01 00 02 e1 03 15 00 00 00 01 00 02 e2 69 15 00 00 00 01 00 02 e3 03 15 00 00 00 01 00 02 e4 7e 15 00 00 00 01 00 02 e5 03 15 00 00 00 01 00 02 e6 9b 15 00 00 00 01 00 02 e7 03 15 00 00 00 01 00 02 e8 b4 15 00 00 00 01 00 02 e9 03 15 00 00 00 01 00 02 ea c3 15 00 00 00 01 00 02 eb 03 15 00 00 00 01 00 02 ec c6 15 01 00 00 01 00 02 ed 03 15 00 00 00 01 00 02 ee ca 15 00 00 00 01 00 02 ef 00 15 00 00 00 01 00 02 f0 37 15 00 00 00 01 00 02 f1 00 15 00 00 00 01 00 02 f2 73 15 00 00 00 01 00 02 f3 00 15 00 00 00 01 00 02 f4 a5 15 00 00 00 01 00 02 f5 00 15 00 00 00 01 00 02 f6 c6 15 00 00 00 01 00 02 f7 00 15 00 00 00 01 00 02 f8 df 15 00 00 00 01 00 02 f9 00 15 00 00 00 01 00 02 fa f3 15 00 00 00 01 00 02 ff 21 15 00 00 00 01 00 02 fb 01 15 00 00 00 01 00 02 00 01 15 00 00 00 01 00 02 01 05 15 00 00 00 01 00 02 02 01 15 00 00 00 01 00 02 03 14 15 00 00 00 01 00 02 04 01 15 00 00 00 01 00 02 05 22 15 00 00 00 01 00 02 06 01 15 00 00 00 01 00 02 07 4e 15 00 00 00 01 00 02 08 01 15 00 00 00 01 00 02 09 70 15 00 00 00 01 00 02 0a 01 15 00 00 00 01 00 02 0b a5 15 00 00 00 01 00 02 0c 01 15 00 00 00 01 00 02 0d d0 15 00 00 00 01 00 02 0e 02 15 00 00 00 01 00 02 0f 12 15 00 00 00 01 00 02 10 02 15 00 00 00 01 00 02 11 46 15 00 00 00 01 00 02 12 02 15 00 00 00 01 00 02 13 46 15 00 00 00 01 00 02 14 02 15 00 00 00 01 00 02 15 76 15 00 00 00 01 00 02 16 02 15 00 00 00 01 00 02 17 a9 15 00 00 00 01 00 02 18 02 15 01 00 00 01 00 02 19 d3 15 00 00 00 01 00 02 1a 03 15 00 00 00 01 00 02 1b 00 15 00 00 00 01 00 02 1c 03 15 00 00 00 01 00 02 1d 21 15 00 00 00 01 00 02 1e 03 15 00 00 00 01 00 02 1f 49 15 00 00 00 01 00 02 20 03 15 00 00 00 01 00 02 21 55 15 00 00 00 01 00 02 22 03 15 00 00 00 01 00 02 23 63 15 00 00 00 01 00 02 24 03 15 00 00 00 01 00 02 25 75 15 00 00 00 01 00 02 26 03 15 00 00 00 01 00 02 27 8e 15 00 00 00 01 00 02 28 03 15 00 00 00 01 00 02 29 ac 15 00 00 00 01 00 02 2a 03 15 00 00 00 01 00 02 2b c0 15 00 00 00 01 00 02 2d 03 15 00 00 00 01 00 02 2f c6 15 00 00 00 01 00 02 30 03 15 00 00 00 01 00 02 31 ca 15 00 00 00 01 00 02 32 00 15 00 00 00 01 00 02 33 37 15 00 00 00 01 00 02 34 00 15 00 00 00 01 00 02 35 73 15 00 00 00 01 00 02 36 00 15 00 00 00 01 00 02 37 a5 15 00 00 00 01 00 02 38 00 15 00 00 00 01 00 02 39 c6 15 00 00 00 01 00 02 3a 00 15 00 00 00 01 00 02 3b df 15 00 00 00 01 00 02 3d 00 15 00 00 00 01 00 02 3f f3 15 00 00 00 01 00 02 40 01 15 00 00 00 01 00 02 41 05 15 00 00 00 01 00 02 42 01 15 00 00 00 01 00 02 43 14 15 00 00 00 01 00 02 44 01 15 00 00 00 01 00 02 45 22 15 01 00 00 01 00 02 46 01 15 00 00 00 01 00 02 47 4e 15 00 00 00 01 00 02 48 01 15 00 00 00 01 00 02 49 70 15 00 00 00 01 00 02 4a 01 15 00 00 00 01 00 02 4b a5 15 00 00 00 01 00 02 4c 01 15 00 00 00 01 00 02 4d d0 15 00 00 00 01 00 02 4e 02 15 00 00 00 01 00 02 4f 12 15 00 00 00 01 00 02 50 02 15 00 00 00 01 00 02 51 46 15 00 00 00 01 00 02 52 02 15 00 00 00 01 00 02 53 46 15 00 00 00 01 00 02 54 02 15 00 00 00 01 00 02 55 76 15 00 00 00 01 00 02 56 02 15 00 00 00 01 00 02 58 a9 15 00 00 00 01 00 02 59 02 15 00 00 00 01 00 02 5a d3 15 00 00 00 01 00 02 5b 03 15 00 00 00 01 00 02 5c 00 15 00 00 00 01 00 02 5d 03 15 00 00 00 01 00 02 5e 21 15 00 00 00 01 00 02 5f 03 15 00 00 00 01 00 02 60 49 15 00 00 00 01 00 02 61 03 15 00 00 00 01 00 02 62 55 15 00 00 00 01 00 02 63 03 15 00 00 00 01 00 02 64 63 15 00 00 00 01 00 02 65 03 15 00 00 00 01 00 02 66 75 15 00 00 00 01 00 02 67 03 15 00 00 00 01 00 02 68 8e 15 00 00 00 01 00 02 69 03 15 00 00 00 01 00 02 6a ac 15 00 00 00 01 00 02 6b 03 15 00 00 00 01 00 02 6c c0 15 00 00 00 01 00 02 6d 03 15 00 00 00 01 00 02 6e c6 15 01 00 00 01 00 02 6f 03 15 00 00 00 01 00 02 70 ca 15 00 00 00 01 00 02 71 02 15 00 00 00 01 00 02 72 3a 15 00 00 00 01 00 02 73 02 15 00 00 00 01 00 02 74 3b 15 00 00 00 01 00 02 75 02 15 00 00 00 01 00 02 76 3c 15 00 00 00 01 00 02 77 02 15 00 00 00 01 00 02 78 3e 15 00 00 00 01 00 02 79 02 15 00 00 00 01 00 02 7a 40 15 00 00 00 01 00 02 7b 02 15 00 00 00 01 00 02 7c 40 15 00 00 00 01 00 02 7d 02 15 00 00 00 01 00 02 7e 43 15 00 00 00 01 00 02 7f 02 15 00 00 00 01 00 02 80 43 15 00 00 00 01 00 02 81 02 15 00 00 00 01 00 02 82 46 15 00 00 00 01 00 02 83 02 15 00 00 00 01 00 02 84 4c 15 00 00 00 01 00 02 85 02 15 00 00 00 01 00 02 86 53 15 00 00 00 01 00 02 87 02 15 00 00 00 01 00 02 88 5f 15 00 00 00 01 00 02 89 02 15 00 00 00 01 00 02 8a 6b 15 00 00 00 01 00 02 8b 02 15 00 00 00 01 00 02 8c 84 15 00 00 00 01 00 02 8d 02 15 00 00 00 01 00 02 8e 9f 15 00 00 00 01 00 02 8f 02 15 00 00 00 01 00 02 90 9f 15 00 00 00 01 00 02 91 02 15 00 00 00 01 00 02 92 c7 15 00 00 00 01 00 02 93 02 15 00 00 00 01 00 02 94 f7 15 00 00 00 01 00 02 95 03 15 00 00 00 01 00 02 96 18 15 00 00 00 01 00 02 97 03 15 00 00 00 01 00 02 98 40 15 01 00 00 01 00 02 99 03 15 00 00 00 01 00 02 9a 5c 15 00 00 00 01 00 02 9b 03 15 00 00 00 01 00 02 9c 8a 15 00 00 00 01 00 02 9d 03 15 00 00 00 01 00 02 9e 9a 15 00 00 00 01 00 02 9f 03 15 00 00 00 01 00 02 a0 a9 15 00 00 00 01 00 02 a2 03 15 00 00 00 01 00 02 a3 b5 15 00 00 00 01 00 02 a4 03 15 00 00 00 01 00 02 a5 be 15 00 00 00 01 00 02 a6 03 15 00 00 00 01 00 02 a7 c2 15 00 00 00 01 00 02 a9 03 15 00 00 00 01 00 02 aa c4 15 00 00 00 01 00 02 ab 03 15 00 00 00 01 00 02 ac c6 15 00 00 00 01 00 02 ad 03 15 00 00 00 01 00 02 ae ca 15 00 00 00 01 00 02 af 02 15 00 00 00 01 00 02 b0 3a 15 00 00 00 01 00 02 b1 02 15 00 00 00 01 00 02 b2 3b 15 00 00 00 01 00 02 b3 02 15 00 00 00 01 00 02 b4 3c 15 00 00 00 01 00 02 b5 02 15 00 00 00 01 00 02 b6 3e 15 00 00 00 01 00 02 b7 02 15 00 00 00 01 00 02 b8 40 15 00 00 00 01 00 02 b9 02 15 00 00 00 01 00 02 ba 40 15 00 00 00 01 00 02 bb 02 15 00 00 00 01 00 02 bc 43 15 00 00 00 01 00 02 bd 02 15 00 00 00 01 00 02 be 43 15 00 00 00 01 00 02 bf 02 15 00 00 00 01 00 02 c0 46 15 00 00 00 01 00 02 c1 02 15 00 00 00 01 00 02 c2 4c 15 00 00 00 01 00 02 c3 02 15 01 00 00 01 00 02 c4 53 15 00 00 00 01 00 02 c5 02 15 00 00 00 01 00 02 c6 5f 15 00 00 00 01 00 02 c7 02 15 00 00 00 01 00 02 c8 6b 15 00 00 00 01 00 02 c9 02 15 00 00 00 01 00 02 ca 84 15 00 00 00 01 00 02 cb 02 15 00 00 00 01 00 02 cc 9f 15 00 00 00 01 00 02 cd 02 15 00 00 00 01 00 02 ce 9f 15 00 00 00 01 00 02 cf 02 15 00 00 00 01 00 02 d0 c7 15 00 00 00 01 00 02 d1 02 15 00 00 00 01 00 02 d2 f7 15 00 00 00 01 00 02 d3 03 15 00 00 00 01 00 02 d4 18 15 00 00 00 01 00 02 d5 03 15 00 00 00 01 00 02 d6 40 15 00 00 00 01 00 02 d7 03 15 00 00 00 01 00 02 d8 5c 15 00 00 00 01 00 02 d9 03 15 00 00 00 01 00 02 da 8a 15 00 00 00 01 00 02 db 03 15 00 00 00 01 00 02 dc 9a 15 00 00 00 01 00 02 dd 03 15 00 00 00 01 00 02 de a9 15 00 00 00 01 00 02 df 03 15 00 00 00 01 00 02 e0 b5 15 00 00 00 01 00 02 e1 03 15 00 00 00 01 00 02 e2 be 15 00 00 00 01 00 02 e3 03 15 00 00 00 01 00 02 e4 c2 15 00 00 00 01 00 02 e5 03 15 00 00 00 01 00 02 e6 c4 15 00 00 00 01 00 02 e7 03 15 00 00 00 01 00 02 e8 c6 15 00 00 00 01 00 02 e9 03 15 00 00 00 01 00 02 ea ca 15 00 00 00 01 00 02 fb 01 15 01 00 00 01 00 02 ff 10];
		qcom,mdss-dsi-dispparam-papermode-command-state = "dsi_hs_mode";
	};
};

