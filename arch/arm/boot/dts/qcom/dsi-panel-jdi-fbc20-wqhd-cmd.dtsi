/* Copyright (c) 2013-2014, The Linux Foundation. All rights reserved.
 * Copyright (C) 2016 XiaoMi, Inc.
 *
 * This program is free software; you can redistribute it and/or modify
 * it under the terms of the GNU General Public License version 2 and
 * only version 2 as published by the Free Software Foundation.
 *
 * This program is distributed in the hope that it will be useful,
 * but WITHOUT ANY WARRANTY; without even the implied warranty of
 * MERCHANTABILITY or FITNESS FOR A PARTICULAR PURPOSE.  See the
 * GNU General Public License for more details.
 */

/*---------------------------------------------------------------------------
 * This file is autogenerated file using gcdb parser. Please do not edit it.
 * Update input XML file to add a new entry or update variable in this file
 * VERSION = "1.0"
 *---------------------------------------------------------------------------*/
&mdss_mdp {
	dsi_jdi_fbc20_wqhd_cmd: qcom,mdss_dsi_jdi_fbc20_wqhd_command {
		qcom,mdss-dsi-panel-name = "jdi fbc20 wqhd cmd mode dsi panel";
		qcom,mdss-dsi-panel-id = <2>;
		qcom,mdss-dsi-panel-controller = <&mdss_dsi0>;
		qcom,mdss-dsi-panel-type = "dsi_cmd_mode";
		qcom,mdss-dsi-panel-destination = "display_1";
		qcom,mdss-dsi-panel-framerate = <60>;

		qcom,mdss-dsi-virtual-channel-id = <0>;
		qcom,mdss-dsi-stream = <0>;
		qcom,mdss-dsi-panel-width = <1440>;
		qcom,mdss-dsi-panel-height = <2560>;
		qcom,mdss-dsi-h-front-porch = <183>;
		qcom,mdss-dsi-h-back-porch = <190>;
		qcom,mdss-dsi-h-pulse-width = <12>;
		qcom,mdss-dsi-h-sync-skew = <0>;
		qcom,mdss-dsi-v-back-porch = <5>;
		qcom,mdss-dsi-v-front-porch = <8>;
		qcom,mdss-dsi-v-pulse-width = <1>;
		qcom,mdss-dsi-h-left-border = <0>;
		qcom,mdss-dsi-h-right-border = <0>;
		qcom,mdss-dsi-v-top-border = <0>;
		qcom,mdss-dsi-v-bottom-border = <0>;
		qcom,mdss-dsi-bpp = <24>;
		qcom,mdss-dsi-underflow-color = <0xff>;
		qcom,mdss-dsi-border-color = <0>;
		qcom,mdss-dsi-on-command = [
			15 01 00 00 00 00 02 ff 28
			15 01 00 00 00 00 02 fb 01
			15 00 00 00 00 00 02 f2 04
			15 00 00 00 00 00 02 f5 84
			15 00 00 00 00 00 02 f6 83
			15 00 00 00 00 00 02 f7 bb
			15 01 00 00 00 00 02 f8 6b

			15 00 00 00 01 00 02 FF 20
			15 00 00 00 01 00 02 FB 01
			15 00 00 00 01 00 02 75 00
			15 00 00 00 01 00 02 76 00
			15 00 00 00 01 00 02 77 00
			15 00 00 00 01 00 02 78 20
			15 00 00 00 01 00 02 79 00
			15 00 00 00 01 00 02 7A 58
			15 00 00 00 01 00 02 7B 00
			15 00 00 00 01 00 02 7C 81
			15 00 00 00 01 00 02 7D 00
			15 00 00 00 01 00 02 7E 9F
			15 00 00 00 01 00 02 7F 00
			15 00 00 00 01 00 02 80 BA
			15 00 00 00 01 00 02 81 00
			15 00 00 00 01 00 02 82 D2
			15 00 00 00 01 00 02 83 00
			15 00 00 00 01 00 02 84 E8
			15 00 00 00 01 00 02 85 00
			15 00 00 00 01 00 02 86 FA
			15 00 00 00 01 00 02 87 01
			15 00 00 00 01 00 02 88 33
			15 00 00 00 01 00 02 89 01
			15 00 00 00 01 00 02 8A 5F
			15 00 00 00 01 00 02 8B 01
			15 00 00 00 01 00 02 8C 9F
			15 00 00 00 01 00 02 8D 01
			15 00 00 00 01 00 02 8E CF
			15 00 00 00 01 00 02 8F 02
			15 00 00 00 01 00 02 90 15
			15 00 00 00 01 00 02 91 02
			15 00 00 00 01 00 02 92 4F
			15 00 00 00 01 00 02 93 02
			15 00 00 00 01 00 02 94 51
			15 00 00 00 01 00 02 95 02
			15 00 00 00 01 00 02 96 84
			15 00 00 00 01 00 02 97 02
			15 00 00 00 01 00 02 98 BD
			15 00 00 00 01 00 02 99 02
			15 00 00 00 01 00 02 9A E0
			15 00 00 00 01 00 02 9B 03
			15 00 00 00 01 00 02 9C 10
			15 00 00 00 01 00 02 9D 03
			15 00 00 00 01 00 02 9E 36
			15 00 00 00 01 00 02 9F 03
			15 00 00 00 01 00 02 A0 67
			15 00 00 00 01 00 02 A2 03
			15 00 00 00 01 00 02 A3 76
			15 00 00 00 01 00 02 A4 03
			15 00 00 00 01 00 02 A5 86
			15 00 00 00 01 00 02 A6 03
			15 00 00 00 01 00 02 A7 98
			15 00 00 00 01 00 02 A9 03
			15 00 00 00 01 00 02 AA AC
			15 00 00 00 01 00 02 AB 03
			15 00 00 00 01 00 02 AC C1
			15 00 00 00 01 00 02 AD 03
			15 00 00 00 01 00 02 AE D8
			15 00 00 00 01 00 02 AF 03
			15 00 00 00 01 00 02 B0 F2
			15 00 00 00 01 00 02 B1 03
			15 00 00 00 01 00 02 B2 FF
			15 00 00 00 01 00 02 B3 00
			15 00 00 00 01 00 02 B4 00
			15 00 00 00 01 00 02 B5 00
			15 00 00 00 01 00 02 B6 20
			15 00 00 00 01 00 02 B7 00
			15 00 00 00 01 00 02 B8 58
			15 00 00 00 01 00 02 B9 00
			15 00 00 00 01 00 02 BA 81
			15 00 00 00 01 00 02 BB 00
			15 00 00 00 01 00 02 BC 9F
			15 00 00 00 01 00 02 BD 00
			15 00 00 00 01 00 02 BE BA
			15 00 00 00 01 00 02 BF 00
			15 00 00 00 01 00 02 C0 D2
			15 00 00 00 01 00 02 C1 00
			15 00 00 00 01 00 02 C2 E8
			15 00 00 00 01 00 02 C3 00
			15 00 00 00 01 00 02 C4 FA
			15 00 00 00 01 00 02 C5 01
			15 00 00 00 01 00 02 C6 33
			15 00 00 00 01 00 02 C7 01
			15 00 00 00 01 00 02 C8 5F
			15 00 00 00 01 00 02 C9 01
			15 00 00 00 01 00 02 CA 9F
			15 00 00 00 01 00 02 CB 01
			15 00 00 00 01 00 02 CC CF
			15 00 00 00 01 00 02 CD 02
			15 00 00 00 01 00 02 CE 15
			15 00 00 00 01 00 02 CF 02
			15 00 00 00 01 00 02 D0 4F
			15 00 00 00 01 00 02 D1 02
			15 00 00 00 01 00 02 D2 51
			15 00 00 00 01 00 02 D3 02
			15 00 00 00 01 00 02 D4 84
			15 00 00 00 01 00 02 D5 02
			15 00 00 00 01 00 02 D6 BD
			15 00 00 00 01 00 02 D7 02
			15 00 00 00 01 00 02 D8 E0
			15 00 00 00 01 00 02 D9 03
			15 00 00 00 01 00 02 DA 10
			15 00 00 00 01 00 02 DB 03
			15 00 00 00 01 00 02 DC 36
			15 00 00 00 01 00 02 DD 03
			15 00 00 00 01 00 02 DE 67
			15 00 00 00 01 00 02 DF 03
			15 00 00 00 01 00 02 E0 76
			15 00 00 00 01 00 02 E1 03
			15 00 00 00 01 00 02 E2 86
			15 00 00 00 01 00 02 E3 03
			15 00 00 00 01 00 02 E4 98
			15 00 00 00 01 00 02 E5 03
			15 00 00 00 01 00 02 E6 AC
			15 00 00 00 01 00 02 E7 03
			15 00 00 00 01 00 02 E8 C1
			15 00 00 00 01 00 02 E9 03
			15 00 00 00 01 00 02 EA D8
			15 00 00 00 01 00 02 EB 03
			15 00 00 00 01 00 02 EC F2
			15 00 00 00 01 00 02 ED 03
			15 00 00 00 01 00 02 EE FF
			15 00 00 00 01 00 02 EF 00
			15 00 00 00 01 00 02 F0 E0
			15 00 00 00 01 00 02 F1 00
			15 00 00 00 01 00 02 F2 E9
			15 00 00 00 01 00 02 F3 00
			15 00 00 00 01 00 02 F4 FB
			15 00 00 00 01 00 02 F5 01
			15 00 00 00 01 00 02 F6 0B
			15 00 00 00 01 00 02 F7 01
			15 00 00 00 01 00 02 F8 1A
			15 00 00 00 01 00 02 F9 01
			15 01 00 00 01 00 02 FA 27
			15 00 00 00 01 00 02 FF 21
			15 00 00 00 01 00 02 FB 01
			15 00 00 00 01 00 02 00 01
			15 00 00 00 01 00 02 01 33
			15 00 00 00 01 00 02 02 01
			15 00 00 00 01 00 02 03 3F
			15 00 00 00 01 00 02 04 01
			15 00 00 00 01 00 02 05 4A
			15 00 00 00 01 00 02 06 01
			15 00 00 00 01 00 02 07 71
			15 00 00 00 01 00 02 08 01
			15 00 00 00 01 00 02 09 8F
			15 00 00 00 01 00 02 0A 01
			15 00 00 00 01 00 02 0B C1
			15 00 00 00 01 00 02 0C 01
			15 00 00 00 01 00 02 0D E9
			15 00 00 00 01 00 02 0E 02
			15 00 00 00 01 00 02 0F 26
			15 00 00 00 01 00 02 10 02
			15 00 00 00 01 00 02 11 5A
			15 00 00 00 01 00 02 12 02
			15 00 00 00 01 00 02 13 5C
			15 00 00 00 01 00 02 14 02
			15 00 00 00 01 00 02 15 8E
			15 00 00 00 01 00 02 16 02
			15 00 00 00 01 00 02 17 C5
			15 00 00 00 01 00 02 18 02
			15 00 00 00 01 00 02 19 E8
			15 00 00 00 01 00 02 1A 03
			15 00 00 00 01 00 02 1B 17
			15 00 00 00 01 00 02 1C 03
			15 00 00 00 01 00 02 1D 39
			15 00 00 00 01 00 02 1E 03
			15 00 00 00 01 00 02 1F 67
			15 00 00 00 01 00 02 20 03
			15 00 00 00 01 00 02 21 76
			15 00 00 00 01 00 02 22 03
			15 00 00 00 01 00 02 23 86
			15 00 00 00 01 00 02 24 03
			15 00 00 00 01 00 02 25 98
			15 00 00 00 01 00 02 26 03
			15 00 00 00 01 00 02 27 AB
			15 00 00 00 01 00 02 28 03
			15 00 00 00 01 00 02 29 C0
			15 00 00 00 01 00 02 2A 03
			15 00 00 00 01 00 02 2B D8
			15 00 00 00 01 00 02 2D 03
			15 00 00 00 01 00 02 2F F2
			15 00 00 00 01 00 02 30 03
			15 00 00 00 01 00 02 31 FF
			15 00 00 00 01 00 02 32 00
			15 00 00 00 01 00 02 33 E0
			15 00 00 00 01 00 02 34 00
			15 00 00 00 01 00 02 35 E9
			15 00 00 00 01 00 02 36 00
			15 00 00 00 01 00 02 37 FB
			15 00 00 00 01 00 02 38 01
			15 00 00 00 01 00 02 39 0B
			15 00 00 00 01 00 02 3A 01
			15 00 00 00 01 00 02 3B 1A
			15 00 00 00 01 00 02 3D 01
			15 00 00 00 01 00 02 3F 27
			15 00 00 00 01 00 02 40 01
			15 00 00 00 01 00 02 41 33
			15 00 00 00 01 00 02 42 01
			15 00 00 00 01 00 02 43 3F
			15 00 00 00 01 00 02 44 01
			15 00 00 00 01 00 02 45 4A
			15 00 00 00 01 00 02 46 01
			15 00 00 00 01 00 02 47 71
			15 00 00 00 01 00 02 48 01
			15 00 00 00 01 00 02 49 8F
			15 00 00 00 01 00 02 4A 01
			15 00 00 00 01 00 02 4B C1
			15 00 00 00 01 00 02 4C 01
			15 00 00 00 01 00 02 4D E9
			15 00 00 00 01 00 02 4E 02
			15 00 00 00 01 00 02 4F 26
			15 00 00 00 01 00 02 50 02
			15 00 00 00 01 00 02 51 5A
			15 00 00 00 01 00 02 52 02
			15 00 00 00 01 00 02 53 5C
			15 00 00 00 01 00 02 54 02
			15 00 00 00 01 00 02 55 8E
			15 00 00 00 01 00 02 56 02
			15 00 00 00 01 00 02 58 C5
			15 00 00 00 01 00 02 59 02
			15 00 00 00 01 00 02 5A E8
			15 00 00 00 01 00 02 5B 03
			15 00 00 00 01 00 02 5C 17
			15 00 00 00 01 00 02 5D 03
			15 00 00 00 01 00 02 5E 39
			15 00 00 00 01 00 02 5F 03
			15 00 00 00 01 00 02 60 67
			15 00 00 00 01 00 02 61 03
			15 00 00 00 01 00 02 62 76
			15 00 00 00 01 00 02 63 03
			15 00 00 00 01 00 02 64 86
			15 00 00 00 01 00 02 65 03
			15 00 00 00 01 00 02 66 98
			15 00 00 00 01 00 02 67 03
			15 00 00 00 01 00 02 68 AB
			15 00 00 00 01 00 02 69 03
			15 00 00 00 01 00 02 6A C0
			15 00 00 00 01 00 02 6B 03
			15 00 00 00 01 00 02 6C D8
			15 00 00 00 01 00 02 6D 03
			15 00 00 00 01 00 02 6E F2
			15 00 00 00 01 00 02 6F 03
			15 00 00 00 01 00 02 70 FF
			15 00 00 00 01 00 02 71 00
			15 00 00 00 01 00 02 72 00
			15 00 00 00 01 00 02 73 00
			15 00 00 00 01 00 02 74 2F
			15 00 00 00 01 00 02 75 00
			15 00 00 00 01 00 02 76 7E
			15 00 00 00 01 00 02 77 00
			15 00 00 00 01 00 02 78 AD
			15 00 00 00 01 00 02 79 00
			15 00 00 00 01 00 02 7A C7
			15 00 00 00 01 00 02 7B 00
			15 00 00 00 01 00 02 7C E0
			15 00 00 00 01 00 02 7D 00
			15 00 00 00 01 00 02 7E F7
			15 00 00 00 01 00 02 7F 01
			15 00 00 00 01 00 02 80 09
			15 00 00 00 01 00 02 81 01
			15 00 00 00 01 00 02 82 19
			15 00 00 00 01 00 02 83 01
			15 00 00 00 01 00 02 84 4F
			15 00 00 00 01 00 02 85 01
			15 00 00 00 01 00 02 86 76
			15 00 00 00 01 00 02 87 01
			15 00 00 00 01 00 02 88 B2
			15 00 00 00 01 00 02 89 01
			15 00 00 00 01 00 02 8A DE
			15 00 00 00 01 00 02 8B 02
			15 00 00 00 01 00 02 8C 20
			15 00 00 00 01 00 02 8D 02
			15 00 00 00 01 00 02 8E 56
			15 00 00 00 01 00 02 8F 02
			15 00 00 00 01 00 02 90 58
			15 00 00 00 01 00 02 91 02
			15 00 00 00 01 00 02 92 8B
			15 00 00 00 01 00 02 93 02
			15 00 00 00 01 00 02 94 C2
			15 00 00 00 01 00 02 95 02
			15 00 00 00 01 00 02 96 E6
			15 00 00 00 01 00 02 97 03
			15 00 00 00 01 00 02 98 15
			15 00 00 00 01 00 02 99 03
			15 00 00 00 01 00 02 9A 35
			15 00 00 00 01 00 02 9B 03
			15 00 00 00 01 00 02 9C 64
			15 00 00 00 01 00 02 9D 03
			15 00 00 00 01 00 02 9E 73
			15 00 00 00 01 00 02 9F 03
			15 00 00 00 01 00 02 A0 83
			15 00 00 00 01 00 02 A2 03
			15 00 00 00 01 00 02 A3 95
			15 00 00 00 01 00 02 A4 03
			15 00 00 00 01 00 02 A5 A9
			15 00 00 00 01 00 02 A6 03
			15 00 00 00 01 00 02 A7 BF
			15 00 00 00 01 00 02 A9 03
			15 00 00 00 01 00 02 AA D7
			15 00 00 00 01 00 02 AB 03
			15 00 00 00 01 00 02 AC F1
			15 00 00 00 01 00 02 AD 03
			15 00 00 00 01 00 02 AE FF
			15 00 00 00 01 00 02 AF 00
			15 00 00 00 01 00 02 B0 00
			15 00 00 00 01 00 02 B1 00
			15 00 00 00 01 00 02 B2 2F
			15 00 00 00 01 00 02 B3 00
			15 00 00 00 01 00 02 B4 7E
			15 00 00 00 01 00 02 B5 00
			15 00 00 00 01 00 02 B6 AD
			15 00 00 00 01 00 02 B7 00
			15 00 00 00 01 00 02 B8 C7
			15 00 00 00 01 00 02 B9 00
			15 00 00 00 01 00 02 BA E0
			15 00 00 00 01 00 02 BB 00
			15 00 00 00 01 00 02 BC F7
			15 00 00 00 01 00 02 BD 01
			15 00 00 00 01 00 02 BE 09
			15 00 00 00 01 00 02 BF 01
			15 00 00 00 01 00 02 C0 19
			15 00 00 00 01 00 02 C1 01
			15 00 00 00 01 00 02 C2 4F
			15 00 00 00 01 00 02 C3 01
			15 00 00 00 01 00 02 C4 76
			15 00 00 00 01 00 02 C5 01
			15 00 00 00 01 00 02 C6 B2
			15 00 00 00 01 00 02 C7 01
			15 00 00 00 01 00 02 C8 DE
			15 00 00 00 01 00 02 C9 02
			15 00 00 00 01 00 02 CA 20
			15 00 00 00 01 00 02 CB 02
			15 00 00 00 01 00 02 CC 56
			15 00 00 00 01 00 02 CD 02
			15 00 00 00 01 00 02 CE 58
			15 00 00 00 01 00 02 CF 02
			15 00 00 00 01 00 02 D0 8B
			15 00 00 00 01 00 02 D1 02
			15 00 00 00 01 00 02 D2 C2
			15 00 00 00 01 00 02 D3 02
			15 00 00 00 01 00 02 D4 E6
			15 00 00 00 01 00 02 D5 03
			15 00 00 00 01 00 02 D6 15
			15 00 00 00 01 00 02 D7 03
			15 00 00 00 01 00 02 D8 35
			15 00 00 00 01 00 02 D9 03
			15 00 00 00 01 00 02 DA 64
			15 00 00 00 01 00 02 DB 03
			15 00 00 00 01 00 02 DC 73
			15 00 00 00 01 00 02 DD 03
			15 00 00 00 01 00 02 DE 83
			15 00 00 00 01 00 02 DF 03
			15 00 00 00 01 00 02 E0 95
			15 00 00 00 01 00 02 E1 03
			15 00 00 00 01 00 02 E2 A9
			15 00 00 00 01 00 02 E3 03
			15 00 00 00 01 00 02 E4 BF
			15 00 00 00 01 00 02 E5 03
			15 00 00 00 01 00 02 E6 D7
			15 00 00 00 01 00 02 E7 03
			15 00 00 00 01 00 02 E8 F1
			15 00 00 00 01 00 02 E9 03
			15 01 00 00 01 00 02 EA FF

			15 00 00 00 00 00 02 ff 23
			15 00 00 00 00 00 02 fb 01
			15 00 00 00 00 00 02 05 24

			15 00 00 00 00 00 02 ff 10
			15 00 00 00 00 00 02 51 ff
			15 00 00 00 00 00 02 53 2c
			15 00 00 00 00 00 02 55 00
			15 00 00 00 00 00 02 35 00
			39 00 00 00 00 00 03 44 09 d9
			15 00 00 00 00 00 02 bb 10
			15 00 00 00 00 00 02 c0 01
			05 01 00 00 78 00 02 11 00
			05 01 00 00 14 00 02 29 00
			];

		qcom,mdss-dsi-on-commandasdf = [
			15 01 00 00 00 00 02 ff 24
			15 01 00 00 00 00 02 ec 01
			];
		qcom,mdss-dsi-off-command = [
			05 01 00 00 02 00 02 28 00
			05 01 00 00 79 00 02 10 00
			];
		qcom,mdss-dsi-on-command-state = "dsi_lp_mode";
		qcom,mdss-dsi-off-command-state = "dsi_hs_mode";
		qcom,mdss-dsi-h-sync-pulse = <0>;
		qcom,mdss-dsi-traffic-mode = "burst_mode";
		qcom,mdss-dsi-bllp-eof-power-mode;
		qcom,mdss-dsi-bllp-power-mode;
		qcom,mdss-dsi-lane-0-state;
		qcom,mdss-dsi-lane-1-state;
		qcom,mdss-dsi-lane-2-state;
		qcom,mdss-dsi-lane-3-state;
		qcom,mdss-dsi-panel-timings = [dc 49 34 00 a7 a2 36 4d 41 03 04 00];
		qcom,mdss-dsi-t-clk-post = <0x19>;
		qcom,mdss-dsi-t-clk-pre = <0x35>;
		qcom,mdss-dsi-bl-min-level = <1>;
		qcom,mdss-dsi-bl-max-level = <4095>;
		qcom,mdss-dsi-dma-trigger = "trigger_sw";
		qcom,mdss-dsi-mdp-trigger = "none";
		qcom,mdss-dsi-bl-pmic-control-type = "bl_ctrl_wled";
		qcom,mdss-dsi-reset-sequence = <1 10>, <0 10>, <1 10>;
		qcom,mdss-pan-physical-width-dimension = <71>;
		qcom,mdss-pan-physical-height-dimension = <126>;

		qcom,mdss-dsi-te-pin-select = <1>;
		qcom,mdss-dsi-wr-mem-start = <0x2c>;
		qcom,mdss-dsi-wr-mem-continue = <0x3c>;
		qcom,mdss-dsi-te-dcs-command = <1>;
		qcom,mdss-dsi-te-check-enable;
		qcom,mdss-dsi-te-using-te-pin;

		qcom,mdss-dsi-fbc-enable;
		qcom,mdss-dsi-fbc-ver2-mode;
		qcom,mdss-dsi-fbc-bpp = <8>;
		qcom,mdss-dsi-fbc-packing = <1>;
		qcom,mdss-dsi-fbc-2d-pred-mode;
		qcom,mdss-dsi-fbc-slice-height = <4>;
		qcom,mdss-dsi-fbc-quant-error;
		qcom,mdss-dsi-fbc-bias = <2>;
		qcom,mdss-dsi-fbc-vlc-mode;
		qcom,mdss-dsi-fbc-bflc-mode;
		qcom,mdss-dsi-fbc-lossy-mode-idx = <3>;
		qcom,mdss-dsi-fbc-pat-mode;
		qcom,mdss-dsi-fbc-budget-ctrl = <5>;
		qcom,mdss-dsi-fbc-block-budget = <59>;
		qcom,mdss-dsi-fbc-h-line-budget = <900>;
		qcom,mdss-dsi-fbc-lossless-threshold = <0x200>;
		qcom,mdss-dsi-fbc-lossy-threshold = <192>;
		qcom,mdss-dsi-fbc-rgb-threshold = <4>;
		qcom,mdss-dsi-fbc-max-pred-err = <2>;
		qcom,dispparam-enabled;
		qcom,mdss-dsi-dispparam-warm-command = [15 00 00 00 01 00 02 ff 20 15 00 00 00 01 00 02 fb 01 15 00 00 00 01 00 02 75 00 15 00 00 00 01 00 02 76 00 15 00 00 00 01 00 02 77 00 15 00 00 00 01 00 02 78 20 15 00 00 00 01 00 02 79 00 15 00 00 00 01 00 02 7a 58 15 00 00 00 01 00 02 7b 00 15 00 00 00 01 00 02 7c 81 15 00 00 00 01 00 02 7d 00 15 00 00 00 01 00 02 7e 9f 15 00 00 00 01 00 02 7f 00 15 00 00 00 01 00 02 80 ba 15 00 00 00 01 00 02 81 00 15 00 00 00 01 00 02 82 d2 15 00 00 00 01 00 02 83 00 15 00 00 00 01 00 02 84 e8 15 00 00 00 01 00 02 85 00 15 00 00 00 01 00 02 86 fa 15 00 00 00 01 00 02 87 01 15 00 00 00 01 00 02 88 33 15 00 00 00 01 00 02 89 01 15 00 00 00 01 00 02 8a 5f 15 00 00 00 01 00 02 8b 01 15 00 00 00 01 00 02 8c 9f 15 00 00 00 01 00 02 8d 01 15 00 00 00 01 00 02 8e cf 15 00 00 00 01 00 02 8f 02 15 00 00 00 01 00 02 90 15 15 00 00 00 01 00 02 91 02 15 00 00 00 01 00 02 92 4f 15 00 00 00 01 00 02 93 02 15 00 00 00 01 00 02 94 51 15 00 00 00 01 00 02 95 02 15 00 00 00 01 00 02 96 84 15 00 00 00 01 00 02 97 02 15 00 00 00 01 00 02 98 be 15 00 00 00 01 00 02 99 02 15 00 00 00 01 00 02 9a e2 15 00 00 00 01 00 02 9b 03 15 00 00 00 01 00 02 9c 11 15 00 00 00 01 00 02 9d 03 15 00 00 00 01 00 02 9e 36 15 00 00 00 01 00 02 9f 03 15 00 00 00 01 00 02 a0 67 15 00 00 00 01 00 02 a2 03 15 00 00 00 01 00 02 a3 76 15 00 00 00 01 00 02 a4 03 15 00 00 00 01 00 02 a5 86 15 00 00 00 01 00 02 a6 03 15 00 00 00 01 00 02 a7 98 15 00 00 00 01 00 02 a9 03 15 00 00 00 01 00 02 aa ac 15 00 00 00 01 00 02 ab 03 15 00 00 00 01 00 02 ac c1 15 00 00 00 01 00 02 ad 03 15 00 00 00 01 00 02 ae d8 15 00 00 00 01 00 02 af 03 15 00 00 00 01 00 02 b0 f2 15 00 00 00 01 00 02 b1 03 15 00 00 00 01 00 02 b2 ff 15 00 00 00 01 00 02 b3 00 15 00 00 00 01 00 02 b4 00 15 00 00 00 01 00 02 b5 00 15 00 00 00 01 00 02 b6 20 15 00 00 00 01 00 02 b7 00 15 00 00 00 01 00 02 b8 58 15 00 00 00 01 00 02 b9 00 15 00 00 00 01 00 02 ba 81 15 00 00 00 01 00 02 bb 00 15 00 00 00 01 00 02 bc 9f 15 00 00 00 01 00 02 bd 00 15 00 00 00 01 00 02 be ba 15 00 00 00 01 00 02 bf 00 15 00 00 00 01 00 02 c0 d2 15 00 00 00 01 00 02 c1 00 15 00 00 00 01 00 02 c2 e8 15 00 00 00 01 00 02 c3 00 15 00 00 00 01 00 02 c4 fa 15 00 00 00 01 00 02 c5 01 15 00 00 00 01 00 02 c6 33 15 00 00 00 01 00 02 c7 01 15 00 00 00 01 00 02 c8 5f 15 00 00 00 01 00 02 c9 01 15 00 00 00 01 00 02 ca 9f 15 00 00 00 01 00 02 cb 01 15 00 00 00 01 00 02 cc cf 15 00 00 00 01 00 02 cd 02 15 00 00 00 01 00 02 ce 15 15 00 00 00 01 00 02 cf 02 15 00 00 00 01 00 02 d0 4f 15 00 00 00 01 00 02 d1 02 15 00 00 00 01 00 02 d2 51 15 00 00 00 01 00 02 d3 02 15 00 00 00 01 00 02 d4 84 15 00 00 00 01 00 02 d5 02 15 00 00 00 01 00 02 d6 be 15 00 00 00 01 00 02 d7 02 15 00 00 00 01 00 02 d8 e2 15 00 00 00 01 00 02 d9 03 15 00 00 00 01 00 02 da 11 15 00 00 00 01 00 02 db 03 15 00 00 00 01 00 02 dc 36 15 00 00 00 01 00 02 dd 03 15 00 00 00 01 00 02 de 67 15 00 00 00 01 00 02 df 03 15 00 00 00 01 00 02 e0 76 15 00 00 00 01 00 02 e1 03 15 00 00 00 01 00 02 e2 86 15 00 00 00 01 00 02 e3 03 15 00 00 00 01 00 02 e4 98 15 00 00 00 01 00 02 e5 03 15 00 00 00 01 00 02 e6 ac 15 00 00 00 01 00 02 e7 03 15 00 00 00 01 00 02 e8 c1 15 00 00 00 01 00 02 e9 03 15 00 00 00 01 00 02 ea d8 15 00 00 00 01 00 02 eb 03 15 00 00 00 01 00 02 ec f2 15 00 00 00 01 00 02 ed 03 15 00 00 00 01 00 02 ee ff 15 00 00 00 01 00 02 ef 01 15 00 00 00 01 00 02 f0 15 15 00 00 00 01 00 02 f1 01 15 00 00 00 01 00 02 f2 1c 15 00 00 00 01 00 02 f3 01 15 00 00 00 01 00 02 f4 29 15 00 00 00 01 00 02 f5 01 15 00 00 00 01 00 02 f6 35 15 00 00 00 01 00 02 f7 01 15 00 00 00 01 00 02 f8 40 15 00 00 00 01 00 02 f9 01 15 01 00 00 01 00 02 fa 4b 15 00 00 00 01 00 02 ff 21 15 00 00 00 01 00 02 fb 01 15 00 00 00 01 00 02 00 01 15 00 00 00 01 00 02 01 55 15 00 00 00 01 00 02 02 01 15 00 00 00 01 00 02 03 5f 15 00 00 00 01 00 02 04 01 15 00 00 00 01 00 02 05 68 15 00 00 00 01 00 02 06 01 15 00 00 00 01 00 02 07 87 15 00 00 00 01 00 02 08 01 15 00 00 00 01 00 02 09 a2 15 00 00 00 01 00 02 0a 01 15 00 00 00 01 00 02 0b cf 15 00 00 00 01 00 02 0c 01 15 00 00 00 01 00 02 0d f3 15 00 00 00 01 00 02 0e 02 15 00 00 00 01 00 02 0f 2d 15 00 00 00 01 00 02 10 02 15 00 00 00 01 00 02 11 5f 15 00 00 00 01 00 02 12 02 15 00 00 00 01 00 02 13 61 15 00 00 00 01 00 02 14 02 15 00 00 00 01 00 02 15 92 15 00 00 00 01 00 02 16 02 15 00 00 00 01 00 02 17 c9 15 00 00 00 01 00 02 18 02 15 00 00 00 01 00 02 19 ed 15 00 00 00 01 00 02 1a 03 15 00 00 00 01 00 02 1b 1b 15 00 00 00 01 00 02 1c 03 15 00 00 00 01 00 02 1d 3c 15 00 00 00 01 00 02 1e 03 15 00 00 00 01 00 02 1f 69 15 00 00 00 01 00 02 20 03 15 00 00 00 01 00 02 21 78 15 00 00 00 01 00 02 22 03 15 00 00 00 01 00 02 23 88 15 00 00 00 01 00 02 24 03 15 00 00 00 01 00 02 25 99 15 00 00 00 01 00 02 26 03 15 00 00 00 01 00 02 27 ac 15 00 00 00 01 00 02 28 03 15 00 00 00 01 00 02 29 c1 15 00 00 00 01 00 02 2a 03 15 00 00 00 01 00 02 2b d8 15 00 00 00 01 00 02 2d 03 15 00 00 00 01 00 02 2f f2 15 00 00 00 01 00 02 30 03 15 00 00 00 01 00 02 31 ff 15 00 00 00 01 00 02 32 01 15 00 00 00 01 00 02 33 15 15 00 00 00 01 00 02 34 01 15 00 00 00 01 00 02 35 1c 15 00 00 00 01 00 02 36 01 15 00 00 00 01 00 02 37 29 15 00 00 00 01 00 02 38 01 15 00 00 00 01 00 02 39 35 15 00 00 00 01 00 02 3a 01 15 00 00 00 01 00 02 3b 40 15 00 00 00 01 00 02 3d 01 15 00 00 00 01 00 02 3f 4b 15 00 00 00 01 00 02 40 01 15 00 00 00 01 00 02 41 55 15 00 00 00 01 00 02 42 01 15 00 00 00 01 00 02 43 5f 15 00 00 00 01 00 02 44 01 15 00 00 00 01 00 02 45 68 15 00 00 00 01 00 02 46 01 15 00 00 00 01 00 02 47 87 15 00 00 00 01 00 02 48 01 15 00 00 00 01 00 02 49 a2 15 00 00 00 01 00 02 4a 01 15 00 00 00 01 00 02 4b cf 15 00 00 00 01 00 02 4c 01 15 00 00 00 01 00 02 4d f3 15 00 00 00 01 00 02 4e 02 15 00 00 00 01 00 02 4f 2d 15 00 00 00 01 00 02 50 02 15 00 00 00 01 00 02 51 5f 15 00 00 00 01 00 02 52 02 15 00 00 00 01 00 02 53 61 15 00 00 00 01 00 02 54 02 15 00 00 00 01 00 02 55 92 15 00 00 00 01 00 02 56 02 15 00 00 00 01 00 02 58 c9 15 00 00 00 01 00 02 59 02 15 00 00 00 01 00 02 5a ed 15 00 00 00 01 00 02 5b 03 15 00 00 00 01 00 02 5c 1b 15 00 00 00 01 00 02 5d 03 15 00 00 00 01 00 02 5e 3c 15 00 00 00 01 00 02 5f 03 15 00 00 00 01 00 02 60 69 15 00 00 00 01 00 02 61 03 15 00 00 00 01 00 02 62 78 15 00 00 00 01 00 02 63 03 15 00 00 00 01 00 02 64 88 15 00 00 00 01 00 02 65 03 15 00 00 00 01 00 02 66 99 15 00 00 00 01 00 02 67 03 15 00 00 00 01 00 02 68 ac 15 00 00 00 01 00 02 69 03 15 00 00 00 01 00 02 6a c1 15 00 00 00 01 00 02 6b 03 15 00 00 00 01 00 02 6c d8 15 00 00 00 01 00 02 6d 03 15 00 00 00 01 00 02 6e f2 15 00 00 00 01 00 02 6f 03 15 00 00 00 01 00 02 70 ff 15 00 00 00 01 00 02 71 01 15 00 00 00 01 00 02 72 25 15 00 00 00 01 00 02 73 01 15 00 00 00 01 00 02 74 2d 15 00 00 00 01 00 02 75 01 15 00 00 00 01 00 02 76 39 15 00 00 00 01 00 02 77 01 15 00 00 00 01 00 02 78 45 15 00 00 00 01 00 02 79 01 15 00 00 00 01 00 02 7a 50 15 00 00 00 01 00 02 7b 01 15 00 00 00 01 00 02 7c 5a 15 00 00 00 01 00 02 7d 01 15 00 00 00 01 00 02 7e 63 15 00 00 00 01 00 02 7f 01 15 00 00 00 01 00 02 80 6c 15 00 00 00 01 00 02 81 01 15 00 00 00 01 00 02 82 75 15 00 00 00 01 00 02 83 01 15 00 00 00 01 00 02 84 94 15 00 00 00 01 00 02 85 01 15 00 00 00 01 00 02 86 ae 15 00 00 00 01 00 02 87 01 15 00 00 00 01 00 02 88 d8 15 00 00 00 01 00 02 89 01 15 00 00 00 01 00 02 8a fb 15 00 00 00 01 00 02 8b 02 15 00 00 00 01 00 02 8c 32 15 00 00 00 01 00 02 8d 02 15 00 00 00 01 00 02 8e 63 15 00 00 00 01 00 02 8f 02 15 00 00 00 01 00 02 90 65 15 00 00 00 01 00 02 91 02 15 00 00 00 01 00 02 92 95 15 00 00 00 01 00 02 93 02 15 00 00 00 01 00 02 94 cc 15 00 00 00 01 00 02 95 02 15 00 00 00 01 00 02 96 f0 15 00 00 00 01 00 02 97 03 15 00 00 00 01 00 02 98 1d 15 00 00 00 01 00 02 99 03 15 00 00 00 01 00 02 9a 3b 15 00 00 00 01 00 02 9b 03 15 00 00 00 01 00 02 9c 68 15 00 00 00 01 00 02 9d 03 15 00 00 00 01 00 02 9e 77 15 00 00 00 01 00 02 9f 03 15 00 00 00 01 00 02 a0 86 15 00 00 00 01 00 02 a2 03 15 00 00 00 01 00 02 a3 98 15 00 00 00 01 00 02 a4 03 15 00 00 00 01 00 02 a5 ab 15 00 00 00 01 00 02 a6 03 15 00 00 00 01 00 02 a7 c0 15 00 00 00 01 00 02 a9 03 15 00 00 00 01 00 02 aa d8 15 00 00 00 01 00 02 ab 03 15 00 00 00 01 00 02 ac f2 15 00 00 00 01 00 02 ad 03 15 00 00 00 01 00 02 ae ff 15 00 00 00 01 00 02 af 01 15 00 00 00 01 00 02 b0 25 15 00 00 00 01 00 02 b1 01 15 00 00 00 01 00 02 b2 2d 15 00 00 00 01 00 02 b3 01 15 00 00 00 01 00 02 b4 39 15 00 00 00 01 00 02 b5 01 15 00 00 00 01 00 02 b6 45 15 00 00 00 01 00 02 b7 01 15 00 00 00 01 00 02 b8 50 15 00 00 00 01 00 02 b9 01 15 00 00 00 01 00 02 ba 5a 15 00 00 00 01 00 02 bb 01 15 00 00 00 01 00 02 bc 63 15 00 00 00 01 00 02 bd 01 15 00 00 00 01 00 02 be 6c 15 00 00 00 01 00 02 bf 01 15 00 00 00 01 00 02 c0 75 15 00 00 00 01 00 02 c1 01 15 00 00 00 01 00 02 c2 94 15 00 00 00 01 00 02 c3 01 15 00 00 00 01 00 02 c4 ae 15 00 00 00 01 00 02 c5 01 15 00 00 00 01 00 02 c6 d8 15 00 00 00 01 00 02 c7 01 15 00 00 00 01 00 02 c8 fb 15 00 00 00 01 00 02 c9 02 15 00 00 00 01 00 02 ca 32 15 00 00 00 01 00 02 cb 02 15 00 00 00 01 00 02 cc 63 15 00 00 00 01 00 02 cd 02 15 00 00 00 01 00 02 ce 65 15 00 00 00 01 00 02 cf 02 15 00 00 00 01 00 02 d0 95 15 00 00 00 01 00 02 d1 02 15 00 00 00 01 00 02 d2 cc 15 00 00 00 01 00 02 d3 02 15 00 00 00 01 00 02 d4 f0 15 00 00 00 01 00 02 d5 03 15 00 00 00 01 00 02 d6 1d 15 00 00 00 01 00 02 d7 03 15 00 00 00 01 00 02 d8 3b 15 00 00 00 01 00 02 d9 03 15 00 00 00 01 00 02 da 68 15 00 00 00 01 00 02 db 03 15 00 00 00 01 00 02 dc 77 15 00 00 00 01 00 02 dd 03 15 00 00 00 01 00 02 de 86 15 00 00 00 01 00 02 df 03 15 00 00 00 01 00 02 e0 98 15 00 00 00 01 00 02 e1 03 15 00 00 00 01 00 02 e2 ab 15 00 00 00 01 00 02 e3 03 15 00 00 00 01 00 02 e4 c0 15 00 00 00 01 00 02 e5 03 15 00 00 00 01 00 02 e6 d8 15 00 00 00 01 00 02 e7 03 15 00 00 00 01 00 02 e8 f2 15 00 00 00 01 00 02 e9 03 15 00 00 00 01 00 02 ea ff 15 01 00 00 01 00 02 ff 10];
		qcom,mdss-dsi-dispparam-warm-command-state = "dsi_hs_mode";
		qcom,mdss-dsi-dispparam-default-command = [15 00 00 00 01 00 02 ff 20 15 00 00 00 01 00 02 fb 01 15 00 00 00 01 00 02 75 00 15 00 00 00 01 00 02 76 00 15 00 00 00 01 00 02 77 00 15 00 00 00 01 00 02 78 20 15 00 00 00 01 00 02 79 00 15 00 00 00 01 00 02 7a 58 15 00 00 00 01 00 02 7b 00 15 00 00 00 01 00 02 7c 81 15 00 00 00 01 00 02 7d 00 15 00 00 00 01 00 02 7e 9f 15 00 00 00 01 00 02 7f 00 15 00 00 00 01 00 02 80 ba 15 00 00 00 01 00 02 81 00 15 00 00 00 01 00 02 82 d2 15 00 00 00 01 00 02 83 00 15 00 00 00 01 00 02 84 e8 15 00 00 00 01 00 02 85 00 15 00 00 00 01 00 02 86 fa 15 00 00 00 01 00 02 87 01 15 00 00 00 01 00 02 88 33 15 00 00 00 01 00 02 89 01 15 00 00 00 01 00 02 8a 5f 15 00 00 00 01 00 02 8b 01 15 00 00 00 01 00 02 8c 9f 15 00 00 00 01 00 02 8d 01 15 00 00 00 01 00 02 8e cf 15 00 00 00 01 00 02 8f 02 15 00 00 00 01 00 02 90 15 15 00 00 00 01 00 02 91 02 15 00 00 00 01 00 02 92 4f 15 00 00 00 01 00 02 93 02 15 00 00 00 01 00 02 94 51 15 00 00 00 01 00 02 95 02 15 00 00 00 01 00 02 96 84 15 00 00 00 01 00 02 97 02 15 00 00 00 01 00 02 98 bd 15 00 00 00 01 00 02 99 02 15 00 00 00 01 00 02 9a e0 15 00 00 00 01 00 02 9b 03 15 00 00 00 01 00 02 9c 10 15 00 00 00 01 00 02 9d 03 15 00 00 00 01 00 02 9e 36 15 00 00 00 01 00 02 9f 03 15 00 00 00 01 00 02 a0 67 15 00 00 00 01 00 02 a2 03 15 00 00 00 01 00 02 a3 76 15 00 00 00 01 00 02 a4 03 15 00 00 00 01 00 02 a5 86 15 00 00 00 01 00 02 a6 03 15 00 00 00 01 00 02 a7 98 15 00 00 00 01 00 02 a9 03 15 00 00 00 01 00 02 aa ac 15 00 00 00 01 00 02 ab 03 15 00 00 00 01 00 02 ac c1 15 00 00 00 01 00 02 ad 03 15 00 00 00 01 00 02 ae d8 15 00 00 00 01 00 02 af 03 15 00 00 00 01 00 02 b0 f2 15 00 00 00 01 00 02 b1 03 15 00 00 00 01 00 02 b2 ff 15 00 00 00 01 00 02 b3 00 15 00 00 00 01 00 02 b4 00 15 00 00 00 01 00 02 b5 00 15 00 00 00 01 00 02 b6 20 15 00 00 00 01 00 02 b7 00 15 00 00 00 01 00 02 b8 58 15 00 00 00 01 00 02 b9 00 15 00 00 00 01 00 02 ba 81 15 00 00 00 01 00 02 bb 00 15 00 00 00 01 00 02 bc 9f 15 00 00 00 01 00 02 bd 00 15 00 00 00 01 00 02 be ba 15 00 00 00 01 00 02 bf 00 15 00 00 00 01 00 02 c0 d2 15 00 00 00 01 00 02 c1 00 15 00 00 00 01 00 02 c2 e8 15 00 00 00 01 00 02 c3 00 15 00 00 00 01 00 02 c4 fa 15 00 00 00 01 00 02 c5 01 15 00 00 00 01 00 02 c6 33 15 00 00 00 01 00 02 c7 01 15 00 00 00 01 00 02 c8 5f 15 00 00 00 01 00 02 c9 01 15 00 00 00 01 00 02 ca 9f 15 00 00 00 01 00 02 cb 01 15 00 00 00 01 00 02 cc cf 15 00 00 00 01 00 02 cd 02 15 00 00 00 01 00 02 ce 15 15 00 00 00 01 00 02 cf 02 15 00 00 00 01 00 02 d0 4f 15 00 00 00 01 00 02 d1 02 15 00 00 00 01 00 02 d2 51 15 00 00 00 01 00 02 d3 02 15 00 00 00 01 00 02 d4 84 15 00 00 00 01 00 02 d5 02 15 00 00 00 01 00 02 d6 bd 15 00 00 00 01 00 02 d7 02 15 00 00 00 01 00 02 d8 e0 15 00 00 00 01 00 02 d9 03 15 00 00 00 01 00 02 da 10 15 00 00 00 01 00 02 db 03 15 00 00 00 01 00 02 dc 36 15 00 00 00 01 00 02 dd 03 15 00 00 00 01 00 02 de 67 15 00 00 00 01 00 02 df 03 15 00 00 00 01 00 02 e0 76 15 00 00 00 01 00 02 e1 03 15 00 00 00 01 00 02 e2 86 15 00 00 00 01 00 02 e3 03 15 00 00 00 01 00 02 e4 98 15 00 00 00 01 00 02 e5 03 15 00 00 00 01 00 02 e6 ac 15 00 00 00 01 00 02 e7 03 15 00 00 00 01 00 02 e8 c1 15 00 00 00 01 00 02 e9 03 15 00 00 00 01 00 02 ea d8 15 00 00 00 01 00 02 eb 03 15 00 00 00 01 00 02 ec f2 15 00 00 00 01 00 02 ed 03 15 00 00 00 01 00 02 ee ff 15 00 00 00 01 00 02 ef 00 15 00 00 00 01 00 02 f0 e0 15 00 00 00 01 00 02 f1 00 15 00 00 00 01 00 02 f2 e9 15 00 00 00 01 00 02 f3 00 15 00 00 00 01 00 02 f4 fb 15 00 00 00 01 00 02 f5 01 15 00 00 00 01 00 02 f6 0b 15 00 00 00 01 00 02 f7 01 15 00 00 00 01 00 02 f8 1a 15 00 00 00 01 00 02 f9 01 15 01 00 00 01 00 02 fa 27 15 00 00 00 01 00 02 ff 21 15 00 00 00 01 00 02 fb 01 15 00 00 00 01 00 02 00 01 15 00 00 00 01 00 02 01 33 15 00 00 00 01 00 02 02 01 15 00 00 00 01 00 02 03 3f 15 00 00 00 01 00 02 04 01 15 00 00 00 01 00 02 05 4a 15 00 00 00 01 00 02 06 01 15 00 00 00 01 00 02 07 71 15 00 00 00 01 00 02 08 01 15 00 00 00 01 00 02 09 8f 15 00 00 00 01 00 02 0a 01 15 00 00 00 01 00 02 0b c1 15 00 00 00 01 00 02 0c 01 15 00 00 00 01 00 02 0d e9 15 00 00 00 01 00 02 0e 02 15 00 00 00 01 00 02 0f 26 15 00 00 00 01 00 02 10 02 15 00 00 00 01 00 02 11 5a 15 00 00 00 01 00 02 12 02 15 00 00 00 01 00 02 13 5c 15 00 00 00 01 00 02 14 02 15 00 00 00 01 00 02 15 8e 15 00 00 00 01 00 02 16 02 15 00 00 00 01 00 02 17 c5 15 00 00 00 01 00 02 18 02 15 00 00 00 01 00 02 19 e8 15 00 00 00 01 00 02 1a 03 15 00 00 00 01 00 02 1b 17 15 00 00 00 01 00 02 1c 03 15 00 00 00 01 00 02 1d 39 15 00 00 00 01 00 02 1e 03 15 00 00 00 01 00 02 1f 67 15 00 00 00 01 00 02 20 03 15 00 00 00 01 00 02 21 76 15 00 00 00 01 00 02 22 03 15 00 00 00 01 00 02 23 86 15 00 00 00 01 00 02 24 03 15 00 00 00 01 00 02 25 98 15 00 00 00 01 00 02 26 03 15 00 00 00 01 00 02 27 ab 15 00 00 00 01 00 02 28 03 15 00 00 00 01 00 02 29 c0 15 00 00 00 01 00 02 2a 03 15 00 00 00 01 00 02 2b d8 15 00 00 00 01 00 02 2d 03 15 00 00 00 01 00 02 2f f2 15 00 00 00 01 00 02 30 03 15 00 00 00 01 00 02 31 ff 15 00 00 00 01 00 02 32 00 15 00 00 00 01 00 02 33 e0 15 00 00 00 01 00 02 34 00 15 00 00 00 01 00 02 35 e9 15 00 00 00 01 00 02 36 00 15 00 00 00 01 00 02 37 fb 15 00 00 00 01 00 02 38 01 15 00 00 00 01 00 02 39 0b 15 00 00 00 01 00 02 3a 01 15 00 00 00 01 00 02 3b 1a 15 00 00 00 01 00 02 3d 01 15 00 00 00 01 00 02 3f 27 15 00 00 00 01 00 02 40 01 15 00 00 00 01 00 02 41 33 15 00 00 00 01 00 02 42 01 15 00 00 00 01 00 02 43 3f 15 00 00 00 01 00 02 44 01 15 00 00 00 01 00 02 45 4a 15 00 00 00 01 00 02 46 01 15 00 00 00 01 00 02 47 71 15 00 00 00 01 00 02 48 01 15 00 00 00 01 00 02 49 8f 15 00 00 00 01 00 02 4a 01 15 00 00 00 01 00 02 4b c1 15 00 00 00 01 00 02 4c 01 15 00 00 00 01 00 02 4d e9 15 00 00 00 01 00 02 4e 02 15 00 00 00 01 00 02 4f 26 15 00 00 00 01 00 02 50 02 15 00 00 00 01 00 02 51 5a 15 00 00 00 01 00 02 52 02 15 00 00 00 01 00 02 53 5c 15 00 00 00 01 00 02 54 02 15 00 00 00 01 00 02 55 8e 15 00 00 00 01 00 02 56 02 15 00 00 00 01 00 02 58 c5 15 00 00 00 01 00 02 59 02 15 00 00 00 01 00 02 5a e8 15 00 00 00 01 00 02 5b 03 15 00 00 00 01 00 02 5c 17 15 00 00 00 01 00 02 5d 03 15 00 00 00 01 00 02 5e 39 15 00 00 00 01 00 02 5f 03 15 00 00 00 01 00 02 60 67 15 00 00 00 01 00 02 61 03 15 00 00 00 01 00 02 62 76 15 00 00 00 01 00 02 63 03 15 00 00 00 01 00 02 64 86 15 00 00 00 01 00 02 65 03 15 00 00 00 01 00 02 66 98 15 00 00 00 01 00 02 67 03 15 00 00 00 01 00 02 68 ab 15 00 00 00 01 00 02 69 03 15 00 00 00 01 00 02 6a c0 15 00 00 00 01 00 02 6b 03 15 00 00 00 01 00 02 6c d8 15 00 00 00 01 00 02 6d 03 15 00 00 00 01 00 02 6e f2 15 00 00 00 01 00 02 6f 03 15 00 00 00 01 00 02 70 ff 15 00 00 00 01 00 02 71 00 15 00 00 00 01 00 02 72 00 15 00 00 00 01 00 02 73 00 15 00 00 00 01 00 02 74 2f 15 00 00 00 01 00 02 75 00 15 00 00 00 01 00 02 76 7e 15 00 00 00 01 00 02 77 00 15 00 00 00 01 00 02 78 ad 15 00 00 00 01 00 02 79 00 15 00 00 00 01 00 02 7a c7 15 00 00 00 01 00 02 7b 00 15 00 00 00 01 00 02 7c e0 15 00 00 00 01 00 02 7d 00 15 00 00 00 01 00 02 7e f7 15 00 00 00 01 00 02 7f 01 15 00 00 00 01 00 02 80 09 15 00 00 00 01 00 02 81 01 15 00 00 00 01 00 02 82 19 15 00 00 00 01 00 02 83 01 15 00 00 00 01 00 02 84 4f 15 00 00 00 01 00 02 85 01 15 00 00 00 01 00 02 86 76 15 00 00 00 01 00 02 87 01 15 00 00 00 01 00 02 88 b2 15 00 00 00 01 00 02 89 01 15 00 00 00 01 00 02 8a de 15 00 00 00 01 00 02 8b 02 15 00 00 00 01 00 02 8c 20 15 00 00 00 01 00 02 8d 02 15 00 00 00 01 00 02 8e 56 15 00 00 00 01 00 02 8f 02 15 00 00 00 01 00 02 90 58 15 00 00 00 01 00 02 91 02 15 00 00 00 01 00 02 92 8b 15 00 00 00 01 00 02 93 02 15 00 00 00 01 00 02 94 c2 15 00 00 00 01 00 02 95 02 15 00 00 00 01 00 02 96 e6 15 00 00 00 01 00 02 97 03 15 00 00 00 01 00 02 98 15 15 00 00 00 01 00 02 99 03 15 00 00 00 01 00 02 9a 35 15 00 00 00 01 00 02 9b 03 15 00 00 00 01 00 02 9c 64 15 00 00 00 01 00 02 9d 03 15 00 00 00 01 00 02 9e 73 15 00 00 00 01 00 02 9f 03 15 00 00 00 01 00 02 a0 83 15 00 00 00 01 00 02 a2 03 15 00 00 00 01 00 02 a3 95 15 00 00 00 01 00 02 a4 03 15 00 00 00 01 00 02 a5 a9 15 00 00 00 01 00 02 a6 03 15 00 00 00 01 00 02 a7 bf 15 00 00 00 01 00 02 a9 03 15 00 00 00 01 00 02 aa d7 15 00 00 00 01 00 02 ab 03 15 00 00 00 01 00 02 ac f1 15 00 00 00 01 00 02 ad 03 15 00 00 00 01 00 02 ae ff 15 00 00 00 01 00 02 af 00 15 00 00 00 01 00 02 b0 00 15 00 00 00 01 00 02 b1 00 15 00 00 00 01 00 02 b2 2f 15 00 00 00 01 00 02 b3 00 15 00 00 00 01 00 02 b4 7e 15 00 00 00 01 00 02 b5 00 15 00 00 00 01 00 02 b6 ad 15 00 00 00 01 00 02 b7 00 15 00 00 00 01 00 02 b8 c7 15 00 00 00 01 00 02 b9 00 15 00 00 00 01 00 02 ba e0 15 00 00 00 01 00 02 bb 00 15 00 00 00 01 00 02 bc f7 15 00 00 00 01 00 02 bd 01 15 00 00 00 01 00 02 be 09 15 00 00 00 01 00 02 bf 01 15 00 00 00 01 00 02 c0 19 15 00 00 00 01 00 02 c1 01 15 00 00 00 01 00 02 c2 4f 15 00 00 00 01 00 02 c3 01 15 00 00 00 01 00 02 c4 76 15 00 00 00 01 00 02 c5 01 15 00 00 00 01 00 02 c6 b2 15 00 00 00 01 00 02 c7 01 15 00 00 00 01 00 02 c8 de 15 00 00 00 01 00 02 c9 02 15 00 00 00 01 00 02 ca 20 15 00 00 00 01 00 02 cb 02 15 00 00 00 01 00 02 cc 56 15 00 00 00 01 00 02 cd 02 15 00 00 00 01 00 02 ce 58 15 00 00 00 01 00 02 cf 02 15 00 00 00 01 00 02 d0 8b 15 00 00 00 01 00 02 d1 02 15 00 00 00 01 00 02 d2 c2 15 00 00 00 01 00 02 d3 02 15 00 00 00 01 00 02 d4 e6 15 00 00 00 01 00 02 d5 03 15 00 00 00 01 00 02 d6 15 15 00 00 00 01 00 02 d7 03 15 00 00 00 01 00 02 d8 35 15 00 00 00 01 00 02 d9 03 15 00 00 00 01 00 02 da 64 15 00 00 00 01 00 02 db 03 15 00 00 00 01 00 02 dc 73 15 00 00 00 01 00 02 dd 03 15 00 00 00 01 00 02 de 83 15 00 00 00 01 00 02 df 03 15 00 00 00 01 00 02 e0 95 15 00 00 00 01 00 02 e1 03 15 00 00 00 01 00 02 e2 a9 15 00 00 00 01 00 02 e3 03 15 00 00 00 01 00 02 e4 bf 15 00 00 00 01 00 02 e5 03 15 00 00 00 01 00 02 e6 d7 15 00 00 00 01 00 02 e7 03 15 00 00 00 01 00 02 e8 f1 15 00 00 00 01 00 02 e9 03 15 00 00 00 01 00 02 ea ff 15 01 00 00 01 00 02 ff 10];
		qcom,mdss-dsi-dispparam-default-command-state = "dsi_hs_mode";
		qcom,mdss-dsi-dispparam-cold-command = [15 00 00 00 01 00 02 ff 20 15 00 00 00 01 00 02 fb 01 15 00 00 00 01 00 02 75 01 15 00 00 00 01 00 02 76 03 15 00 00 00 01 00 02 77 01 15 00 00 00 01 00 02 78 0c 15 00 00 00 01 00 02 79 01 15 00 00 00 01 00 02 7a 1a 15 00 00 00 01 00 02 7b 01 15 00 00 00 01 00 02 7c 28 15 00 00 00 01 00 02 7d 01 15 00 00 00 01 00 02 7e 35 15 00 00 00 01 00 02 7f 01 15 00 00 00 01 00 02 80 41 15 00 00 00 01 00 02 81 01 15 00 00 00 01 00 02 82 4c 15 00 00 00 01 00 02 83 01 15 00 00 00 01 00 02 84 57 15 00 00 00 01 00 02 85 01 15 00 00 00 01 00 02 86 62 15 00 00 00 01 00 02 87 01 15 00 00 00 01 00 02 88 84 15 00 00 00 01 00 02 89 01 15 00 00 00 01 00 02 8a a1 15 00 00 00 01 00 02 8b 01 15 00 00 00 01 00 02 8c d1 15 00 00 00 01 00 02 8d 01 15 00 00 00 01 00 02 8e f7 15 00 00 00 01 00 02 8f 02 15 00 00 00 01 00 02 90 33 15 00 00 00 01 00 02 91 02 15 00 00 00 01 00 02 92 68 15 00 00 00 01 00 02 93 02 15 00 00 00 01 00 02 94 6a 15 00 00 00 01 00 02 95 02 15 00 00 00 01 00 02 96 9d 15 00 00 00 01 00 02 97 02 15 00 00 00 01 00 02 98 d6 15 00 00 00 01 00 02 99 02 15 00 00 00 01 00 02 9a fc 15 00 00 00 01 00 02 9b 03 15 00 00 00 01 00 02 9c 2d 15 00 00 00 01 00 02 9d 03 15 00 00 00 01 00 02 9e 53 15 00 00 00 01 00 02 9f 03 15 00 00 00 01 00 02 a0 80 15 00 00 00 01 00 02 a2 03 15 00 00 00 01 00 02 a3 8d 15 00 00 00 01 00 02 a4 03 15 00 00 00 01 00 02 a5 9c 15 00 00 00 01 00 02 a6 03 15 00 00 00 01 00 02 a7 ab 15 00 00 00 01 00 02 a9 03 15 00 00 00 01 00 02 aa bc 15 00 00 00 01 00 02 ab 03 15 00 00 00 01 00 02 ac cd 15 00 00 00 01 00 02 ad 03 15 00 00 00 01 00 02 ae e0 15 00 00 00 01 00 02 af 03 15 00 00 00 01 00 02 b0 f5 15 00 00 00 01 00 02 b1 03 15 00 00 00 01 00 02 b2 ff 15 00 00 00 01 00 02 b3 01 15 00 00 00 01 00 02 b4 03 15 00 00 00 01 00 02 b5 01 15 00 00 00 01 00 02 b6 0c 15 00 00 00 01 00 02 b7 01 15 00 00 00 01 00 02 b8 1a 15 00 00 00 01 00 02 b9 01 15 00 00 00 01 00 02 ba 28 15 00 00 00 01 00 02 bb 01 15 00 00 00 01 00 02 bc 35 15 00 00 00 01 00 02 bd 01 15 00 00 00 01 00 02 be 41 15 00 00 00 01 00 02 bf 01 15 00 00 00 01 00 02 c0 4c 15 00 00 00 01 00 02 c1 01 15 00 00 00 01 00 02 c2 57 15 00 00 00 01 00 02 c3 01 15 00 00 00 01 00 02 c4 62 15 00 00 00 01 00 02 c5 01 15 00 00 00 01 00 02 c6 84 15 00 00 00 01 00 02 c7 01 15 00 00 00 01 00 02 c8 a1 15 00 00 00 01 00 02 c9 01 15 00 00 00 01 00 02 ca d1 15 00 00 00 01 00 02 cb 01 15 00 00 00 01 00 02 cc f7 15 00 00 00 01 00 02 cd 02 15 00 00 00 01 00 02 ce 33 15 00 00 00 01 00 02 cf 02 15 00 00 00 01 00 02 d0 68 15 00 00 00 01 00 02 d1 02 15 00 00 00 01 00 02 d2 6a 15 00 00 00 01 00 02 d3 02 15 00 00 00 01 00 02 d4 9d 15 00 00 00 01 00 02 d5 02 15 00 00 00 01 00 02 d6 d6 15 00 00 00 01 00 02 d7 02 15 00 00 00 01 00 02 d8 fc 15 00 00 00 01 00 02 d9 03 15 00 00 00 01 00 02 da 2d 15 00 00 00 01 00 02 db 03 15 00 00 00 01 00 02 dc 53 15 00 00 00 01 00 02 dd 03 15 00 00 00 01 00 02 de 80 15 00 00 00 01 00 02 df 03 15 00 00 00 01 00 02 e0 8d 15 00 00 00 01 00 02 e1 03 15 00 00 00 01 00 02 e2 9c 15 00 00 00 01 00 02 e3 03 15 00 00 00 01 00 02 e4 ab 15 00 00 00 01 00 02 e5 03 15 00 00 00 01 00 02 e6 bc 15 00 00 00 01 00 02 e7 03 15 00 00 00 01 00 02 e8 cd 15 00 00 00 01 00 02 e9 03 15 00 00 00 01 00 02 ea e0 15 00 00 00 01 00 02 eb 03 15 00 00 00 01 00 02 ec f5 15 00 00 00 01 00 02 ed 03 15 00 00 00 01 00 02 ee ff 15 00 00 00 01 00 02 ef 01 15 00 00 00 01 00 02 f0 0d 15 00 00 00 01 00 02 f1 01 15 00 00 00 01 00 02 f2 15 15 00 00 00 01 00 02 f3 01 15 00 00 00 01 00 02 f4 23 15 00 00 00 01 00 02 f5 01 15 00 00 00 01 00 02 f6 31 15 00 00 00 01 00 02 f7 01 15 00 00 00 01 00 02 f8 3d 15 00 00 00 01 00 02 f9 01 15 01 00 00 01 00 02 fa 49 15 00 00 00 01 00 02 ff 21 15 00 00 00 01 00 02 fb 01 15 00 00 00 01 00 02 00 01 15 00 00 00 01 00 02 01 54 15 00 00 00 01 00 02 02 01 15 00 00 00 01 00 02 03 5f 15 00 00 00 01 00 02 04 01 15 00 00 00 01 00 02 05 69 15 00 00 00 01 00 02 06 01 15 00 00 00 01 00 02 07 8a 15 00 00 00 01 00 02 08 01 15 00 00 00 01 00 02 09 a8 15 00 00 00 01 00 02 0a 01 15 00 00 00 01 00 02 0b d6 15 00 00 00 01 00 02 0c 01 15 00 00 00 01 00 02 0d fb 15 00 00 00 01 00 02 0e 02 15 00 00 00 01 00 02 0f 37 15 00 00 00 01 00 02 10 02 15 00 00 00 01 00 02 11 6a 15 00 00 00 01 00 02 12 02 15 00 00 00 01 00 02 13 6c 15 00 00 00 01 00 02 14 02 15 00 00 00 01 00 02 15 9e 15 00 00 00 01 00 02 16 02 15 00 00 00 01 00 02 17 d8 15 00 00 00 01 00 02 18 02 15 00 00 00 01 00 02 19 fe 15 00 00 00 01 00 02 1a 03 15 00 00 00 01 00 02 1b 2d 15 00 00 00 01 00 02 1c 03 15 00 00 00 01 00 02 1d 4e 15 00 00 00 01 00 02 1e 03 15 00 00 00 01 00 02 1f 7a 15 00 00 00 01 00 02 20 03 15 00 00 00 01 00 02 21 87 15 00 00 00 01 00 02 22 03 15 00 00 00 01 00 02 23 96 15 00 00 00 01 00 02 24 03 15 00 00 00 01 00 02 25 a5 15 00 00 00 01 00 02 26 03 15 00 00 00 01 00 02 27 b6 15 00 00 00 01 00 02 28 03 15 00 00 00 01 00 02 29 c9 15 00 00 00 01 00 02 2a 03 15 00 00 00 01 00 02 2b dd 15 00 00 00 01 00 02 2d 03 15 00 00 00 01 00 02 2f f4 15 00 00 00 01 00 02 30 03 15 00 00 00 01 00 02 31 ff 15 00 00 00 01 00 02 32 01 15 00 00 00 01 00 02 33 0d 15 00 00 00 01 00 02 34 01 15 00 00 00 01 00 02 35 15 15 00 00 00 01 00 02 36 01 15 00 00 00 01 00 02 37 23 15 00 00 00 01 00 02 38 01 15 00 00 00 01 00 02 39 31 15 00 00 00 01 00 02 3a 01 15 00 00 00 01 00 02 3b 3d 15 00 00 00 01 00 02 3d 01 15 00 00 00 01 00 02 3f 49 15 00 00 00 01 00 02 40 01 15 00 00 00 01 00 02 41 54 15 00 00 00 01 00 02 42 01 15 00 00 00 01 00 02 43 5f 15 00 00 00 01 00 02 44 01 15 00 00 00 01 00 02 45 69 15 00 00 00 01 00 02 46 01 15 00 00 00 01 00 02 47 8a 15 00 00 00 01 00 02 48 01 15 00 00 00 01 00 02 49 a8 15 00 00 00 01 00 02 4a 01 15 00 00 00 01 00 02 4b d6 15 00 00 00 01 00 02 4c 01 15 00 00 00 01 00 02 4d fb 15 00 00 00 01 00 02 4e 02 15 00 00 00 01 00 02 4f 37 15 00 00 00 01 00 02 50 02 15 00 00 00 01 00 02 51 6a 15 00 00 00 01 00 02 52 02 15 00 00 00 01 00 02 53 6c 15 00 00 00 01 00 02 54 02 15 00 00 00 01 00 02 55 9e 15 00 00 00 01 00 02 56 02 15 00 00 00 01 00 02 58 d8 15 00 00 00 01 00 02 59 02 15 00 00 00 01 00 02 5a fe 15 00 00 00 01 00 02 5b 03 15 00 00 00 01 00 02 5c 2d 15 00 00 00 01 00 02 5d 03 15 00 00 00 01 00 02 5e 4e 15 00 00 00 01 00 02 5f 03 15 00 00 00 01 00 02 60 7a 15 00 00 00 01 00 02 61 03 15 00 00 00 01 00 02 62 87 15 00 00 00 01 00 02 63 03 15 00 00 00 01 00 02 64 96 15 00 00 00 01 00 02 65 03 15 00 00 00 01 00 02 66 a5 15 00 00 00 01 00 02 67 03 15 00 00 00 01 00 02 68 b6 15 00 00 00 01 00 02 69 03 15 00 00 00 01 00 02 6a c9 15 00 00 00 01 00 02 6b 03 15 00 00 00 01 00 02 6c dd 15 00 00 00 01 00 02 6d 03 15 00 00 00 01 00 02 6e f4 15 00 00 00 01 00 02 6f 03 15 00 00 00 01 00 02 70 ff 15 00 00 00 01 00 02 71 00 15 00 00 00 01 00 02 72 00 15 00 00 00 01 00 02 73 00 15 00 00 00 01 00 02 74 31 15 00 00 00 01 00 02 75 00 15 00 00 00 01 00 02 76 84 15 00 00 00 01 00 02 77 00 15 00 00 00 01 00 02 78 b4 15 00 00 00 01 00 02 79 00 15 00 00 00 01 00 02 7a cf 15 00 00 00 01 00 02 7b 00 15 00 00 00 01 00 02 7c e8 15 00 00 00 01 00 02 7d 00 15 00 00 00 01 00 02 7e ff 15 00 00 00 01 00 02 7f 01 15 00 00 00 01 00 02 80 13 15 00 00 00 01 00 02 81 01 15 00 00 00 01 00 02 82 23 15 00 00 00 01 00 02 83 01 15 00 00 00 01 00 02 84 5a 15 00 00 00 01 00 02 85 01 15 00 00 00 01 00 02 86 82 15 00 00 00 01 00 02 87 01 15 00 00 00 01 00 02 88 bd 15 00 00 00 01 00 02 89 01 15 00 00 00 01 00 02 8a ea 15 00 00 00 01 00 02 8b 02 15 00 00 00 01 00 02 8c 2c 15 00 00 00 01 00 02 8d 02 15 00 00 00 01 00 02 8e 62 15 00 00 00 01 00 02 8f 02 15 00 00 00 01 00 02 90 64 15 00 00 00 01 00 02 91 02 15 00 00 00 01 00 02 92 98 15 00 00 00 01 00 02 93 02 15 00 00 00 01 00 02 94 d3 15 00 00 00 01 00 02 95 02 15 00 00 00 01 00 02 96 f9 15 00 00 00 01 00 02 97 03 15 00 00 00 01 00 02 98 29 15 00 00 00 01 00 02 99 03 15 00 00 00 01 00 02 9a 4a 15 00 00 00 01 00 02 9b 03 15 00 00 00 01 00 02 9c 77 15 00 00 00 01 00 02 9d 03 15 00 00 00 01 00 02 9e 84 15 00 00 00 01 00 02 9f 03 15 00 00 00 01 00 02 a0 93 15 00 00 00 01 00 02 a2 03 15 00 00 00 01 00 02 a3 a3 15 00 00 00 01 00 02 a4 03 15 00 00 00 01 00 02 a5 b5 15 00 00 00 01 00 02 a6 03 15 00 00 00 01 00 02 a7 c8 15 00 00 00 01 00 02 a9 03 15 00 00 00 01 00 02 aa dd 15 00 00 00 01 00 02 ab 03 15 00 00 00 01 00 02 ac f3 15 00 00 00 01 00 02 ad 03 15 00 00 00 01 00 02 ae ff 15 00 00 00 01 00 02 af 00 15 00 00 00 01 00 02 b0 00 15 00 00 00 01 00 02 b1 00 15 00 00 00 01 00 02 b2 31 15 00 00 00 01 00 02 b3 00 15 00 00 00 01 00 02 b4 84 15 00 00 00 01 00 02 b5 00 15 00 00 00 01 00 02 b6 b4 15 00 00 00 01 00 02 b7 00 15 00 00 00 01 00 02 b8 cf 15 00 00 00 01 00 02 b9 00 15 00 00 00 01 00 02 ba e8 15 00 00 00 01 00 02 bb 00 15 00 00 00 01 00 02 bc ff 15 00 00 00 01 00 02 bd 01 15 00 00 00 01 00 02 be 13 15 00 00 00 01 00 02 bf 01 15 00 00 00 01 00 02 c0 23 15 00 00 00 01 00 02 c1 01 15 00 00 00 01 00 02 c2 5a 15 00 00 00 01 00 02 c3 01 15 00 00 00 01 00 02 c4 82 15 00 00 00 01 00 02 c5 01 15 00 00 00 01 00 02 c6 bd 15 00 00 00 01 00 02 c7 01 15 00 00 00 01 00 02 c8 ea 15 00 00 00 01 00 02 c9 02 15 00 00 00 01 00 02 ca 2c 15 00 00 00 01 00 02 cb 02 15 00 00 00 01 00 02 cc 62 15 00 00 00 01 00 02 cd 02 15 00 00 00 01 00 02 ce 64 15 00 00 00 01 00 02 cf 02 15 00 00 00 01 00 02 d0 98 15 00 00 00 01 00 02 d1 02 15 00 00 00 01 00 02 d2 d3 15 00 00 00 01 00 02 d3 02 15 00 00 00 01 00 02 d4 f9 15 00 00 00 01 00 02 d5 03 15 00 00 00 01 00 02 d6 29 15 00 00 00 01 00 02 d7 03 15 00 00 00 01 00 02 d8 4a 15 00 00 00 01 00 02 d9 03 15 00 00 00 01 00 02 da 77 15 00 00 00 01 00 02 db 03 15 00 00 00 01 00 02 dc 84 15 00 00 00 01 00 02 dd 03 15 00 00 00 01 00 02 de 93 15 00 00 00 01 00 02 df 03 15 00 00 00 01 00 02 e0 a3 15 00 00 00 01 00 02 e1 03 15 00 00 00 01 00 02 e2 b5 15 00 00 00 01 00 02 e3 03 15 00 00 00 01 00 02 e4 c8 15 00 00 00 01 00 02 e5 03 15 00 00 00 01 00 02 e6 dd 15 00 00 00 01 00 02 e7 03 15 00 00 00 01 00 02 e8 f3 15 00 00 00 01 00 02 e9 03 15 00 00 00 01 00 02 ea ff 15 01 00 00 01 00 02 ff 10];
		qcom,mdss-dsi-dispparam-cold-command-state = "dsi_hs_mode";
		qcom,mdss-dsi-dispparam-ceon-command = [15 00 00 00 01 00 02 ff 10 15 01 00 00 10 00 02 55 80];
		qcom,mdss-dsi-dispparam-ceoff-command = [15 00 00 00 01 00 02 ff 10 15 01 00 00 10 00 02 55 00];
		qcom,mdss-dsi-dispparam-cabcon-command = <0x15010000 0x10002ff 0x23150000 0x10002 0xfb011500 0x100 0x217f315 0x1 0x218e2 0x15000000 0x1000219 0xd2150000 0x10002 0x1ac11500 0x100 0x21bb115 0x1 0x21ca3 0x15000000 0x100021d 0x87150000 0x10002 0x1e871500 0x100 0x21f8715 0x1 0x22066 0x15010000 0x10002ff 0x10150000 0x10002 0x51ff1500 0x100 0x2532c15 0x1000001 0x25502>;
		qcom,mdss-dsi-dispparam-cabcguion-command = [15 00 00 00 01 00 02 ff 10 15 01 00 00 01 00 02 55 01];
		qcom,mdss-dsi-dispparam-cabcstillon-command = [15 01 00 00 01 00 02 ff 23 15 00 00 00 01 00 02 fb 01 15 00 00 00 01 00 02 17 f3 15 00 00 00 01 00 02 18 e2 15 00 00 00 01 00 02 19 d2 15 00 00 00 01 00 02 1a c1 15 00 00 00 01 00 02 1b b1 15 00 00 00 01 00 02 1c a3 15 00 00 00 01 00 02 1d 87 15 00 00 00 01 00 02 1e 87 15 00 00 00 01 00 02 1f 87 15 00 00 00 01 00 02 20 66 15 01 00 00 01 00 02 ff 10 15 01 00 00 01 00 02 55 02];
		qcom,mdss-dsi-dispparam-cabcmovieon-command = [15 00 00 00 01 00 02 ff 10 15 01 00 00 01 00 02 55 03];
		qcom,mdss-dsi-dispparam-cabcoff-command = [15 00 00 00 01 00 02 ff 10 15 01 00 00 01 00 02 55 00];
		qcom,mdss-dsi-dispparam-papermode-command = [15 01 00 00 78 00 02 ff 20 15 00 00 00 01 00 02 fb 01 15 00 00 00 01 00 02 75 00 15 00 00 00 01 00 02 76 c8 15 00 00 00 01 00 02 77 00 15 00 00 00 01 00 02 78 d3 15 00 00 00 01 00 02 79 00 15 00 00 00 01 00 02 7a e7 15 00 00 00 01 00 02 7b 00 15 00 00 00 01 00 02 7c f8 15 00 00 00 01 00 02 7d 01 15 00 00 00 01 00 02 7e 08 15 00 00 00 01 00 02 7f 01 15 00 00 00 01 00 02 80 17 15 00 00 00 01 00 02 81 01 15 00 00 00 01 00 02 82 24 15 00 00 00 01 00 02 83 01 15 00 00 00 01 00 02 84 30 15 00 00 00 01 00 02 85 01 15 00 00 00 01 00 02 86 3c 15 00 00 00 01 00 02 87 01 15 00 00 00 01 00 02 88 64 15 00 00 00 01 00 02 89 01 15 00 00 00 01 00 02 8a 84 15 00 00 00 01 00 02 8b 01 15 00 00 00 01 00 02 8c b8 15 00 00 00 01 00 02 8d 01 15 00 00 00 01 00 02 8e e0 15 00 00 00 01 00 02 8f 02 15 00 00 00 01 00 02 90 1f 15 00 00 00 01 00 02 91 02 15 00 00 00 01 00 02 92 54 15 00 00 00 01 00 02 93 02 15 00 00 00 01 00 02 94 56 15 00 00 00 01 00 02 95 02 15 00 00 00 01 00 02 96 8a 15 00 00 00 01 00 02 97 02 15 00 00 00 01 00 02 98 c1 15 00 00 00 01 00 02 99 02 15 00 00 00 01 00 02 9a e1 15 00 00 00 01 00 02 9b 03 15 00 00 00 01 00 02 9c 0a 15 00 00 00 01 00 02 9d 03 15 00 00 00 01 00 02 9e 33 15 00 00 00 01 00 02 9f 03 15 00 00 00 01 00 02 a0 58 15 00 00 00 01 00 02 a2 03 15 00 00 00 01 00 02 a3 63 15 00 00 00 01 00 02 a4 03 15 00 00 00 01 00 02 a5 6f 15 00 00 00 01 00 02 a6 03 15 00 00 00 01 00 02 a7 7c 15 00 00 00 01 00 02 a9 03 15 00 00 00 01 00 02 aa 8a 15 00 00 00 01 00 02 ab 03 15 00 00 00 01 00 02 ac 9a 15 00 00 00 01 00 02 ad 03 15 00 00 00 01 00 02 ae ab 15 00 00 00 01 00 02 af 03 15 00 00 00 01 00 02 b0 b6 15 00 00 00 01 00 02 b1 03 15 00 00 00 01 00 02 b2 fe 15 00 00 00 01 00 02 b3 00 15 00 00 00 01 00 02 b4 c8 15 00 00 00 01 00 02 b5 00 15 00 00 00 01 00 02 b6 d3 15 00 00 00 01 00 02 b7 00 15 00 00 00 01 00 02 b8 e7 15 00 00 00 01 00 02 b9 00 15 00 00 00 01 00 02 ba f8 15 00 00 00 01 00 02 bb 01 15 00 00 00 01 00 02 bc 08 15 00 00 00 01 00 02 bd 01 15 00 00 00 01 00 02 be 17 15 00 00 00 01 00 02 bf 01 15 00 00 00 01 00 02 c0 24 15 00 00 00 01 00 02 c1 01 15 00 00 00 01 00 02 c2 30 15 00 00 00 01 00 02 c3 01 15 00 00 00 01 00 02 c4 3c 15 00 00 00 01 00 02 c5 01 15 00 00 00 01 00 02 c6 64 15 00 00 00 01 00 02 c7 01 15 00 00 00 01 00 02 c8 84 15 00 00 00 01 00 02 c9 01 15 00 00 00 01 00 02 ca b8 15 00 00 00 01 00 02 cb 01 15 00 00 00 01 00 02 cc e0 15 00 00 00 01 00 02 cd 02 15 00 00 00 01 00 02 ce 1f 15 00 00 00 01 00 02 cf 02 15 00 00 00 01 00 02 d0 54 15 00 00 00 01 00 02 d1 02 15 00 00 00 01 00 02 d2 56 15 00 00 00 01 00 02 d3 02 15 00 00 00 01 00 02 d4 8a 15 00 00 00 01 00 02 d5 02 15 00 00 00 01 00 02 d6 c1 15 00 00 00 01 00 02 d7 02 15 00 00 00 01 00 02 d8 e1 15 00 00 00 01 00 02 d9 03 15 00 00 00 01 00 02 da 0a 15 00 00 00 01 00 02 db 03 15 00 00 00 01 00 02 dc 33 15 00 00 00 01 00 02 dd 03 15 00 00 00 01 00 02 de 58 15 00 00 00 01 00 02 df 03 15 00 00 00 01 00 02 e0 63 15 00 00 00 01 00 02 e1 03 15 00 00 00 01 00 02 e2 6f 15 00 00 00 01 00 02 e3 03 15 00 00 00 01 00 02 e4 7c 15 00 00 00 01 00 02 e5 03 15 00 00 00 01 00 02 e6 8a 15 00 00 00 01 00 02 e7 03 15 00 00 00 01 00 02 e8 9a 15 00 00 00 01 00 02 e9 03 15 00 00 00 01 00 02 ea ab 15 00 00 00 01 00 02 eb 03 15 00 00 00 01 00 02 ec b6 15 00 00 00 01 00 02 ed 03 15 00 00 00 01 00 02 ee fe 15 00 00 00 01 00 02 ef 00 15 00 00 00 01 00 02 f0 c8 15 00 00 00 01 00 02 f1 00 15 00 00 00 01 00 02 f2 d3 15 00 00 00 01 00 02 f3 00 15 00 00 00 01 00 02 f4 e8 15 00 00 00 01 00 02 f5 00 15 00 00 00 01 00 02 f6 fa 15 00 00 00 01 00 02 f7 01 15 00 00 00 01 00 02 f8 0b 15 00 00 00 01 00 02 f9 01 15 00 00 00 01 00 02 fa 19 15 00 00 00 01 00 02 ff 21 15 00 00 00 01 00 02 fb 01 15 00 00 00 01 00 02 00 01 15 00 00 00 01 00 02 01 27 15 00 00 00 01 00 02 02 01 15 00 00 00 01 00 02 03 34 15 00 00 00 01 00 02 04 01 15 00 00 00 01 00 02 05 3f 15 00 00 00 01 00 02 06 01 15 00 00 00 01 00 02 07 67 15 00 00 00 01 00 02 08 01 15 00 00 00 01 00 02 09 88 15 00 00 00 01 00 02 0a 01 15 00 00 00 01 00 02 0b bb 15 00 00 00 01 00 02 0c 01 15 00 00 00 01 00 02 0d e3 15 00 00 00 01 00 02 0e 02 15 00 00 00 01 00 02 0f 22 15 00 00 00 01 00 02 10 02 15 00 00 00 01 00 02 11 57 15 00 00 00 01 00 02 12 02 15 00 00 00 01 00 02 13 59 15 00 00 00 01 00 02 14 02 15 00 00 00 01 00 02 15 8c 15 00 00 00 01 00 02 16 02 15 00 00 00 01 00 02 17 c3 15 00 00 00 01 00 02 18 02 15 00 00 00 01 00 02 19 e2 15 00 00 00 01 00 02 1a 03 15 00 00 00 01 00 02 1b 0c 15 00 00 00 01 00 02 1c 03 15 00 00 00 01 00 02 1d 35 15 00 00 00 01 00 02 1e 03 15 00 00 00 01 00 02 1f 5b 15 00 00 00 01 00 02 20 03 15 00 00 00 01 00 02 21 67 15 00 00 00 01 00 02 22 03 15 00 00 00 01 00 02 23 73 15 00 00 00 01 00 02 24 03 15 00 00 00 01 00 02 25 82 15 00 00 00 01 00 02 26 03 15 00 00 00 01 00 02 27 93 15 00 00 00 01 00 02 28 03 15 00 00 00 01 00 02 29 a7 15 00 00 00 01 00 02 2a 03 15 00 00 00 01 00 02 2b b8 15 00 00 00 01 00 02 2d 03 15 00 00 00 01 00 02 2f c3 15 00 00 00 01 00 02 30 03 15 00 00 00 01 00 02 31 fe 15 00 00 00 01 00 02 32 00 15 00 00 00 01 00 02 33 c8 15 00 00 00 01 00 02 34 00 15 00 00 00 01 00 02 35 d3 15 00 00 00 01 00 02 36 00 15 00 00 00 01 00 02 37 e8 15 00 00 00 01 00 02 38 00 15 00 00 00 01 00 02 39 fa 15 00 00 00 01 00 02 3a 01 15 00 00 00 01 00 02 3b 0b 15 00 00 00 01 00 02 3d 01 15 00 00 00 01 00 02 3f 19 15 00 00 00 01 00 02 40 01 15 00 00 00 01 00 02 41 27 15 00 00 00 01 00 02 42 01 15 00 00 00 01 00 02 43 34 15 00 00 00 01 00 02 44 01 15 00 00 00 01 00 02 45 3f 15 00 00 00 01 00 02 46 01 15 00 00 00 01 00 02 47 67 15 00 00 00 01 00 02 48 01 15 00 00 00 01 00 02 49 88 15 00 00 00 01 00 02 4a 01 15 00 00 00 01 00 02 4b bb 15 00 00 00 01 00 02 4c 01 15 00 00 00 01 00 02 4d e3 15 00 00 00 01 00 02 4e 02 15 00 00 00 01 00 02 4f 22 15 00 00 00 01 00 02 50 02 15 00 00 00 01 00 02 51 57 15 00 00 00 01 00 02 52 02 15 00 00 00 01 00 02 53 59 15 00 00 00 01 00 02 54 02 15 00 00 00 01 00 02 55 8c 15 00 00 00 01 00 02 56 02 15 00 00 00 01 00 02 58 c3 15 00 00 00 01 00 02 59 02 15 00 00 00 01 00 02 5a e2 15 00 00 00 01 00 02 5b 03 15 00 00 00 01 00 02 5c 0c 15 00 00 00 01 00 02 5d 03 15 00 00 00 01 00 02 5e 35 15 00 00 00 01 00 02 5f 03 15 00 00 00 01 00 02 60 5b 15 00 00 00 01 00 02 61 03 15 00 00 00 01 00 02 62 67 15 00 00 00 01 00 02 63 03 15 00 00 00 01 00 02 64 73 15 00 00 00 01 00 02 65 03 15 00 00 00 01 00 02 66 82 15 00 00 00 01 00 02 67 03 15 00 00 00 01 00 02 68 93 15 00 00 00 01 00 02 69 03 15 00 00 00 01 00 02 6a a7 15 00 00 00 01 00 02 6b 03 15 00 00 00 01 00 02 6c b8 15 00 00 00 01 00 02 6d 03 15 00 00 00 01 00 02 6e c3 15 00 00 00 01 00 02 6f 03 15 00 00 00 01 00 02 70 fe 15 00 00 00 01 00 02 71 02 15 00 00 00 01 00 02 72 34 15 00 00 00 01 00 02 73 02 15 00 00 00 01 00 02 74 35 15 00 00 00 01 00 02 75 02 15 00 00 00 01 00 02 76 37 15 00 00 00 01 00 02 77 02 15 00 00 00 01 00 02 78 39 15 00 00 00 01 00 02 79 02 15 00 00 00 01 00 02 7a 3b 15 00 00 00 01 00 02 7b 02 15 00 00 00 01 00 02 7c 3d 15 00 00 00 01 00 02 7d 02 15 00 00 00 01 00 02 7e 3f 15 00 00 00 01 00 02 7f 02 15 00 00 00 01 00 02 80 41 15 00 00 00 01 00 02 81 02 15 00 00 00 01 00 02 82 42 15 00 00 00 01 00 02 83 02 15 00 00 00 01 00 02 84 4a 15 00 00 00 01 00 02 85 02 15 00 00 00 01 00 02 86 52 15 00 00 00 01 00 02 87 02 15 00 00 00 01 00 02 88 61 15 00 00 00 01 00 02 89 02 15 00 00 00 01 00 02 8a 6f 15 00 00 00 01 00 02 8b 02 15 00 00 00 01 00 02 8c 8d 15 00 00 00 01 00 02 8d 02 15 00 00 00 01 00 02 8e ad 15 00 00 00 01 00 02 8f 02 15 00 00 00 01 00 02 90 ae 15 00 00 00 01 00 02 91 02 15 00 00 00 01 00 02 92 d0 15 00 00 00 01 00 02 93 02 15 00 00 00 01 00 02 94 f9 15 00 00 00 01 00 02 95 03 15 00 00 00 01 00 02 96 17 15 00 00 00 01 00 02 97 03 15 00 00 00 01 00 02 98 4a 15 00 00 00 01 00 02 99 03 15 00 00 00 01 00 02 9a 5f 15 00 00 00 01 00 02 9b 03 15 00 00 00 01 00 02 9c 77 15 00 00 00 01 00 02 9d 03 15 00 00 00 01 00 02 9e 7d 15 00 00 00 01 00 02 9f 03 15 00 00 00 01 00 02 a0 83 15 00 00 00 01 00 02 a2 03 15 00 00 00 01 00 02 a3 89 15 00 00 00 01 00 02 a4 03 15 00 00 00 01 00 02 a5 d9 15 00 00 00 01 00 02 a6 03 15 00 00 00 01 00 02 a7 c8 15 00 00 00 01 00 02 a9 03 15 00 00 00 01 00 02 aa f9 15 00 00 00 01 00 02 ab 03 15 00 00 00 01 00 02 ac fb 15 00 00 00 01 00 02 ad 03 15 00 00 00 01 00 02 ae fe 15 00 00 00 01 00 02 af 02 15 00 00 00 01 00 02 b0 34 15 00 00 00 01 00 02 b1 02 15 00 00 00 01 00 02 b2 35 15 00 00 00 01 00 02 b3 02 15 00 00 00 01 00 02 b4 37 15 00 00 00 01 00 02 b5 02 15 00 00 00 01 00 02 b6 39 15 00 00 00 01 00 02 b7 02 15 00 00 00 01 00 02 b8 3b 15 00 00 00 01 00 02 b9 02 15 00 00 00 01 00 02 ba 3d 15 00 00 00 01 00 02 bb 02 15 00 00 00 01 00 02 bc 3f 15 00 00 00 01 00 02 bd 02 15 00 00 00 01 00 02 be 41 15 00 00 00 01 00 02 bf 02 15 00 00 00 01 00 02 c0 42 15 00 00 00 01 00 02 c1 02 15 00 00 00 01 00 02 c2 4a 15 00 00 00 01 00 02 c3 02 15 00 00 00 01 00 02 c4 52 15 00 00 00 01 00 02 c5 02 15 00 00 00 01 00 02 c6 61 15 00 00 00 01 00 02 c7 02 15 00 00 00 01 00 02 c8 6f 15 00 00 00 01 00 02 c9 02 15 00 00 00 01 00 02 ca 8d 15 00 00 00 01 00 02 cb 02 15 00 00 00 01 00 02 cc ad 15 00 00 00 01 00 02 cd 02 15 00 00 00 01 00 02 ce ae 15 00 00 00 01 00 02 cf 02 15 00 00 00 01 00 02 d0 d0 15 00 00 00 01 00 02 d1 02 15 00 00 00 01 00 02 d2 f9 15 00 00 00 01 00 02 d3 03 15 00 00 00 01 00 02 d4 17 15 00 00 00 01 00 02 d5 03 15 00 00 00 01 00 02 d6 4a 15 00 00 00 01 00 02 d7 03 15 00 00 00 01 00 02 d8 5f 15 00 00 00 01 00 02 d9 03 15 00 00 00 01 00 02 da 77 15 00 00 00 01 00 02 db 03 15 00 00 00 01 00 02 dc 7d 15 00 00 00 01 00 02 dd 03 15 00 00 00 01 00 02 de 83 15 00 00 00 01 00 02 df 03 15 00 00 00 01 00 02 e0 89 15 00 00 00 01 00 02 e1 03 15 00 00 00 01 00 02 e2 d9 15 00 00 00 01 00 02 e3 03 15 00 00 00 01 00 02 e4 c8 15 00 00 00 01 00 02 e5 03 15 00 00 00 01 00 02 e6 f9 15 00 00 00 01 00 02 e7 03 15 00 00 00 01 00 02 e8 fb 15 00 00 00 01 00 02 e9 03 15 00 00 00 01 00 02 ea fe 15 00 00 00 01 00 02 fb 01 15 01 00 00 01 00 02 ff 10];
		qcom,mdss-dsi-dispparam-papermode-state = "dsi_hs_mode";
		qcom,mdss-dsi-dispparam-papermode1-command = [15 01 00 00 78 00 02 ff 20 15 00 00 00 01 00 02 fb 01 15 00 00 00 01 00 02 75 00 15 00 00 00 01 00 02 76 c8 15 00 00 00 01 00 02 77 00 15 00 00 00 01 00 02 78 d3 15 00 00 00 01 00 02 79 00 15 00 00 00 01 00 02 7a e7 15 00 00 00 01 00 02 7b 00 15 00 00 00 01 00 02 7c f8 15 00 00 00 01 00 02 7d 01 15 00 00 00 01 00 02 7e 08 15 00 00 00 01 00 02 7f 01 15 00 00 00 01 00 02 80 17 15 00 00 00 01 00 02 81 01 15 00 00 00 01 00 02 82 24 15 00 00 00 01 00 02 83 01 15 00 00 00 01 00 02 84 30 15 00 00 00 01 00 02 85 01 15 00 00 00 01 00 02 86 3c 15 00 00 00 01 00 02 87 01 15 00 00 00 01 00 02 88 64 15 00 00 00 01 00 02 89 01 15 00 00 00 01 00 02 8a 84 15 00 00 00 01 00 02 8b 01 15 00 00 00 01 00 02 8c b8 15 00 00 00 01 00 02 8d 01 15 00 00 00 01 00 02 8e e0 15 00 00 00 01 00 02 8f 02 15 00 00 00 01 00 02 90 1f 15 00 00 00 01 00 02 91 02 15 00 00 00 01 00 02 92 54 15 00 00 00 01 00 02 93 02 15 00 00 00 01 00 02 94 56 15 00 00 00 01 00 02 95 02 15 00 00 00 01 00 02 96 8a 15 00 00 00 01 00 02 97 02 15 00 00 00 01 00 02 98 c1 15 00 00 00 01 00 02 99 02 15 00 00 00 01 00 02 9a e1 15 00 00 00 01 00 02 9b 03 15 00 00 00 01 00 02 9c 0a 15 00 00 00 01 00 02 9d 03 15 00 00 00 01 00 02 9e 33 15 00 00 00 01 00 02 9f 03 15 00 00 00 01 00 02 a0 58 15 00 00 00 01 00 02 a2 03 15 00 00 00 01 00 02 a3 63 15 00 00 00 01 00 02 a4 03 15 00 00 00 01 00 02 a5 6f 15 00 00 00 01 00 02 a6 03 15 00 00 00 01 00 02 a7 7c 15 00 00 00 01 00 02 a9 03 15 00 00 00 01 00 02 aa 8a 15 00 00 00 01 00 02 ab 03 15 00 00 00 01 00 02 ac 9a 15 00 00 00 01 00 02 ad 03 15 00 00 00 01 00 02 ae ab 15 00 00 00 01 00 02 af 03 15 00 00 00 01 00 02 b0 b6 15 00 00 00 01 00 02 b1 03 15 00 00 00 01 00 02 b2 fe 15 00 00 00 01 00 02 b3 00 15 00 00 00 01 00 02 b4 c8 15 00 00 00 01 00 02 b5 00 15 00 00 00 01 00 02 b6 d3 15 00 00 00 01 00 02 b7 00 15 00 00 00 01 00 02 b8 e7 15 00 00 00 01 00 02 b9 00 15 00 00 00 01 00 02 ba f8 15 00 00 00 01 00 02 bb 01 15 00 00 00 01 00 02 bc 08 15 00 00 00 01 00 02 bd 01 15 00 00 00 01 00 02 be 17 15 00 00 00 01 00 02 bf 01 15 00 00 00 01 00 02 c0 24 15 00 00 00 01 00 02 c1 01 15 00 00 00 01 00 02 c2 30 15 00 00 00 01 00 02 c3 01 15 00 00 00 01 00 02 c4 3c 15 00 00 00 01 00 02 c5 01 15 00 00 00 01 00 02 c6 64 15 00 00 00 01 00 02 c7 01 15 00 00 00 01 00 02 c8 84 15 00 00 00 01 00 02 c9 01 15 00 00 00 01 00 02 ca b8 15 00 00 00 01 00 02 cb 01 15 00 00 00 01 00 02 cc e0 15 00 00 00 01 00 02 cd 02 15 00 00 00 01 00 02 ce 1f 15 00 00 00 01 00 02 cf 02 15 00 00 00 01 00 02 d0 54 15 00 00 00 01 00 02 d1 02 15 00 00 00 01 00 02 d2 56 15 00 00 00 01 00 02 d3 02 15 00 00 00 01 00 02 d4 8a 15 00 00 00 01 00 02 d5 02 15 00 00 00 01 00 02 d6 c1 15 00 00 00 01 00 02 d7 02 15 00 00 00 01 00 02 d8 e1 15 00 00 00 01 00 02 d9 03 15 00 00 00 01 00 02 da 0a 15 00 00 00 01 00 02 db 03 15 00 00 00 01 00 02 dc 33 15 00 00 00 01 00 02 dd 03 15 00 00 00 01 00 02 de 58 15 00 00 00 01 00 02 df 03 15 00 00 00 01 00 02 e0 63 15 00 00 00 01 00 02 e1 03 15 00 00 00 01 00 02 e2 6f 15 00 00 00 01 00 02 e3 03 15 00 00 00 01 00 02 e4 7c 15 00 00 00 01 00 02 e5 03 15 00 00 00 01 00 02 e6 8a 15 00 00 00 01 00 02 e7 03 15 00 00 00 01 00 02 e8 9a 15 00 00 00 01 00 02 e9 03 15 00 00 00 01 00 02 ea ab 15 00 00 00 01 00 02 eb 03 15 00 00 00 01 00 02 ec b6 15 00 00 00 01 00 02 ed 03 15 00 00 00 01 00 02 ee fe 15 00 00 00 01 00 02 ef 00 15 00 00 00 01 00 02 f0 c8 15 00 00 00 01 00 02 f1 00 15 00 00 00 01 00 02 f2 d3 15 00 00 00 01 00 02 f3 00 15 00 00 00 01 00 02 f4 e8 15 00 00 00 01 00 02 f5 00 15 00 00 00 01 00 02 f6 fa 15 00 00 00 01 00 02 f7 01 15 00 00 00 01 00 02 f8 0b 15 00 00 00 01 00 02 f9 01 15 00 00 00 01 00 02 fa 19 15 00 00 00 01 00 02 ff 21 15 00 00 00 01 00 02 fb 01 15 00 00 00 01 00 02 00 01 15 00 00 00 01 00 02 01 27 15 00 00 00 01 00 02 02 01 15 00 00 00 01 00 02 03 34 15 00 00 00 01 00 02 04 01 15 00 00 00 01 00 02 05 3f 15 00 00 00 01 00 02 06 01 15 00 00 00 01 00 02 07 67 15 00 00 00 01 00 02 08 01 15 00 00 00 01 00 02 09 88 15 00 00 00 01 00 02 0a 01 15 00 00 00 01 00 02 0b bb 15 00 00 00 01 00 02 0c 01 15 00 00 00 01 00 02 0d e3 15 00 00 00 01 00 02 0e 02 15 00 00 00 01 00 02 0f 22 15 00 00 00 01 00 02 10 02 15 00 00 00 01 00 02 11 57 15 00 00 00 01 00 02 12 02 15 00 00 00 01 00 02 13 59 15 00 00 00 01 00 02 14 02 15 00 00 00 01 00 02 15 8c 15 00 00 00 01 00 02 16 02 15 00 00 00 01 00 02 17 c3 15 00 00 00 01 00 02 18 02 15 00 00 00 01 00 02 19 e2 15 00 00 00 01 00 02 1a 03 15 00 00 00 01 00 02 1b 0c 15 00 00 00 01 00 02 1c 03 15 00 00 00 01 00 02 1d 35 15 00 00 00 01 00 02 1e 03 15 00 00 00 01 00 02 1f 5b 15 00 00 00 01 00 02 20 03 15 00 00 00 01 00 02 21 67 15 00 00 00 01 00 02 22 03 15 00 00 00 01 00 02 23 73 15 00 00 00 01 00 02 24 03 15 00 00 00 01 00 02 25 82 15 00 00 00 01 00 02 26 03 15 00 00 00 01 00 02 27 93 15 00 00 00 01 00 02 28 03 15 00 00 00 01 00 02 29 a7 15 00 00 00 01 00 02 2a 03 15 00 00 00 01 00 02 2b b8 15 00 00 00 01 00 02 2d 03 15 00 00 00 01 00 02 2f c3 15 00 00 00 01 00 02 30 03 15 00 00 00 01 00 02 31 fe 15 00 00 00 01 00 02 32 00 15 00 00 00 01 00 02 33 c8 15 00 00 00 01 00 02 34 00 15 00 00 00 01 00 02 35 d3 15 00 00 00 01 00 02 36 00 15 00 00 00 01 00 02 37 e8 15 00 00 00 01 00 02 38 00 15 00 00 00 01 00 02 39 fa 15 00 00 00 01 00 02 3a 01 15 00 00 00 01 00 02 3b 0b 15 00 00 00 01 00 02 3d 01 15 00 00 00 01 00 02 3f 19 15 00 00 00 01 00 02 40 01 15 00 00 00 01 00 02 41 27 15 00 00 00 01 00 02 42 01 15 00 00 00 01 00 02 43 34 15 00 00 00 01 00 02 44 01 15 00 00 00 01 00 02 45 3f 15 00 00 00 01 00 02 46 01 15 00 00 00 01 00 02 47 67 15 00 00 00 01 00 02 48 01 15 00 00 00 01 00 02 49 88 15 00 00 00 01 00 02 4a 01 15 00 00 00 01 00 02 4b bb 15 00 00 00 01 00 02 4c 01 15 00 00 00 01 00 02 4d e3 15 00 00 00 01 00 02 4e 02 15 00 00 00 01 00 02 4f 22 15 00 00 00 01 00 02 50 02 15 00 00 00 01 00 02 51 57 15 00 00 00 01 00 02 52 02 15 00 00 00 01 00 02 53 59 15 00 00 00 01 00 02 54 02 15 00 00 00 01 00 02 55 8c 15 00 00 00 01 00 02 56 02 15 00 00 00 01 00 02 58 c3 15 00 00 00 01 00 02 59 02 15 00 00 00 01 00 02 5a e2 15 00 00 00 01 00 02 5b 03 15 00 00 00 01 00 02 5c 0c 15 00 00 00 01 00 02 5d 03 15 00 00 00 01 00 02 5e 35 15 00 00 00 01 00 02 5f 03 15 00 00 00 01 00 02 60 5b 15 00 00 00 01 00 02 61 03 15 00 00 00 01 00 02 62 67 15 00 00 00 01 00 02 63 03 15 00 00 00 01 00 02 64 73 15 00 00 00 01 00 02 65 03 15 00 00 00 01 00 02 66 82 15 00 00 00 01 00 02 67 03 15 00 00 00 01 00 02 68 93 15 00 00 00 01 00 02 69 03 15 00 00 00 01 00 02 6a a7 15 00 00 00 01 00 02 6b 03 15 00 00 00 01 00 02 6c b8 15 00 00 00 01 00 02 6d 03 15 00 00 00 01 00 02 6e c3 15 00 00 00 01 00 02 6f 03 15 00 00 00 01 00 02 70 fe 15 00 00 00 01 00 02 71 01 15 00 00 00 01 00 02 72 52 15 00 00 00 01 00 02 73 01 15 00 00 00 01 00 02 74 56 15 00 00 00 01 00 02 75 01 15 00 00 00 01 00 02 76 5f 15 00 00 00 01 00 02 77 01 15 00 00 00 01 00 02 78 67 15 00 00 00 01 00 02 79 01 15 00 00 00 01 00 02 7a 6f 15 00 00 00 01 00 02 7b 01 15 00 00 00 01 00 02 7c 77 15 00 00 00 01 00 02 7d 01 15 00 00 00 01 00 02 7e 7e 15 00 00 00 01 00 02 7f 01 15 00 00 00 01 00 02 80 85 15 00 00 00 01 00 02 81 01 15 00 00 00 01 00 02 82 8c 15 00 00 00 01 00 02 83 01 15 00 00 00 01 00 02 84 a4 15 00 00 00 01 00 02 85 01 15 00 00 00 01 00 02 86 ba 15 00 00 00 01 00 02 87 01 15 00 00 00 01 00 02 88 df 15 00 00 00 01 00 02 89 01 15 00 00 00 01 00 02 8a ff 15 00 00 00 01 00 02 8b 02 15 00 00 00 01 00 02 8c 34 15 00 00 00 01 00 02 8d 02 15 00 00 00 01 00 02 8e 64 15 00 00 00 01 00 02 8f 02 15 00 00 00 01 00 02 90 65 15 00 00 00 01 00 02 91 02 15 00 00 00 01 00 02 92 95 15 00 00 00 01 00 02 93 02 15 00 00 00 01 00 02 94 ca 15 00 00 00 01 00 02 95 02 15 00 00 00 01 00 02 96 e9 15 00 00 00 01 00 02 97 03 15 00 00 00 01 00 02 98 13 15 00 00 00 01 00 02 99 03 15 00 00 00 01 00 02 9a 3b 15 00 00 00 01 00 02 9b 03 15 00 00 00 01 00 02 9c 5e 15 00 00 00 01 00 02 9d 03 15 00 00 00 01 00 02 9e 69 15 00 00 00 01 00 02 9f 03 15 00 00 00 01 00 02 a0 74 15 00 00 00 01 00 02 a2 03 15 00 00 00 01 00 02 a3 81 15 00 00 00 01 00 02 a4 03 15 00 00 00 01 00 02 a5 8e 15 00 00 00 01 00 02 a6 03 15 00 00 00 01 00 02 a7 9e 15 00 00 00 01 00 02 a9 03 15 00 00 00 01 00 02 aa ad 15 00 00 00 01 00 02 ab 03 15 00 00 00 01 00 02 ac b6 15 00 00 00 01 00 02 ad 03 15 00 00 00 01 00 02 ae fe 15 00 00 00 01 00 02 af 01 15 00 00 00 01 00 02 b0 52 15 00 00 00 01 00 02 b1 01 15 00 00 00 01 00 02 b2 56 15 00 00 00 01 00 02 b3 01 15 00 00 00 01 00 02 b4 5f 15 00 00 00 01 00 02 b5 01 15 00 00 00 01 00 02 b6 67 15 00 00 00 01 00 02 b7 01 15 00 00 00 01 00 02 b8 6f 15 00 00 00 01 00 02 b9 01 15 00 00 00 01 00 02 ba 77 15 00 00 00 01 00 02 bb 01 15 00 00 00 01 00 02 bc 7e 15 00 00 00 01 00 02 bd 01 15 00 00 00 01 00 02 be 85 15 00 00 00 01 00 02 bf 01 15 00 00 00 01 00 02 c0 8c 15 00 00 00 01 00 02 c1 01 15 00 00 00 01 00 02 c2 a4 15 00 00 00 01 00 02 c3 01 15 00 00 00 01 00 02 c4 ba 15 00 00 00 01 00 02 c5 01 15 00 00 00 01 00 02 c6 df 15 00 00 00 01 00 02 c7 01 15 00 00 00 01 00 02 c8 ff 15 00 00 00 01 00 02 c9 02 15 00 00 00 01 00 02 ca 34 15 00 00 00 01 00 02 cb 02 15 00 00 00 01 00 02 cc 64 15 00 00 00 01 00 02 cd 02 15 00 00 00 01 00 02 ce 65 15 00 00 00 01 00 02 cf 02 15 00 00 00 01 00 02 d0 95 15 00 00 00 01 00 02 d1 02 15 00 00 00 01 00 02 d2 ca 15 00 00 00 01 00 02 d3 02 15 00 00 00 01 00 02 d4 e9 15 00 00 00 01 00 02 d5 03 15 00 00 00 01 00 02 d6 13 15 00 00 00 01 00 02 d7 03 15 00 00 00 01 00 02 d8 3b 15 00 00 00 01 00 02 d9 03 15 00 00 00 01 00 02 da 5e 15 00 00 00 01 00 02 db 03 15 00 00 00 01 00 02 dc 69 15 00 00 00 01 00 02 dd 03 15 00 00 00 01 00 02 de 74 15 00 00 00 01 00 02 df 03 15 00 00 00 01 00 02 e0 81 15 00 00 00 01 00 02 e1 03 15 00 00 00 01 00 02 e2 8e 15 00 00 00 01 00 02 e3 03 15 00 00 00 01 00 02 e4 9e 15 00 00 00 01 00 02 e5 03 15 00 00 00 01 00 02 e6 ad 15 00 00 00 01 00 02 e7 03 15 00 00 00 01 00 02 e8 b6 15 00 00 00 01 00 02 e9 03 15 00 00 00 01 00 02 ea fe 15 00 00 00 01 00 02 fb 01 15 01 00 00 01 00 02 ff 10];
		qcom,mdss-dsi-dispparam-papermode1-state = "dsi_hs_mode";
		qcom,mdss-dsi-dispparam-papermode2-command = [15 01 00 00 78 00 02 ff 20 15 00 00 00 01 00 02 fb 01 15 00 00 00 01 00 02 75 00 15 00 00 00 01 00 02 76 c8 15 00 00 00 01 00 02 77 00 15 00 00 00 01 00 02 78 d3 15 00 00 00 01 00 02 79 00 15 00 00 00 01 00 02 7a e7 15 00 00 00 01 00 02 7b 00 15 00 00 00 01 00 02 7c f8 15 00 00 00 01 00 02 7d 01 15 00 00 00 01 00 02 7e 08 15 00 00 00 01 00 02 7f 01 15 00 00 00 01 00 02 80 17 15 00 00 00 01 00 02 81 01 15 00 00 00 01 00 02 82 24 15 00 00 00 01 00 02 83 01 15 00 00 00 01 00 02 84 30 15 00 00 00 01 00 02 85 01 15 00 00 00 01 00 02 86 3c 15 00 00 00 01 00 02 87 01 15 00 00 00 01 00 02 88 64 15 00 00 00 01 00 02 89 01 15 00 00 00 01 00 02 8a 84 15 00 00 00 01 00 02 8b 01 15 00 00 00 01 00 02 8c b8 15 00 00 00 01 00 02 8d 01 15 00 00 00 01 00 02 8e e0 15 00 00 00 01 00 02 8f 02 15 00 00 00 01 00 02 90 1f 15 00 00 00 01 00 02 91 02 15 00 00 00 01 00 02 92 54 15 00 00 00 01 00 02 93 02 15 00 00 00 01 00 02 94 56 15 00 00 00 01 00 02 95 02 15 00 00 00 01 00 02 96 8a 15 00 00 00 01 00 02 97 02 15 00 00 00 01 00 02 98 c1 15 00 00 00 01 00 02 99 02 15 00 00 00 01 00 02 9a e1 15 00 00 00 01 00 02 9b 03 15 00 00 00 01 00 02 9c 0a 15 00 00 00 01 00 02 9d 03 15 00 00 00 01 00 02 9e 33 15 00 00 00 01 00 02 9f 03 15 00 00 00 01 00 02 a0 58 15 00 00 00 01 00 02 a2 03 15 00 00 00 01 00 02 a3 63 15 00 00 00 01 00 02 a4 03 15 00 00 00 01 00 02 a5 6f 15 00 00 00 01 00 02 a6 03 15 00 00 00 01 00 02 a7 7c 15 00 00 00 01 00 02 a9 03 15 00 00 00 01 00 02 aa 8a 15 00 00 00 01 00 02 ab 03 15 00 00 00 01 00 02 ac 9a 15 00 00 00 01 00 02 ad 03 15 00 00 00 01 00 02 ae ab 15 00 00 00 01 00 02 af 03 15 00 00 00 01 00 02 b0 b6 15 00 00 00 01 00 02 b1 03 15 00 00 00 01 00 02 b2 fe 15 00 00 00 01 00 02 b3 00 15 00 00 00 01 00 02 b4 c8 15 00 00 00 01 00 02 b5 00 15 00 00 00 01 00 02 b6 d3 15 00 00 00 01 00 02 b7 00 15 00 00 00 01 00 02 b8 e7 15 00 00 00 01 00 02 b9 00 15 00 00 00 01 00 02 ba f8 15 00 00 00 01 00 02 bb 01 15 00 00 00 01 00 02 bc 08 15 00 00 00 01 00 02 bd 01 15 00 00 00 01 00 02 be 17 15 00 00 00 01 00 02 bf 01 15 00 00 00 01 00 02 c0 24 15 00 00 00 01 00 02 c1 01 15 00 00 00 01 00 02 c2 30 15 00 00 00 01 00 02 c3 01 15 00 00 00 01 00 02 c4 3c 15 00 00 00 01 00 02 c5 01 15 00 00 00 01 00 02 c6 64 15 00 00 00 01 00 02 c7 01 15 00 00 00 01 00 02 c8 84 15 00 00 00 01 00 02 c9 01 15 00 00 00 01 00 02 ca b8 15 00 00 00 01 00 02 cb 01 15 00 00 00 01 00 02 cc e0 15 00 00 00 01 00 02 cd 02 15 00 00 00 01 00 02 ce 1f 15 00 00 00 01 00 02 cf 02 15 00 00 00 01 00 02 d0 54 15 00 00 00 01 00 02 d1 02 15 00 00 00 01 00 02 d2 56 15 00 00 00 01 00 02 d3 02 15 00 00 00 01 00 02 d4 8a 15 00 00 00 01 00 02 d5 02 15 00 00 00 01 00 02 d6 c1 15 00 00 00 01 00 02 d7 02 15 00 00 00 01 00 02 d8 e1 15 00 00 00 01 00 02 d9 03 15 00 00 00 01 00 02 da 0a 15 00 00 00 01 00 02 db 03 15 00 00 00 01 00 02 dc 33 15 00 00 00 01 00 02 dd 03 15 00 00 00 01 00 02 de 58 15 00 00 00 01 00 02 df 03 15 00 00 00 01 00 02 e0 63 15 00 00 00 01 00 02 e1 03 15 00 00 00 01 00 02 e2 6f 15 00 00 00 01 00 02 e3 03 15 00 00 00 01 00 02 e4 7c 15 00 00 00 01 00 02 e5 03 15 00 00 00 01 00 02 e6 8a 15 00 00 00 01 00 02 e7 03 15 00 00 00 01 00 02 e8 9a 15 00 00 00 01 00 02 e9 03 15 00 00 00 01 00 02 ea ab 15 00 00 00 01 00 02 eb 03 15 00 00 00 01 00 02 ec b6 15 00 00 00 01 00 02 ed 03 15 00 00 00 01 00 02 ee fe 15 00 00 00 01 00 02 ef 00 15 00 00 00 01 00 02 f0 c8 15 00 00 00 01 00 02 f1 00 15 00 00 00 01 00 02 f2 d3 15 00 00 00 01 00 02 f3 00 15 00 00 00 01 00 02 f4 e8 15 00 00 00 01 00 02 f5 00 15 00 00 00 01 00 02 f6 fa 15 00 00 00 01 00 02 f7 01 15 00 00 00 01 00 02 f8 0b 15 00 00 00 01 00 02 f9 01 15 00 00 00 01 00 02 fa 19 15 00 00 00 01 00 02 ff 21 15 00 00 00 01 00 02 fb 01 15 00 00 00 01 00 02 00 01 15 00 00 00 01 00 02 01 27 15 00 00 00 01 00 02 02 01 15 00 00 00 01 00 02 03 34 15 00 00 00 01 00 02 04 01 15 00 00 00 01 00 02 05 3f 15 00 00 00 01 00 02 06 01 15 00 00 00 01 00 02 07 67 15 00 00 00 01 00 02 08 01 15 00 00 00 01 00 02 09 88 15 00 00 00 01 00 02 0a 01 15 00 00 00 01 00 02 0b bb 15 00 00 00 01 00 02 0c 01 15 00 00 00 01 00 02 0d e3 15 00 00 00 01 00 02 0e 02 15 00 00 00 01 00 02 0f 22 15 00 00 00 01 00 02 10 02 15 00 00 00 01 00 02 11 57 15 00 00 00 01 00 02 12 02 15 00 00 00 01 00 02 13 59 15 00 00 00 01 00 02 14 02 15 00 00 00 01 00 02 15 8c 15 00 00 00 01 00 02 16 02 15 00 00 00 01 00 02 17 c3 15 00 00 00 01 00 02 18 02 15 00 00 00 01 00 02 19 e2 15 00 00 00 01 00 02 1a 03 15 00 00 00 01 00 02 1b 0c 15 00 00 00 01 00 02 1c 03 15 00 00 00 01 00 02 1d 35 15 00 00 00 01 00 02 1e 03 15 00 00 00 01 00 02 1f 5b 15 00 00 00 01 00 02 20 03 15 00 00 00 01 00 02 21 67 15 00 00 00 01 00 02 22 03 15 00 00 00 01 00 02 23 73 15 00 00 00 01 00 02 24 03 15 00 00 00 01 00 02 25 82 15 00 00 00 01 00 02 26 03 15 00 00 00 01 00 02 27 93 15 00 00 00 01 00 02 28 03 15 00 00 00 01 00 02 29 a7 15 00 00 00 01 00 02 2a 03 15 00 00 00 01 00 02 2b b8 15 00 00 00 01 00 02 2d 03 15 00 00 00 01 00 02 2f c3 15 00 00 00 01 00 02 30 03 15 00 00 00 01 00 02 31 fe 15 00 00 00 01 00 02 32 00 15 00 00 00 01 00 02 33 c8 15 00 00 00 01 00 02 34 00 15 00 00 00 01 00 02 35 d3 15 00 00 00 01 00 02 36 00 15 00 00 00 01 00 02 37 e8 15 00 00 00 01 00 02 38 00 15 00 00 00 01 00 02 39 fa 15 00 00 00 01 00 02 3a 01 15 00 00 00 01 00 02 3b 0b 15 00 00 00 01 00 02 3d 01 15 00 00 00 01 00 02 3f 19 15 00 00 00 01 00 02 40 01 15 00 00 00 01 00 02 41 27 15 00 00 00 01 00 02 42 01 15 00 00 00 01 00 02 43 34 15 00 00 00 01 00 02 44 01 15 00 00 00 01 00 02 45 3f 15 00 00 00 01 00 02 46 01 15 00 00 00 01 00 02 47 67 15 00 00 00 01 00 02 48 01 15 00 00 00 01 00 02 49 88 15 00 00 00 01 00 02 4a 01 15 00 00 00 01 00 02 4b bb 15 00 00 00 01 00 02 4c 01 15 00 00 00 01 00 02 4d e3 15 00 00 00 01 00 02 4e 02 15 00 00 00 01 00 02 4f 22 15 00 00 00 01 00 02 50 02 15 00 00 00 01 00 02 51 57 15 00 00 00 01 00 02 52 02 15 00 00 00 01 00 02 53 59 15 00 00 00 01 00 02 54 02 15 00 00 00 01 00 02 55 8c 15 00 00 00 01 00 02 56 02 15 00 00 00 01 00 02 58 c3 15 00 00 00 01 00 02 59 02 15 00 00 00 01 00 02 5a e2 15 00 00 00 01 00 02 5b 03 15 00 00 00 01 00 02 5c 0c 15 00 00 00 01 00 02 5d 03 15 00 00 00 01 00 02 5e 35 15 00 00 00 01 00 02 5f 03 15 00 00 00 01 00 02 60 5b 15 00 00 00 01 00 02 61 03 15 00 00 00 01 00 02 62 67 15 00 00 00 01 00 02 63 03 15 00 00 00 01 00 02 64 73 15 00 00 00 01 00 02 65 03 15 00 00 00 01 00 02 66 82 15 00 00 00 01 00 02 67 03 15 00 00 00 01 00 02 68 93 15 00 00 00 01 00 02 69 03 15 00 00 00 01 00 02 6a a7 15 00 00 00 01 00 02 6b 03 15 00 00 00 01 00 02 6c b8 15 00 00 00 01 00 02 6d 03 15 00 00 00 01 00 02 6e c3 15 00 00 00 01 00 02 6f 03 15 00 00 00 01 00 02 70 fe 15 00 00 00 01 00 02 71 01 15 00 00 00 01 00 02 72 82 15 00 00 00 01 00 02 73 01 15 00 00 00 01 00 02 74 85 15 00 00 00 01 00 02 75 01 15 00 00 00 01 00 02 76 8c 15 00 00 00 01 00 02 77 01 15 00 00 00 01 00 02 78 92 15 00 00 00 01 00 02 79 01 15 00 00 00 01 00 02 7a 98 15 00 00 00 01 00 02 7b 01 15 00 00 00 01 00 02 7c 9e 15 00 00 00 01 00 02 7d 01 15 00 00 00 01 00 02 7e a3 15 00 00 00 01 00 02 7f 01 15 00 00 00 01 00 02 80 a9 15 00 00 00 01 00 02 81 01 15 00 00 00 01 00 02 82 ae 15 00 00 00 01 00 02 83 01 15 00 00 00 01 00 02 84 c2 15 00 00 00 01 00 02 85 01 15 00 00 00 01 00 02 86 d4 15 00 00 00 01 00 02 87 01 15 00 00 00 01 00 02 88 f3 15 00 00 00 01 00 02 89 02 15 00 00 00 01 00 02 8a 0f 15 00 00 00 01 00 02 8b 02 15 00 00 00 01 00 02 8c 3f 15 00 00 00 01 00 02 8d 02 15 00 00 00 01 00 02 8e 6d 15 00 00 00 01 00 02 8f 02 15 00 00 00 01 00 02 90 6e 15 00 00 00 01 00 02 91 02 15 00 00 00 01 00 02 92 9c 15 00 00 00 01 00 02 93 02 15 00 00 00 01 00 02 94 cf 15 00 00 00 01 00 02 95 02 15 00 00 00 01 00 02 96 ed 15 00 00 00 01 00 02 97 03 15 00 00 00 01 00 02 98 22 15 00 00 00 01 00 02 99 03 15 00 00 00 01 00 02 9a 3f 15 00 00 00 01 00 02 9b 03 15 00 00 00 01 00 02 9c 62 15 00 00 00 01 00 02 9d 03 15 00 00 00 01 00 02 9e 6c 15 00 00 00 01 00 02 9f 03 15 00 00 00 01 00 02 a0 77 15 00 00 00 01 00 02 a2 03 15 00 00 00 01 00 02 a3 83 15 00 00 00 01 00 02 a4 03 15 00 00 00 01 00 02 a5 91 15 00 00 00 01 00 02 a6 03 15 00 00 00 01 00 02 a7 9f 15 00 00 00 01 00 02 a9 03 15 00 00 00 01 00 02 aa ae 15 00 00 00 01 00 02 ab 03 15 00 00 00 01 00 02 ac b7 15 00 00 00 01 00 02 ad 03 15 00 00 00 01 00 02 ae fe 15 00 00 00 01 00 02 af 01 15 00 00 00 01 00 02 b0 82 15 00 00 00 01 00 02 b1 01 15 00 00 00 01 00 02 b2 85 15 00 00 00 01 00 02 b3 01 15 00 00 00 01 00 02 b4 8c 15 00 00 00 01 00 02 b5 01 15 00 00 00 01 00 02 b6 92 15 00 00 00 01 00 02 b7 01 15 00 00 00 01 00 02 b8 98 15 00 00 00 01 00 02 b9 01 15 00 00 00 01 00 02 ba 9e 15 00 00 00 01 00 02 bb 01 15 00 00 00 01 00 02 bc a3 15 00 00 00 01 00 02 bd 01 15 00 00 00 01 00 02 be a9 15 00 00 00 01 00 02 bf 01 15 00 00 00 01 00 02 c0 ae 15 00 00 00 01 00 02 c1 01 15 00 00 00 01 00 02 c2 c2 15 00 00 00 01 00 02 c3 01 15 00 00 00 01 00 02 c4 d4 15 00 00 00 01 00 02 c5 01 15 00 00 00 01 00 02 c6 f3 15 00 00 00 01 00 02 c7 02 15 00 00 00 01 00 02 c8 0f 15 00 00 00 01 00 02 c9 02 15 00 00 00 01 00 02 ca 3f 15 00 00 00 01 00 02 cb 02 15 00 00 00 01 00 02 cc 6d 15 00 00 00 01 00 02 cd 02 15 00 00 00 01 00 02 ce 6e 15 00 00 00 01 00 02 cf 02 15 00 00 00 01 00 02 d0 9c 15 00 00 00 01 00 02 d1 02 15 00 00 00 01 00 02 d2 cf 15 00 00 00 01 00 02 d3 02 15 00 00 00 01 00 02 d4 ed 15 00 00 00 01 00 02 d5 03 15 00 00 00 01 00 02 d6 22 15 00 00 00 01 00 02 d7 03 15 00 00 00 01 00 02 d8 3f 15 00 00 00 01 00 02 d9 03 15 00 00 00 01 00 02 da 62 15 00 00 00 01 00 02 db 03 15 00 00 00 01 00 02 dc 6c 15 00 00 00 01 00 02 dd 03 15 00 00 00 01 00 02 de 77 15 00 00 00 01 00 02 df 03 15 00 00 00 01 00 02 e0 83 15 00 00 00 01 00 02 e1 03 15 00 00 00 01 00 02 e2 91 15 00 00 00 01 00 02 e3 03 15 00 00 00 01 00 02 e4 9f 15 00 00 00 01 00 02 e5 03 15 00 00 00 01 00 02 e6 ae 15 00 00 00 01 00 02 e7 03 15 00 00 00 01 00 02 e8 b7 15 00 00 00 01 00 02 e9 03 15 00 00 00 01 00 02 ea fe 15 00 00 00 01 00 02 fb 01 15 01 00 00 01 00 02 ff 10];
		qcom,mdss-dsi-dispparam-papermode2-state = "dsi_hs_mode";
		qcom,mdss-dsi-dispparam-papermode3-command = [15 01 00 00 78 00 02 ff 20 15 00 00 00 01 00 02 fb 01 15 00 00 00 01 00 02 75 00 15 00 00 00 01 00 02 76 c8 15 00 00 00 01 00 02 77 00 15 00 00 00 01 00 02 78 d3 15 00 00 00 01 00 02 79 00 15 00 00 00 01 00 02 7a e7 15 00 00 00 01 00 02 7b 00 15 00 00 00 01 00 02 7c f8 15 00 00 00 01 00 02 7d 01 15 00 00 00 01 00 02 7e 08 15 00 00 00 01 00 02 7f 01 15 00 00 00 01 00 02 80 17 15 00 00 00 01 00 02 81 01 15 00 00 00 01 00 02 82 24 15 00 00 00 01 00 02 83 01 15 00 00 00 01 00 02 84 30 15 00 00 00 01 00 02 85 01 15 00 00 00 01 00 02 86 3c 15 00 00 00 01 00 02 87 01 15 00 00 00 01 00 02 88 64 15 00 00 00 01 00 02 89 01 15 00 00 00 01 00 02 8a 84 15 00 00 00 01 00 02 8b 01 15 00 00 00 01 00 02 8c b8 15 00 00 00 01 00 02 8d 01 15 00 00 00 01 00 02 8e e0 15 00 00 00 01 00 02 8f 02 15 00 00 00 01 00 02 90 1f 15 00 00 00 01 00 02 91 02 15 00 00 00 01 00 02 92 54 15 00 00 00 01 00 02 93 02 15 00 00 00 01 00 02 94 56 15 00 00 00 01 00 02 95 02 15 00 00 00 01 00 02 96 8a 15 00 00 00 01 00 02 97 02 15 00 00 00 01 00 02 98 c1 15 00 00 00 01 00 02 99 02 15 00 00 00 01 00 02 9a e1 15 00 00 00 01 00 02 9b 03 15 00 00 00 01 00 02 9c 0a 15 00 00 00 01 00 02 9d 03 15 00 00 00 01 00 02 9e 33 15 00 00 00 01 00 02 9f 03 15 00 00 00 01 00 02 a0 58 15 00 00 00 01 00 02 a2 03 15 00 00 00 01 00 02 a3 63 15 00 00 00 01 00 02 a4 03 15 00 00 00 01 00 02 a5 6f 15 00 00 00 01 00 02 a6 03 15 00 00 00 01 00 02 a7 7c 15 00 00 00 01 00 02 a9 03 15 00 00 00 01 00 02 aa 8a 15 00 00 00 01 00 02 ab 03 15 00 00 00 01 00 02 ac 9a 15 00 00 00 01 00 02 ad 03 15 00 00 00 01 00 02 ae ab 15 00 00 00 01 00 02 af 03 15 00 00 00 01 00 02 b0 b6 15 00 00 00 01 00 02 b1 03 15 00 00 00 01 00 02 b2 fe 15 00 00 00 01 00 02 b3 00 15 00 00 00 01 00 02 b4 c8 15 00 00 00 01 00 02 b5 00 15 00 00 00 01 00 02 b6 d3 15 00 00 00 01 00 02 b7 00 15 00 00 00 01 00 02 b8 e7 15 00 00 00 01 00 02 b9 00 15 00 00 00 01 00 02 ba f8 15 00 00 00 01 00 02 bb 01 15 00 00 00 01 00 02 bc 08 15 00 00 00 01 00 02 bd 01 15 00 00 00 01 00 02 be 17 15 00 00 00 01 00 02 bf 01 15 00 00 00 01 00 02 c0 24 15 00 00 00 01 00 02 c1 01 15 00 00 00 01 00 02 c2 30 15 00 00 00 01 00 02 c3 01 15 00 00 00 01 00 02 c4 3c 15 00 00 00 01 00 02 c5 01 15 00 00 00 01 00 02 c6 64 15 00 00 00 01 00 02 c7 01 15 00 00 00 01 00 02 c8 84 15 00 00 00 01 00 02 c9 01 15 00 00 00 01 00 02 ca b8 15 00 00 00 01 00 02 cb 01 15 00 00 00 01 00 02 cc e0 15 00 00 00 01 00 02 cd 02 15 00 00 00 01 00 02 ce 1f 15 00 00 00 01 00 02 cf 02 15 00 00 00 01 00 02 d0 54 15 00 00 00 01 00 02 d1 02 15 00 00 00 01 00 02 d2 56 15 00 00 00 01 00 02 d3 02 15 00 00 00 01 00 02 d4 8a 15 00 00 00 01 00 02 d5 02 15 00 00 00 01 00 02 d6 c1 15 00 00 00 01 00 02 d7 02 15 00 00 00 01 00 02 d8 e1 15 00 00 00 01 00 02 d9 03 15 00 00 00 01 00 02 da 0a 15 00 00 00 01 00 02 db 03 15 00 00 00 01 00 02 dc 33 15 00 00 00 01 00 02 dd 03 15 00 00 00 01 00 02 de 58 15 00 00 00 01 00 02 df 03 15 00 00 00 01 00 02 e0 63 15 00 00 00 01 00 02 e1 03 15 00 00 00 01 00 02 e2 6f 15 00 00 00 01 00 02 e3 03 15 00 00 00 01 00 02 e4 7c 15 00 00 00 01 00 02 e5 03 15 00 00 00 01 00 02 e6 8a 15 00 00 00 01 00 02 e7 03 15 00 00 00 01 00 02 e8 9a 15 00 00 00 01 00 02 e9 03 15 00 00 00 01 00 02 ea ab 15 00 00 00 01 00 02 eb 03 15 00 00 00 01 00 02 ec b6 15 00 00 00 01 00 02 ed 03 15 00 00 00 01 00 02 ee fe 15 00 00 00 01 00 02 ef 00 15 00 00 00 01 00 02 f0 c8 15 00 00 00 01 00 02 f1 00 15 00 00 00 01 00 02 f2 d3 15 00 00 00 01 00 02 f3 00 15 00 00 00 01 00 02 f4 e8 15 00 00 00 01 00 02 f5 00 15 00 00 00 01 00 02 f6 fa 15 00 00 00 01 00 02 f7 01 15 00 00 00 01 00 02 f8 0b 15 00 00 00 01 00 02 f9 01 15 00 00 00 01 00 02 fa 19 15 00 00 00 01 00 02 ff 21 15 00 00 00 01 00 02 fb 01 15 00 00 00 01 00 02 00 01 15 00 00 00 01 00 02 01 27 15 00 00 00 01 00 02 02 01 15 00 00 00 01 00 02 03 34 15 00 00 00 01 00 02 04 01 15 00 00 00 01 00 02 05 3f 15 00 00 00 01 00 02 06 01 15 00 00 00 01 00 02 07 67 15 00 00 00 01 00 02 08 01 15 00 00 00 01 00 02 09 88 15 00 00 00 01 00 02 0a 01 15 00 00 00 01 00 02 0b bb 15 00 00 00 01 00 02 0c 01 15 00 00 00 01 00 02 0d e3 15 00 00 00 01 00 02 0e 02 15 00 00 00 01 00 02 0f 22 15 00 00 00 01 00 02 10 02 15 00 00 00 01 00 02 11 57 15 00 00 00 01 00 02 12 02 15 00 00 00 01 00 02 13 59 15 00 00 00 01 00 02 14 02 15 00 00 00 01 00 02 15 8c 15 00 00 00 01 00 02 16 02 15 00 00 00 01 00 02 17 c3 15 00 00 00 01 00 02 18 02 15 00 00 00 01 00 02 19 e2 15 00 00 00 01 00 02 1a 03 15 00 00 00 01 00 02 1b 0c 15 00 00 00 01 00 02 1c 03 15 00 00 00 01 00 02 1d 35 15 00 00 00 01 00 02 1e 03 15 00 00 00 01 00 02 1f 5b 15 00 00 00 01 00 02 20 03 15 00 00 00 01 00 02 21 67 15 00 00 00 01 00 02 22 03 15 00 00 00 01 00 02 23 73 15 00 00 00 01 00 02 24 03 15 00 00 00 01 00 02 25 82 15 00 00 00 01 00 02 26 03 15 00 00 00 01 00 02 27 93 15 00 00 00 01 00 02 28 03 15 00 00 00 01 00 02 29 a7 15 00 00 00 01 00 02 2a 03 15 00 00 00 01 00 02 2b b8 15 00 00 00 01 00 02 2d 03 15 00 00 00 01 00 02 2f c3 15 00 00 00 01 00 02 30 03 15 00 00 00 01 00 02 31 fe 15 00 00 00 01 00 02 32 00 15 00 00 00 01 00 02 33 c8 15 00 00 00 01 00 02 34 00 15 00 00 00 01 00 02 35 d3 15 00 00 00 01 00 02 36 00 15 00 00 00 01 00 02 37 e8 15 00 00 00 01 00 02 38 00 15 00 00 00 01 00 02 39 fa 15 00 00 00 01 00 02 3a 01 15 00 00 00 01 00 02 3b 0b 15 00 00 00 01 00 02 3d 01 15 00 00 00 01 00 02 3f 19 15 00 00 00 01 00 02 40 01 15 00 00 00 01 00 02 41 27 15 00 00 00 01 00 02 42 01 15 00 00 00 01 00 02 43 34 15 00 00 00 01 00 02 44 01 15 00 00 00 01 00 02 45 3f 15 00 00 00 01 00 02 46 01 15 00 00 00 01 00 02 47 67 15 00 00 00 01 00 02 48 01 15 00 00 00 01 00 02 49 88 15 00 00 00 01 00 02 4a 01 15 00 00 00 01 00 02 4b bb 15 00 00 00 01 00 02 4c 01 15 00 00 00 01 00 02 4d e3 15 00 00 00 01 00 02 4e 02 15 00 00 00 01 00 02 4f 22 15 00 00 00 01 00 02 50 02 15 00 00 00 01 00 02 51 57 15 00 00 00 01 00 02 52 02 15 00 00 00 01 00 02 53 59 15 00 00 00 01 00 02 54 02 15 00 00 00 01 00 02 55 8c 15 00 00 00 01 00 02 56 02 15 00 00 00 01 00 02 58 c3 15 00 00 00 01 00 02 59 02 15 00 00 00 01 00 02 5a e2 15 00 00 00 01 00 02 5b 03 15 00 00 00 01 00 02 5c 0c 15 00 00 00 01 00 02 5d 03 15 00 00 00 01 00 02 5e 35 15 00 00 00 01 00 02 5f 03 15 00 00 00 01 00 02 60 5b 15 00 00 00 01 00 02 61 03 15 00 00 00 01 00 02 62 67 15 00 00 00 01 00 02 63 03 15 00 00 00 01 00 02 64 73 15 00 00 00 01 00 02 65 03 15 00 00 00 01 00 02 66 82 15 00 00 00 01 00 02 67 03 15 00 00 00 01 00 02 68 93 15 00 00 00 01 00 02 69 03 15 00 00 00 01 00 02 6a a7 15 00 00 00 01 00 02 6b 03 15 00 00 00 01 00 02 6c b8 15 00 00 00 01 00 02 6d 03 15 00 00 00 01 00 02 6e c3 15 00 00 00 01 00 02 6f 03 15 00 00 00 01 00 02 70 fe 15 00 00 00 01 00 02 71 01 15 00 00 00 01 00 02 72 b2 15 00 00 00 01 00 02 73 01 15 00 00 00 01 00 02 74 b4 15 00 00 00 01 00 02 75 01 15 00 00 00 01 00 02 76 b9 15 00 00 00 01 00 02 77 01 15 00 00 00 01 00 02 78 be 15 00 00 00 01 00 02 79 01 15 00 00 00 01 00 02 7a c2 15 00 00 00 01 00 02 7b 01 15 00 00 00 01 00 02 7c c6 15 00 00 00 01 00 02 7d 01 15 00 00 00 01 00 02 7e cb 15 00 00 00 01 00 02 7f 01 15 00 00 00 01 00 02 80 cf 15 00 00 00 01 00 02 81 01 15 00 00 00 01 00 02 82 d3 15 00 00 00 01 00 02 83 01 15 00 00 00 01 00 02 84 e2 15 00 00 00 01 00 02 85 01 15 00 00 00 01 00 02 86 f0 15 00 00 00 01 00 02 87 02 15 00 00 00 01 00 02 88 0b 15 00 00 00 01 00 02 89 02 15 00 00 00 01 00 02 8a 22 15 00 00 00 01 00 02 8b 02 15 00 00 00 01 00 02 8c 4e 15 00 00 00 01 00 02 8d 02 15 00 00 00 01 00 02 8e 79 15 00 00 00 01 00 02 8f 02 15 00 00 00 01 00 02 90 7a 15 00 00 00 01 00 02 91 02 15 00 00 00 01 00 02 92 a6 15 00 00 00 01 00 02 93 02 15 00 00 00 01 00 02 94 d6 15 00 00 00 01 00 02 95 02 15 00 00 00 01 00 02 96 f4 15 00 00 00 01 00 02 97 03 15 00 00 00 01 00 02 98 29 15 00 00 00 01 00 02 99 03 15 00 00 00 01 00 02 9a 45 15 00 00 00 01 00 02 9b 03 15 00 00 00 01 00 02 9c 67 15 00 00 00 01 00 02 9d 03 15 00 00 00 01 00 02 9e 71 15 00 00 00 01 00 02 9f 03 15 00 00 00 01 00 02 a0 7b 15 00 00 00 01 00 02 a2 03 15 00 00 00 01 00 02 a3 87 15 00 00 00 01 00 02 a4 03 15 00 00 00 01 00 02 a5 94 15 00 00 00 01 00 02 a6 03 15 00 00 00 01 00 02 a7 a2 15 00 00 00 01 00 02 a9 03 15 00 00 00 01 00 02 aa af 15 00 00 00 01 00 02 ab 03 15 00 00 00 01 00 02 ac b7 15 00 00 00 01 00 02 ad 03 15 00 00 00 01 00 02 ae fe 15 00 00 00 01 00 02 af 01 15 00 00 00 01 00 02 b0 b2 15 00 00 00 01 00 02 b1 01 15 00 00 00 01 00 02 b2 b4 15 00 00 00 01 00 02 b3 01 15 00 00 00 01 00 02 b4 b9 15 00 00 00 01 00 02 b5 01 15 00 00 00 01 00 02 b6 be 15 00 00 00 01 00 02 b7 01 15 00 00 00 01 00 02 b8 c2 15 00 00 00 01 00 02 b9 01 15 00 00 00 01 00 02 ba c6 15 00 00 00 01 00 02 bb 01 15 00 00 00 01 00 02 bc cb 15 00 00 00 01 00 02 bd 01 15 00 00 00 01 00 02 be cf 15 00 00 00 01 00 02 bf 01 15 00 00 00 01 00 02 c0 d3 15 00 00 00 01 00 02 c1 01 15 00 00 00 01 00 02 c2 e2 15 00 00 00 01 00 02 c3 01 15 00 00 00 01 00 02 c4 f0 15 00 00 00 01 00 02 c5 02 15 00 00 00 01 00 02 c6 0b 15 00 00 00 01 00 02 c7 02 15 00 00 00 01 00 02 c8 22 15 00 00 00 01 00 02 c9 02 15 00 00 00 01 00 02 ca 4e 15 00 00 00 01 00 02 cb 02 15 00 00 00 01 00 02 cc 79 15 00 00 00 01 00 02 cd 02 15 00 00 00 01 00 02 ce 7a 15 00 00 00 01 00 02 cf 02 15 00 00 00 01 00 02 d0 a6 15 00 00 00 01 00 02 d1 02 15 00 00 00 01 00 02 d2 d6 15 00 00 00 01 00 02 d3 02 15 00 00 00 01 00 02 d4 f4 15 00 00 00 01 00 02 d5 03 15 00 00 00 01 00 02 d6 29 15 00 00 00 01 00 02 d7 03 15 00 00 00 01 00 02 d8 45 15 00 00 00 01 00 02 d9 03 15 00 00 00 01 00 02 da 67 15 00 00 00 01 00 02 db 03 15 00 00 00 01 00 02 dc 71 15 00 00 00 01 00 02 dd 03 15 00 00 00 01 00 02 de 7b 15 00 00 00 01 00 02 df 03 15 00 00 00 01 00 02 e0 87 15 00 00 00 01 00 02 e1 03 15 00 00 00 01 00 02 e2 94 15 00 00 00 01 00 02 e3 03 15 00 00 00 01 00 02 e4 a2 15 00 00 00 01 00 02 e5 03 15 00 00 00 01 00 02 e6 af 15 00 00 00 01 00 02 e7 03 15 00 00 00 01 00 02 e8 b7 15 00 00 00 01 00 02 e9 03 15 00 00 00 01 00 02 ea fe 15 00 00 00 01 00 02 fb 01 15 01 00 00 01 00 02 ff 10];
		qcom,mdss-dsi-dispparam-papermode3-state = "dsi_hs_mode";
		qcom,mdss-dsi-dispparam-papermode4-command = [15 01 00 00 78 00 02 ff 20 15 00 00 00 01 00 02 fb 01 15 00 00 00 01 00 02 75 00 15 00 00 00 01 00 02 76 c8 15 00 00 00 01 00 02 77 00 15 00 00 00 01 00 02 78 d3 15 00 00 00 01 00 02 79 00 15 00 00 00 01 00 02 7a e7 15 00 00 00 01 00 02 7b 00 15 00 00 00 01 00 02 7c f8 15 00 00 00 01 00 02 7d 01 15 00 00 00 01 00 02 7e 08 15 00 00 00 01 00 02 7f 01 15 00 00 00 01 00 02 80 17 15 00 00 00 01 00 02 81 01 15 00 00 00 01 00 02 82 24 15 00 00 00 01 00 02 83 01 15 00 00 00 01 00 02 84 30 15 00 00 00 01 00 02 85 01 15 00 00 00 01 00 02 86 3c 15 00 00 00 01 00 02 87 01 15 00 00 00 01 00 02 88 64 15 00 00 00 01 00 02 89 01 15 00 00 00 01 00 02 8a 84 15 00 00 00 01 00 02 8b 01 15 00 00 00 01 00 02 8c b8 15 00 00 00 01 00 02 8d 01 15 00 00 00 01 00 02 8e e0 15 00 00 00 01 00 02 8f 02 15 00 00 00 01 00 02 90 1f 15 00 00 00 01 00 02 91 02 15 00 00 00 01 00 02 92 54 15 00 00 00 01 00 02 93 02 15 00 00 00 01 00 02 94 56 15 00 00 00 01 00 02 95 02 15 00 00 00 01 00 02 96 8a 15 00 00 00 01 00 02 97 02 15 00 00 00 01 00 02 98 c1 15 00 00 00 01 00 02 99 02 15 00 00 00 01 00 02 9a e1 15 00 00 00 01 00 02 9b 03 15 00 00 00 01 00 02 9c 0a 15 00 00 00 01 00 02 9d 03 15 00 00 00 01 00 02 9e 33 15 00 00 00 01 00 02 9f 03 15 00 00 00 01 00 02 a0 58 15 00 00 00 01 00 02 a2 03 15 00 00 00 01 00 02 a3 63 15 00 00 00 01 00 02 a4 03 15 00 00 00 01 00 02 a5 6f 15 00 00 00 01 00 02 a6 03 15 00 00 00 01 00 02 a7 7c 15 00 00 00 01 00 02 a9 03 15 00 00 00 01 00 02 aa 8a 15 00 00 00 01 00 02 ab 03 15 00 00 00 01 00 02 ac 9a 15 00 00 00 01 00 02 ad 03 15 00 00 00 01 00 02 ae ab 15 00 00 00 01 00 02 af 03 15 00 00 00 01 00 02 b0 b6 15 00 00 00 01 00 02 b1 03 15 00 00 00 01 00 02 b2 fe 15 00 00 00 01 00 02 b3 00 15 00 00 00 01 00 02 b4 c8 15 00 00 00 01 00 02 b5 00 15 00 00 00 01 00 02 b6 d3 15 00 00 00 01 00 02 b7 00 15 00 00 00 01 00 02 b8 e7 15 00 00 00 01 00 02 b9 00 15 00 00 00 01 00 02 ba f8 15 00 00 00 01 00 02 bb 01 15 00 00 00 01 00 02 bc 08 15 00 00 00 01 00 02 bd 01 15 00 00 00 01 00 02 be 17 15 00 00 00 01 00 02 bf 01 15 00 00 00 01 00 02 c0 24 15 00 00 00 01 00 02 c1 01 15 00 00 00 01 00 02 c2 30 15 00 00 00 01 00 02 c3 01 15 00 00 00 01 00 02 c4 3c 15 00 00 00 01 00 02 c5 01 15 00 00 00 01 00 02 c6 64 15 00 00 00 01 00 02 c7 01 15 00 00 00 01 00 02 c8 84 15 00 00 00 01 00 02 c9 01 15 00 00 00 01 00 02 ca b8 15 00 00 00 01 00 02 cb 01 15 00 00 00 01 00 02 cc e0 15 00 00 00 01 00 02 cd 02 15 00 00 00 01 00 02 ce 1f 15 00 00 00 01 00 02 cf 02 15 00 00 00 01 00 02 d0 54 15 00 00 00 01 00 02 d1 02 15 00 00 00 01 00 02 d2 56 15 00 00 00 01 00 02 d3 02 15 00 00 00 01 00 02 d4 8a 15 00 00 00 01 00 02 d5 02 15 00 00 00 01 00 02 d6 c1 15 00 00 00 01 00 02 d7 02 15 00 00 00 01 00 02 d8 e1 15 00 00 00 01 00 02 d9 03 15 00 00 00 01 00 02 da 0a 15 00 00 00 01 00 02 db 03 15 00 00 00 01 00 02 dc 33 15 00 00 00 01 00 02 dd 03 15 00 00 00 01 00 02 de 58 15 00 00 00 01 00 02 df 03 15 00 00 00 01 00 02 e0 63 15 00 00 00 01 00 02 e1 03 15 00 00 00 01 00 02 e2 6f 15 00 00 00 01 00 02 e3 03 15 00 00 00 01 00 02 e4 7c 15 00 00 00 01 00 02 e5 03 15 00 00 00 01 00 02 e6 8a 15 00 00 00 01 00 02 e7 03 15 00 00 00 01 00 02 e8 9a 15 00 00 00 01 00 02 e9 03 15 00 00 00 01 00 02 ea ab 15 00 00 00 01 00 02 eb 03 15 00 00 00 01 00 02 ec b6 15 00 00 00 01 00 02 ed 03 15 00 00 00 01 00 02 ee fe 15 00 00 00 01 00 02 ef 00 15 00 00 00 01 00 02 f0 c8 15 00 00 00 01 00 02 f1 00 15 00 00 00 01 00 02 f2 d3 15 00 00 00 01 00 02 f3 00 15 00 00 00 01 00 02 f4 e8 15 00 00 00 01 00 02 f5 00 15 00 00 00 01 00 02 f6 fa 15 00 00 00 01 00 02 f7 01 15 00 00 00 01 00 02 f8 0b 15 00 00 00 01 00 02 f9 01 15 00 00 00 01 00 02 fa 19 15 00 00 00 01 00 02 ff 21 15 00 00 00 01 00 02 fb 01 15 00 00 00 01 00 02 00 01 15 00 00 00 01 00 02 01 27 15 00 00 00 01 00 02 02 01 15 00 00 00 01 00 02 03 34 15 00 00 00 01 00 02 04 01 15 00 00 00 01 00 02 05 3f 15 00 00 00 01 00 02 06 01 15 00 00 00 01 00 02 07 67 15 00 00 00 01 00 02 08 01 15 00 00 00 01 00 02 09 88 15 00 00 00 01 00 02 0a 01 15 00 00 00 01 00 02 0b bb 15 00 00 00 01 00 02 0c 01 15 00 00 00 01 00 02 0d e3 15 00 00 00 01 00 02 0e 02 15 00 00 00 01 00 02 0f 22 15 00 00 00 01 00 02 10 02 15 00 00 00 01 00 02 11 57 15 00 00 00 01 00 02 12 02 15 00 00 00 01 00 02 13 59 15 00 00 00 01 00 02 14 02 15 00 00 00 01 00 02 15 8c 15 00 00 00 01 00 02 16 02 15 00 00 00 01 00 02 17 c3 15 00 00 00 01 00 02 18 02 15 00 00 00 01 00 02 19 e2 15 00 00 00 01 00 02 1a 03 15 00 00 00 01 00 02 1b 0c 15 00 00 00 01 00 02 1c 03 15 00 00 00 01 00 02 1d 35 15 00 00 00 01 00 02 1e 03 15 00 00 00 01 00 02 1f 5b 15 00 00 00 01 00 02 20 03 15 00 00 00 01 00 02 21 67 15 00 00 00 01 00 02 22 03 15 00 00 00 01 00 02 23 73 15 00 00 00 01 00 02 24 03 15 00 00 00 01 00 02 25 82 15 00 00 00 01 00 02 26 03 15 00 00 00 01 00 02 27 93 15 00 00 00 01 00 02 28 03 15 00 00 00 01 00 02 29 a7 15 00 00 00 01 00 02 2a 03 15 00 00 00 01 00 02 2b b8 15 00 00 00 01 00 02 2d 03 15 00 00 00 01 00 02 2f c3 15 00 00 00 01 00 02 30 03 15 00 00 00 01 00 02 31 fe 15 00 00 00 01 00 02 32 00 15 00 00 00 01 00 02 33 c8 15 00 00 00 01 00 02 34 00 15 00 00 00 01 00 02 35 d3 15 00 00 00 01 00 02 36 00 15 00 00 00 01 00 02 37 e8 15 00 00 00 01 00 02 38 00 15 00 00 00 01 00 02 39 fa 15 00 00 00 01 00 02 3a 01 15 00 00 00 01 00 02 3b 0b 15 00 00 00 01 00 02 3d 01 15 00 00 00 01 00 02 3f 19 15 00 00 00 01 00 02 40 01 15 00 00 00 01 00 02 41 27 15 00 00 00 01 00 02 42 01 15 00 00 00 01 00 02 43 34 15 00 00 00 01 00 02 44 01 15 00 00 00 01 00 02 45 3f 15 00 00 00 01 00 02 46 01 15 00 00 00 01 00 02 47 67 15 00 00 00 01 00 02 48 01 15 00 00 00 01 00 02 49 88 15 00 00 00 01 00 02 4a 01 15 00 00 00 01 00 02 4b bb 15 00 00 00 01 00 02 4c 01 15 00 00 00 01 00 02 4d e3 15 00 00 00 01 00 02 4e 02 15 00 00 00 01 00 02 4f 22 15 00 00 00 01 00 02 50 02 15 00 00 00 01 00 02 51 57 15 00 00 00 01 00 02 52 02 15 00 00 00 01 00 02 53 59 15 00 00 00 01 00 02 54 02 15 00 00 00 01 00 02 55 8c 15 00 00 00 01 00 02 56 02 15 00 00 00 01 00 02 58 c3 15 00 00 00 01 00 02 59 02 15 00 00 00 01 00 02 5a e2 15 00 00 00 01 00 02 5b 03 15 00 00 00 01 00 02 5c 0c 15 00 00 00 01 00 02 5d 03 15 00 00 00 01 00 02 5e 35 15 00 00 00 01 00 02 5f 03 15 00 00 00 01 00 02 60 5b 15 00 00 00 01 00 02 61 03 15 00 00 00 01 00 02 62 67 15 00 00 00 01 00 02 63 03 15 00 00 00 01 00 02 64 73 15 00 00 00 01 00 02 65 03 15 00 00 00 01 00 02 66 82 15 00 00 00 01 00 02 67 03 15 00 00 00 01 00 02 68 93 15 00 00 00 01 00 02 69 03 15 00 00 00 01 00 02 6a a7 15 00 00 00 01 00 02 6b 03 15 00 00 00 01 00 02 6c b8 15 00 00 00 01 00 02 6d 03 15 00 00 00 01 00 02 6e c3 15 00 00 00 01 00 02 6f 03 15 00 00 00 01 00 02 70 fe 15 00 00 00 01 00 02 71 01 15 00 00 00 01 00 02 72 d2 15 00 00 00 01 00 02 73 01 15 00 00 00 01 00 02 74 d4 15 00 00 00 01 00 02 75 01 15 00 00 00 01 00 02 76 d8 15 00 00 00 01 00 02 77 01 15 00 00 00 01 00 02 78 db 15 00 00 00 01 00 02 79 01 15 00 00 00 01 00 02 7a df 15 00 00 00 01 00 02 7b 01 15 00 00 00 01 00 02 7c e2 15 00 00 00 01 00 02 7d 01 15 00 00 00 01 00 02 7e e6 15 00 00 00 01 00 02 7f 01 15 00 00 00 01 00 02 80 e9 15 00 00 00 01 00 02 81 01 15 00 00 00 01 00 02 82 ec 15 00 00 00 01 00 02 83 01 15 00 00 00 01 00 02 84 f9 15 00 00 00 01 00 02 85 02 15 00 00 00 01 00 02 86 06 15 00 00 00 01 00 02 87 02 15 00 00 00 01 00 02 88 1c 15 00 00 00 01 00 02 89 02 15 00 00 00 01 00 02 8a 32 15 00 00 00 01 00 02 8b 02 15 00 00 00 01 00 02 8c 5a 15 00 00 00 01 00 02 8d 02 15 00 00 00 01 00 02 8e 82 15 00 00 00 01 00 02 8f 02 15 00 00 00 01 00 02 90 84 15 00 00 00 01 00 02 91 02 15 00 00 00 01 00 02 92 ad 15 00 00 00 01 00 02 93 02 15 00 00 00 01 00 02 94 dd 15 00 00 00 01 00 02 95 02 15 00 00 00 01 00 02 96 fa 15 00 00 00 01 00 02 97 03 15 00 00 00 01 00 02 98 2f 15 00 00 00 01 00 02 99 03 15 00 00 00 01 00 02 9a 4a 15 00 00 00 01 00 02 9b 03 15 00 00 00 01 00 02 9c 6b 15 00 00 00 01 00 02 9d 03 15 00 00 00 01 00 02 9e 75 15 00 00 00 01 00 02 9f 03 15 00 00 00 01 00 02 a0 7f 15 00 00 00 01 00 02 a2 03 15 00 00 00 01 00 02 a3 8a 15 00 00 00 01 00 02 a4 03 15 00 00 00 01 00 02 a5 97 15 00 00 00 01 00 02 a6 03 15 00 00 00 01 00 02 a7 a4 15 00 00 00 01 00 02 a9 03 15 00 00 00 01 00 02 aa b0 15 00 00 00 01 00 02 ab 03 15 00 00 00 01 00 02 ac b7 15 00 00 00 01 00 02 ad 03 15 00 00 00 01 00 02 ae fe 15 00 00 00 01 00 02 af 01 15 00 00 00 01 00 02 b0 d2 15 00 00 00 01 00 02 b1 01 15 00 00 00 01 00 02 b2 d4 15 00 00 00 01 00 02 b3 01 15 00 00 00 01 00 02 b4 d8 15 00 00 00 01 00 02 b5 01 15 00 00 00 01 00 02 b6 db 15 00 00 00 01 00 02 b7 01 15 00 00 00 01 00 02 b8 df 15 00 00 00 01 00 02 b9 01 15 00 00 00 01 00 02 ba e2 15 00 00 00 01 00 02 bb 01 15 00 00 00 01 00 02 bc e6 15 00 00 00 01 00 02 bd 01 15 00 00 00 01 00 02 be e9 15 00 00 00 01 00 02 bf 01 15 00 00 00 01 00 02 c0 ec 15 00 00 00 01 00 02 c1 01 15 00 00 00 01 00 02 c2 f9 15 00 00 00 01 00 02 c3 02 15 00 00 00 01 00 02 c4 06 15 00 00 00 01 00 02 c5 02 15 00 00 00 01 00 02 c6 1c 15 00 00 00 01 00 02 c7 02 15 00 00 00 01 00 02 c8 32 15 00 00 00 01 00 02 c9 02 15 00 00 00 01 00 02 ca 5a 15 00 00 00 01 00 02 cb 02 15 00 00 00 01 00 02 cc 82 15 00 00 00 01 00 02 cd 02 15 00 00 00 01 00 02 ce 84 15 00 00 00 01 00 02 cf 02 15 00 00 00 01 00 02 d0 ad 15 00 00 00 01 00 02 d1 02 15 00 00 00 01 00 02 d2 dd 15 00 00 00 01 00 02 d3 02 15 00 00 00 01 00 02 d4 fa 15 00 00 00 01 00 02 d5 03 15 00 00 00 01 00 02 d6 2f 15 00 00 00 01 00 02 d7 03 15 00 00 00 01 00 02 d8 4a 15 00 00 00 01 00 02 d9 03 15 00 00 00 01 00 02 da 6b 15 00 00 00 01 00 02 db 03 15 00 00 00 01 00 02 dc 75 15 00 00 00 01 00 02 dd 03 15 00 00 00 01 00 02 de 7f 15 00 00 00 01 00 02 df 03 15 00 00 00 01 00 02 e0 8a 15 00 00 00 01 00 02 e1 03 15 00 00 00 01 00 02 e2 97 15 00 00 00 01 00 02 e3 03 15 00 00 00 01 00 02 e4 a4 15 00 00 00 01 00 02 e5 03 15 00 00 00 01 00 02 e6 b0 15 00 00 00 01 00 02 e7 03 15 00 00 00 01 00 02 e8 b7 15 00 00 00 01 00 02 e9 03 15 00 00 00 01 00 02 ea fe 15 00 00 00 01 00 02 fb 01 15 01 00 00 01 00 02 ff 10];
		qcom,mdss-dsi-dispparam-papermode4-state = "dsi_hs_mode";
		qcom,mdss-dsi-dispparam-papermode5-command = [15 01 00 00 78 00 02 ff 20 15 00 00 00 01 00 02 fb 01 15 00 00 00 01 00 02 75 00 15 00 00 00 01 00 02 76 c8 15 00 00 00 01 00 02 77 00 15 00 00 00 01 00 02 78 d3 15 00 00 00 01 00 02 79 00 15 00 00 00 01 00 02 7a e7 15 00 00 00 01 00 02 7b 00 15 00 00 00 01 00 02 7c f8 15 00 00 00 01 00 02 7d 01 15 00 00 00 01 00 02 7e 08 15 00 00 00 01 00 02 7f 01 15 00 00 00 01 00 02 80 17 15 00 00 00 01 00 02 81 01 15 00 00 00 01 00 02 82 24 15 00 00 00 01 00 02 83 01 15 00 00 00 01 00 02 84 30 15 00 00 00 01 00 02 85 01 15 00 00 00 01 00 02 86 3c 15 00 00 00 01 00 02 87 01 15 00 00 00 01 00 02 88 64 15 00 00 00 01 00 02 89 01 15 00 00 00 01 00 02 8a 84 15 00 00 00 01 00 02 8b 01 15 00 00 00 01 00 02 8c b8 15 00 00 00 01 00 02 8d 01 15 00 00 00 01 00 02 8e e0 15 00 00 00 01 00 02 8f 02 15 00 00 00 01 00 02 90 1f 15 00 00 00 01 00 02 91 02 15 00 00 00 01 00 02 92 54 15 00 00 00 01 00 02 93 02 15 00 00 00 01 00 02 94 56 15 00 00 00 01 00 02 95 02 15 00 00 00 01 00 02 96 8a 15 00 00 00 01 00 02 97 02 15 00 00 00 01 00 02 98 c1 15 00 00 00 01 00 02 99 02 15 00 00 00 01 00 02 9a e1 15 00 00 00 01 00 02 9b 03 15 00 00 00 01 00 02 9c 0a 15 00 00 00 01 00 02 9d 03 15 00 00 00 01 00 02 9e 33 15 00 00 00 01 00 02 9f 03 15 00 00 00 01 00 02 a0 58 15 00 00 00 01 00 02 a2 03 15 00 00 00 01 00 02 a3 63 15 00 00 00 01 00 02 a4 03 15 00 00 00 01 00 02 a5 6f 15 00 00 00 01 00 02 a6 03 15 00 00 00 01 00 02 a7 7c 15 00 00 00 01 00 02 a9 03 15 00 00 00 01 00 02 aa 8a 15 00 00 00 01 00 02 ab 03 15 00 00 00 01 00 02 ac 9a 15 00 00 00 01 00 02 ad 03 15 00 00 00 01 00 02 ae ab 15 00 00 00 01 00 02 af 03 15 00 00 00 01 00 02 b0 b6 15 00 00 00 01 00 02 b1 03 15 00 00 00 01 00 02 b2 fe 15 00 00 00 01 00 02 b3 00 15 00 00 00 01 00 02 b4 c8 15 00 00 00 01 00 02 b5 00 15 00 00 00 01 00 02 b6 d3 15 00 00 00 01 00 02 b7 00 15 00 00 00 01 00 02 b8 e7 15 00 00 00 01 00 02 b9 00 15 00 00 00 01 00 02 ba f8 15 00 00 00 01 00 02 bb 01 15 00 00 00 01 00 02 bc 08 15 00 00 00 01 00 02 bd 01 15 00 00 00 01 00 02 be 17 15 00 00 00 01 00 02 bf 01 15 00 00 00 01 00 02 c0 24 15 00 00 00 01 00 02 c1 01 15 00 00 00 01 00 02 c2 30 15 00 00 00 01 00 02 c3 01 15 00 00 00 01 00 02 c4 3c 15 00 00 00 01 00 02 c5 01 15 00 00 00 01 00 02 c6 64 15 00 00 00 01 00 02 c7 01 15 00 00 00 01 00 02 c8 84 15 00 00 00 01 00 02 c9 01 15 00 00 00 01 00 02 ca b8 15 00 00 00 01 00 02 cb 01 15 00 00 00 01 00 02 cc e0 15 00 00 00 01 00 02 cd 02 15 00 00 00 01 00 02 ce 1f 15 00 00 00 01 00 02 cf 02 15 00 00 00 01 00 02 d0 54 15 00 00 00 01 00 02 d1 02 15 00 00 00 01 00 02 d2 56 15 00 00 00 01 00 02 d3 02 15 00 00 00 01 00 02 d4 8a 15 00 00 00 01 00 02 d5 02 15 00 00 00 01 00 02 d6 c1 15 00 00 00 01 00 02 d7 02 15 00 00 00 01 00 02 d8 e1 15 00 00 00 01 00 02 d9 03 15 00 00 00 01 00 02 da 0a 15 00 00 00 01 00 02 db 03 15 00 00 00 01 00 02 dc 33 15 00 00 00 01 00 02 dd 03 15 00 00 00 01 00 02 de 58 15 00 00 00 01 00 02 df 03 15 00 00 00 01 00 02 e0 63 15 00 00 00 01 00 02 e1 03 15 00 00 00 01 00 02 e2 6f 15 00 00 00 01 00 02 e3 03 15 00 00 00 01 00 02 e4 7c 15 00 00 00 01 00 02 e5 03 15 00 00 00 01 00 02 e6 8a 15 00 00 00 01 00 02 e7 03 15 00 00 00 01 00 02 e8 9a 15 00 00 00 01 00 02 e9 03 15 00 00 00 01 00 02 ea ab 15 00 00 00 01 00 02 eb 03 15 00 00 00 01 00 02 ec b6 15 00 00 00 01 00 02 ed 03 15 00 00 00 01 00 02 ee fe 15 00 00 00 01 00 02 ef 00 15 00 00 00 01 00 02 f0 c8 15 00 00 00 01 00 02 f1 00 15 00 00 00 01 00 02 f2 d3 15 00 00 00 01 00 02 f3 00 15 00 00 00 01 00 02 f4 e8 15 00 00 00 01 00 02 f5 00 15 00 00 00 01 00 02 f6 fa 15 00 00 00 01 00 02 f7 01 15 00 00 00 01 00 02 f8 0b 15 00 00 00 01 00 02 f9 01 15 00 00 00 01 00 02 fa 19 15 00 00 00 01 00 02 ff 21 15 00 00 00 01 00 02 fb 01 15 00 00 00 01 00 02 00 01 15 00 00 00 01 00 02 01 27 15 00 00 00 01 00 02 02 01 15 00 00 00 01 00 02 03 34 15 00 00 00 01 00 02 04 01 15 00 00 00 01 00 02 05 3f 15 00 00 00 01 00 02 06 01 15 00 00 00 01 00 02 07 67 15 00 00 00 01 00 02 08 01 15 00 00 00 01 00 02 09 88 15 00 00 00 01 00 02 0a 01 15 00 00 00 01 00 02 0b bb 15 00 00 00 01 00 02 0c 01 15 00 00 00 01 00 02 0d e3 15 00 00 00 01 00 02 0e 02 15 00 00 00 01 00 02 0f 22 15 00 00 00 01 00 02 10 02 15 00 00 00 01 00 02 11 57 15 00 00 00 01 00 02 12 02 15 00 00 00 01 00 02 13 59 15 00 00 00 01 00 02 14 02 15 00 00 00 01 00 02 15 8c 15 00 00 00 01 00 02 16 02 15 00 00 00 01 00 02 17 c3 15 00 00 00 01 00 02 18 02 15 00 00 00 01 00 02 19 e2 15 00 00 00 01 00 02 1a 03 15 00 00 00 01 00 02 1b 0c 15 00 00 00 01 00 02 1c 03 15 00 00 00 01 00 02 1d 35 15 00 00 00 01 00 02 1e 03 15 00 00 00 01 00 02 1f 5b 15 00 00 00 01 00 02 20 03 15 00 00 00 01 00 02 21 67 15 00 00 00 01 00 02 22 03 15 00 00 00 01 00 02 23 73 15 00 00 00 01 00 02 24 03 15 00 00 00 01 00 02 25 82 15 00 00 00 01 00 02 26 03 15 00 00 00 01 00 02 27 93 15 00 00 00 01 00 02 28 03 15 00 00 00 01 00 02 29 a7 15 00 00 00 01 00 02 2a 03 15 00 00 00 01 00 02 2b b8 15 00 00 00 01 00 02 2d 03 15 00 00 00 01 00 02 2f c3 15 00 00 00 01 00 02 30 03 15 00 00 00 01 00 02 31 fe 15 00 00 00 01 00 02 32 00 15 00 00 00 01 00 02 33 c8 15 00 00 00 01 00 02 34 00 15 00 00 00 01 00 02 35 d3 15 00 00 00 01 00 02 36 00 15 00 00 00 01 00 02 37 e8 15 00 00 00 01 00 02 38 00 15 00 00 00 01 00 02 39 fa 15 00 00 00 01 00 02 3a 01 15 00 00 00 01 00 02 3b 0b 15 00 00 00 01 00 02 3d 01 15 00 00 00 01 00 02 3f 19 15 00 00 00 01 00 02 40 01 15 00 00 00 01 00 02 41 27 15 00 00 00 01 00 02 42 01 15 00 00 00 01 00 02 43 34 15 00 00 00 01 00 02 44 01 15 00 00 00 01 00 02 45 3f 15 00 00 00 01 00 02 46 01 15 00 00 00 01 00 02 47 67 15 00 00 00 01 00 02 48 01 15 00 00 00 01 00 02 49 88 15 00 00 00 01 00 02 4a 01 15 00 00 00 01 00 02 4b bb 15 00 00 00 01 00 02 4c 01 15 00 00 00 01 00 02 4d e3 15 00 00 00 01 00 02 4e 02 15 00 00 00 01 00 02 4f 22 15 00 00 00 01 00 02 50 02 15 00 00 00 01 00 02 51 57 15 00 00 00 01 00 02 52 02 15 00 00 00 01 00 02 53 59 15 00 00 00 01 00 02 54 02 15 00 00 00 01 00 02 55 8c 15 00 00 00 01 00 02 56 02 15 00 00 00 01 00 02 58 c3 15 00 00 00 01 00 02 59 02 15 00 00 00 01 00 02 5a e2 15 00 00 00 01 00 02 5b 03 15 00 00 00 01 00 02 5c 0c 15 00 00 00 01 00 02 5d 03 15 00 00 00 01 00 02 5e 35 15 00 00 00 01 00 02 5f 03 15 00 00 00 01 00 02 60 5b 15 00 00 00 01 00 02 61 03 15 00 00 00 01 00 02 62 67 15 00 00 00 01 00 02 63 03 15 00 00 00 01 00 02 64 73 15 00 00 00 01 00 02 65 03 15 00 00 00 01 00 02 66 82 15 00 00 00 01 00 02 67 03 15 00 00 00 01 00 02 68 93 15 00 00 00 01 00 02 69 03 15 00 00 00 01 00 02 6a a7 15 00 00 00 01 00 02 6b 03 15 00 00 00 01 00 02 6c b8 15 00 00 00 01 00 02 6d 03 15 00 00 00 01 00 02 6e c3 15 00 00 00 01 00 02 6f 03 15 00 00 00 01 00 02 70 fe 15 00 00 00 01 00 02 71 01 15 00 00 00 01 00 02 72 f2 15 00 00 00 01 00 02 73 01 15 00 00 00 01 00 02 74 f4 15 00 00 00 01 00 02 75 01 15 00 00 00 01 00 02 76 f7 15 00 00 00 01 00 02 77 01 15 00 00 00 01 00 02 78 fa 15 00 00 00 01 00 02 79 01 15 00 00 00 01 00 02 7a fd 15 00 00 00 01 00 02 7b 01 15 00 00 00 01 00 02 7c ff 15 00 00 00 01 00 02 7d 02 15 00 00 00 01 00 02 7e 02 15 00 00 00 01 00 02 7f 02 15 00 00 00 01 00 02 80 05 15 00 00 00 01 00 02 81 02 15 00 00 00 01 00 02 82 08 15 00 00 00 01 00 02 83 02 15 00 00 00 01 00 02 84 12 15 00 00 00 01 00 02 85 02 15 00 00 00 01 00 02 86 1d 15 00 00 00 01 00 02 87 02 15 00 00 00 01 00 02 88 31 15 00 00 00 01 00 02 89 02 15 00 00 00 01 00 02 8a 44 15 00 00 00 01 00 02 8b 02 15 00 00 00 01 00 02 8c 69 15 00 00 00 01 00 02 8d 02 15 00 00 00 01 00 02 8e 8e 15 00 00 00 01 00 02 8f 02 15 00 00 00 01 00 02 90 8f 15 00 00 00 01 00 02 91 02 15 00 00 00 01 00 02 92 b7 15 00 00 00 01 00 02 93 02 15 00 00 00 01 00 02 94 e4 15 00 00 00 01 00 02 95 03 15 00 00 00 01 00 02 96 01 15 00 00 00 01 00 02 97 03 15 00 00 00 01 00 02 98 36 15 00 00 00 01 00 02 99 03 15 00 00 00 01 00 02 9a 50 15 00 00 00 01 00 02 9b 03 15 00 00 00 01 00 02 9c 70 15 00 00 00 01 00 02 9d 03 15 00 00 00 01 00 02 9e 79 15 00 00 00 01 00 02 9f 03 15 00 00 00 01 00 02 a0 83 15 00 00 00 01 00 02 a2 03 15 00 00 00 01 00 02 a3 8e 15 00 00 00 01 00 02 a4 03 15 00 00 00 01 00 02 a5 9a 15 00 00 00 01 00 02 a6 03 15 00 00 00 01 00 02 a7 a6 15 00 00 00 01 00 02 a9 03 15 00 00 00 01 00 02 aa b1 15 00 00 00 01 00 02 ab 03 15 00 00 00 01 00 02 ac b7 15 00 00 00 01 00 02 ad 03 15 00 00 00 01 00 02 ae fe 15 00 00 00 01 00 02 af 01 15 00 00 00 01 00 02 b0 f2 15 00 00 00 01 00 02 b1 01 15 00 00 00 01 00 02 b2 f4 15 00 00 00 01 00 02 b3 01 15 00 00 00 01 00 02 b4 f7 15 00 00 00 01 00 02 b5 01 15 00 00 00 01 00 02 b6 fa 15 00 00 00 01 00 02 b7 01 15 00 00 00 01 00 02 b8 fd 15 00 00 00 01 00 02 b9 01 15 00 00 00 01 00 02 ba ff 15 00 00 00 01 00 02 bb 02 15 00 00 00 01 00 02 bc 02 15 00 00 00 01 00 02 bd 02 15 00 00 00 01 00 02 be 05 15 00 00 00 01 00 02 bf 02 15 00 00 00 01 00 02 c0 08 15 00 00 00 01 00 02 c1 02 15 00 00 00 01 00 02 c2 12 15 00 00 00 01 00 02 c3 02 15 00 00 00 01 00 02 c4 1d 15 00 00 00 01 00 02 c5 02 15 00 00 00 01 00 02 c6 31 15 00 00 00 01 00 02 c7 02 15 00 00 00 01 00 02 c8 44 15 00 00 00 01 00 02 c9 02 15 00 00 00 01 00 02 ca 69 15 00 00 00 01 00 02 cb 02 15 00 00 00 01 00 02 cc 8e 15 00 00 00 01 00 02 cd 02 15 00 00 00 01 00 02 ce 8f 15 00 00 00 01 00 02 cf 02 15 00 00 00 01 00 02 d0 b7 15 00 00 00 01 00 02 d1 02 15 00 00 00 01 00 02 d2 e4 15 00 00 00 01 00 02 d3 03 15 00 00 00 01 00 02 d4 01 15 00 00 00 01 00 02 d5 03 15 00 00 00 01 00 02 d6 36 15 00 00 00 01 00 02 d7 03 15 00 00 00 01 00 02 d8 50 15 00 00 00 01 00 02 d9 03 15 00 00 00 01 00 02 da 70 15 00 00 00 01 00 02 db 03 15 00 00 00 01 00 02 dc 79 15 00 00 00 01 00 02 dd 03 15 00 00 00 01 00 02 de 83 15 00 00 00 01 00 02 df 03 15 00 00 00 01 00 02 e0 8e 15 00 00 00 01 00 02 e1 03 15 00 00 00 01 00 02 e2 9a 15 00 00 00 01 00 02 e3 03 15 00 00 00 01 00 02 e4 a6 15 00 00 00 01 00 02 e5 03 15 00 00 00 01 00 02 e6 b1 15 00 00 00 01 00 02 e7 03 15 00 00 00 01 00 02 e8 b7 15 00 00 00 01 00 02 e9 03 15 00 00 00 01 00 02 ea fe 15 00 00 00 01 00 02 fb 01 15 01 00 00 01 00 02 ff 10];
		qcom,mdss-dsi-dispparam-papermode5-state = "dsi_hs_mode";
		qcom,mdss-dsi-dispparam-papermode6-command = [15 01 00 00 78 00 02 ff 20 15 00 00 00 01 00 02 fb 01 15 00 00 00 01 00 02 75 00 15 00 00 00 01 00 02 76 c8 15 00 00 00 01 00 02 77 00 15 00 00 00 01 00 02 78 d3 15 00 00 00 01 00 02 79 00 15 00 00 00 01 00 02 7a e7 15 00 00 00 01 00 02 7b 00 15 00 00 00 01 00 02 7c f8 15 00 00 00 01 00 02 7d 01 15 00 00 00 01 00 02 7e 08 15 00 00 00 01 00 02 7f 01 15 00 00 00 01 00 02 80 17 15 00 00 00 01 00 02 81 01 15 00 00 00 01 00 02 82 24 15 00 00 00 01 00 02 83 01 15 00 00 00 01 00 02 84 30 15 00 00 00 01 00 02 85 01 15 00 00 00 01 00 02 86 3c 15 00 00 00 01 00 02 87 01 15 00 00 00 01 00 02 88 64 15 00 00 00 01 00 02 89 01 15 00 00 00 01 00 02 8a 84 15 00 00 00 01 00 02 8b 01 15 00 00 00 01 00 02 8c b8 15 00 00 00 01 00 02 8d 01 15 00 00 00 01 00 02 8e e0 15 00 00 00 01 00 02 8f 02 15 00 00 00 01 00 02 90 1f 15 00 00 00 01 00 02 91 02 15 00 00 00 01 00 02 92 54 15 00 00 00 01 00 02 93 02 15 00 00 00 01 00 02 94 56 15 00 00 00 01 00 02 95 02 15 00 00 00 01 00 02 96 8a 15 00 00 00 01 00 02 97 02 15 00 00 00 01 00 02 98 c1 15 00 00 00 01 00 02 99 02 15 00 00 00 01 00 02 9a e1 15 00 00 00 01 00 02 9b 03 15 00 00 00 01 00 02 9c 0a 15 00 00 00 01 00 02 9d 03 15 00 00 00 01 00 02 9e 33 15 00 00 00 01 00 02 9f 03 15 00 00 00 01 00 02 a0 58 15 00 00 00 01 00 02 a2 03 15 00 00 00 01 00 02 a3 63 15 00 00 00 01 00 02 a4 03 15 00 00 00 01 00 02 a5 6f 15 00 00 00 01 00 02 a6 03 15 00 00 00 01 00 02 a7 7c 15 00 00 00 01 00 02 a9 03 15 00 00 00 01 00 02 aa 8a 15 00 00 00 01 00 02 ab 03 15 00 00 00 01 00 02 ac 9a 15 00 00 00 01 00 02 ad 03 15 00 00 00 01 00 02 ae ab 15 00 00 00 01 00 02 af 03 15 00 00 00 01 00 02 b0 b6 15 00 00 00 01 00 02 b1 03 15 00 00 00 01 00 02 b2 fe 15 00 00 00 01 00 02 b3 00 15 00 00 00 01 00 02 b4 c8 15 00 00 00 01 00 02 b5 00 15 00 00 00 01 00 02 b6 d3 15 00 00 00 01 00 02 b7 00 15 00 00 00 01 00 02 b8 e7 15 00 00 00 01 00 02 b9 00 15 00 00 00 01 00 02 ba f8 15 00 00 00 01 00 02 bb 01 15 00 00 00 01 00 02 bc 08 15 00 00 00 01 00 02 bd 01 15 00 00 00 01 00 02 be 17 15 00 00 00 01 00 02 bf 01 15 00 00 00 01 00 02 c0 24 15 00 00 00 01 00 02 c1 01 15 00 00 00 01 00 02 c2 30 15 00 00 00 01 00 02 c3 01 15 00 00 00 01 00 02 c4 3c 15 00 00 00 01 00 02 c5 01 15 00 00 00 01 00 02 c6 64 15 00 00 00 01 00 02 c7 01 15 00 00 00 01 00 02 c8 84 15 00 00 00 01 00 02 c9 01 15 00 00 00 01 00 02 ca b8 15 00 00 00 01 00 02 cb 01 15 00 00 00 01 00 02 cc e0 15 00 00 00 01 00 02 cd 02 15 00 00 00 01 00 02 ce 1f 15 00 00 00 01 00 02 cf 02 15 00 00 00 01 00 02 d0 54 15 00 00 00 01 00 02 d1 02 15 00 00 00 01 00 02 d2 56 15 00 00 00 01 00 02 d3 02 15 00 00 00 01 00 02 d4 8a 15 00 00 00 01 00 02 d5 02 15 00 00 00 01 00 02 d6 c1 15 00 00 00 01 00 02 d7 02 15 00 00 00 01 00 02 d8 e1 15 00 00 00 01 00 02 d9 03 15 00 00 00 01 00 02 da 0a 15 00 00 00 01 00 02 db 03 15 00 00 00 01 00 02 dc 33 15 00 00 00 01 00 02 dd 03 15 00 00 00 01 00 02 de 58 15 00 00 00 01 00 02 df 03 15 00 00 00 01 00 02 e0 63 15 00 00 00 01 00 02 e1 03 15 00 00 00 01 00 02 e2 6f 15 00 00 00 01 00 02 e3 03 15 00 00 00 01 00 02 e4 7c 15 00 00 00 01 00 02 e5 03 15 00 00 00 01 00 02 e6 8a 15 00 00 00 01 00 02 e7 03 15 00 00 00 01 00 02 e8 9a 15 00 00 00 01 00 02 e9 03 15 00 00 00 01 00 02 ea ab 15 00 00 00 01 00 02 eb 03 15 00 00 00 01 00 02 ec b6 15 00 00 00 01 00 02 ed 03 15 00 00 00 01 00 02 ee fe 15 00 00 00 01 00 02 ef 00 15 00 00 00 01 00 02 f0 c8 15 00 00 00 01 00 02 f1 00 15 00 00 00 01 00 02 f2 d3 15 00 00 00 01 00 02 f3 00 15 00 00 00 01 00 02 f4 e8 15 00 00 00 01 00 02 f5 00 15 00 00 00 01 00 02 f6 fa 15 00 00 00 01 00 02 f7 01 15 00 00 00 01 00 02 f8 0b 15 00 00 00 01 00 02 f9 01 15 00 00 00 01 00 02 fa 19 15 00 00 00 01 00 02 ff 21 15 00 00 00 01 00 02 fb 01 15 00 00 00 01 00 02 00 01 15 00 00 00 01 00 02 01 27 15 00 00 00 01 00 02 02 01 15 00 00 00 01 00 02 03 34 15 00 00 00 01 00 02 04 01 15 00 00 00 01 00 02 05 3f 15 00 00 00 01 00 02 06 01 15 00 00 00 01 00 02 07 67 15 00 00 00 01 00 02 08 01 15 00 00 00 01 00 02 09 88 15 00 00 00 01 00 02 0a 01 15 00 00 00 01 00 02 0b bb 15 00 00 00 01 00 02 0c 01 15 00 00 00 01 00 02 0d e3 15 00 00 00 01 00 02 0e 02 15 00 00 00 01 00 02 0f 22 15 00 00 00 01 00 02 10 02 15 00 00 00 01 00 02 11 57 15 00 00 00 01 00 02 12 02 15 00 00 00 01 00 02 13 59 15 00 00 00 01 00 02 14 02 15 00 00 00 01 00 02 15 8c 15 00 00 00 01 00 02 16 02 15 00 00 00 01 00 02 17 c3 15 00 00 00 01 00 02 18 02 15 00 00 00 01 00 02 19 e2 15 00 00 00 01 00 02 1a 03 15 00 00 00 01 00 02 1b 0c 15 00 00 00 01 00 02 1c 03 15 00 00 00 01 00 02 1d 35 15 00 00 00 01 00 02 1e 03 15 00 00 00 01 00 02 1f 5b 15 00 00 00 01 00 02 20 03 15 00 00 00 01 00 02 21 67 15 00 00 00 01 00 02 22 03 15 00 00 00 01 00 02 23 73 15 00 00 00 01 00 02 24 03 15 00 00 00 01 00 02 25 82 15 00 00 00 01 00 02 26 03 15 00 00 00 01 00 02 27 93 15 00 00 00 01 00 02 28 03 15 00 00 00 01 00 02 29 a7 15 00 00 00 01 00 02 2a 03 15 00 00 00 01 00 02 2b b8 15 00 00 00 01 00 02 2d 03 15 00 00 00 01 00 02 2f c3 15 00 00 00 01 00 02 30 03 15 00 00 00 01 00 02 31 fe 15 00 00 00 01 00 02 32 00 15 00 00 00 01 00 02 33 c8 15 00 00 00 01 00 02 34 00 15 00 00 00 01 00 02 35 d3 15 00 00 00 01 00 02 36 00 15 00 00 00 01 00 02 37 e8 15 00 00 00 01 00 02 38 00 15 00 00 00 01 00 02 39 fa 15 00 00 00 01 00 02 3a 01 15 00 00 00 01 00 02 3b 0b 15 00 00 00 01 00 02 3d 01 15 00 00 00 01 00 02 3f 19 15 00 00 00 01 00 02 40 01 15 00 00 00 01 00 02 41 27 15 00 00 00 01 00 02 42 01 15 00 00 00 01 00 02 43 34 15 00 00 00 01 00 02 44 01 15 00 00 00 01 00 02 45 3f 15 00 00 00 01 00 02 46 01 15 00 00 00 01 00 02 47 67 15 00 00 00 01 00 02 48 01 15 00 00 00 01 00 02 49 88 15 00 00 00 01 00 02 4a 01 15 00 00 00 01 00 02 4b bb 15 00 00 00 01 00 02 4c 01 15 00 00 00 01 00 02 4d e3 15 00 00 00 01 00 02 4e 02 15 00 00 00 01 00 02 4f 22 15 00 00 00 01 00 02 50 02 15 00 00 00 01 00 02 51 57 15 00 00 00 01 00 02 52 02 15 00 00 00 01 00 02 53 59 15 00 00 00 01 00 02 54 02 15 00 00 00 01 00 02 55 8c 15 00 00 00 01 00 02 56 02 15 00 00 00 01 00 02 58 c3 15 00 00 00 01 00 02 59 02 15 00 00 00 01 00 02 5a e2 15 00 00 00 01 00 02 5b 03 15 00 00 00 01 00 02 5c 0c 15 00 00 00 01 00 02 5d 03 15 00 00 00 01 00 02 5e 35 15 00 00 00 01 00 02 5f 03 15 00 00 00 01 00 02 60 5b 15 00 00 00 01 00 02 61 03 15 00 00 00 01 00 02 62 67 15 00 00 00 01 00 02 63 03 15 00 00 00 01 00 02 64 73 15 00 00 00 01 00 02 65 03 15 00 00 00 01 00 02 66 82 15 00 00 00 01 00 02 67 03 15 00 00 00 01 00 02 68 93 15 00 00 00 01 00 02 69 03 15 00 00 00 01 00 02 6a a7 15 00 00 00 01 00 02 6b 03 15 00 00 00 01 00 02 6c b8 15 00 00 00 01 00 02 6d 03 15 00 00 00 01 00 02 6e c3 15 00 00 00 01 00 02 6f 03 15 00 00 00 01 00 02 70 fe 15 00 00 00 01 00 02 71 02 15 00 00 00 01 00 02 72 07 15 00 00 00 01 00 02 73 02 15 00 00 00 01 00 02 74 08 15 00 00 00 01 00 02 75 02 15 00 00 00 01 00 02 76 0b 15 00 00 00 01 00 02 77 02 15 00 00 00 01 00 02 78 0d 15 00 00 00 01 00 02 79 02 15 00 00 00 01 00 02 7a 10 15 00 00 00 01 00 02 7b 02 15 00 00 00 01 00 02 7c 12 15 00 00 00 01 00 02 7d 02 15 00 00 00 01 00 02 7e 15 15 00 00 00 01 00 02 7f 02 15 00 00 00 01 00 02 80 17 15 00 00 00 01 00 02 81 02 15 00 00 00 01 00 02 82 1a 15 00 00 00 01 00 02 83 02 15 00 00 00 01 00 02 84 23 15 00 00 00 01 00 02 85 02 15 00 00 00 01 00 02 86 2d 15 00 00 00 01 00 02 87 02 15 00 00 00 01 00 02 88 3f 15 00 00 00 01 00 02 89 02 15 00 00 00 01 00 02 8a 50 15 00 00 00 01 00 02 8b 02 15 00 00 00 01 00 02 8c 73 15 00 00 00 01 00 02 8d 02 15 00 00 00 01 00 02 8e 97 15 00 00 00 01 00 02 8f 02 15 00 00 00 01 00 02 90 98 15 00 00 00 01 00 02 91 02 15 00 00 00 01 00 02 92 be 15 00 00 00 01 00 02 93 02 15 00 00 00 01 00 02 94 ea 15 00 00 00 01 00 02 95 03 15 00 00 00 01 00 02 96 07 15 00 00 00 01 00 02 97 03 15 00 00 00 01 00 02 98 3c 15 00 00 00 01 00 02 99 03 15 00 00 00 01 00 02 9a 55 15 00 00 00 01 00 02 9b 03 15 00 00 00 01 00 02 9c 74 15 00 00 00 01 00 02 9d 03 15 00 00 00 01 00 02 9e 7d 15 00 00 00 01 00 02 9f 03 15 00 00 00 01 00 02 a0 87 15 00 00 00 01 00 02 a2 03 15 00 00 00 01 00 02 a3 91 15 00 00 00 01 00 02 a4 03 15 00 00 00 01 00 02 a5 9d 15 00 00 00 01 00 02 a6 03 15 00 00 00 01 00 02 a7 a8 15 00 00 00 01 00 02 a9 03 15 00 00 00 01 00 02 aa b2 15 00 00 00 01 00 02 ab 03 15 00 00 00 01 00 02 ac b7 15 00 00 00 01 00 02 ad 03 15 00 00 00 01 00 02 ae fe 15 00 00 00 01 00 02 af 02 15 00 00 00 01 00 02 b0 07 15 00 00 00 01 00 02 b1 02 15 00 00 00 01 00 02 b2 08 15 00 00 00 01 00 02 b3 02 15 00 00 00 01 00 02 b4 0b 15 00 00 00 01 00 02 b5 02 15 00 00 00 01 00 02 b6 0d 15 00 00 00 01 00 02 b7 02 15 00 00 00 01 00 02 b8 10 15 00 00 00 01 00 02 b9 02 15 00 00 00 01 00 02 ba 12 15 00 00 00 01 00 02 bb 02 15 00 00 00 01 00 02 bc 15 15 00 00 00 01 00 02 bd 02 15 00 00 00 01 00 02 be 17 15 00 00 00 01 00 02 bf 02 15 00 00 00 01 00 02 c0 1a 15 00 00 00 01 00 02 c1 02 15 00 00 00 01 00 02 c2 23 15 00 00 00 01 00 02 c3 02 15 00 00 00 01 00 02 c4 2d 15 00 00 00 01 00 02 c5 02 15 00 00 00 01 00 02 c6 3f 15 00 00 00 01 00 02 c7 02 15 00 00 00 01 00 02 c8 50 15 00 00 00 01 00 02 c9 02 15 00 00 00 01 00 02 ca 73 15 00 00 00 01 00 02 cb 02 15 00 00 00 01 00 02 cc 97 15 00 00 00 01 00 02 cd 02 15 00 00 00 01 00 02 ce 98 15 00 00 00 01 00 02 cf 02 15 00 00 00 01 00 02 d0 be 15 00 00 00 01 00 02 d1 02 15 00 00 00 01 00 02 d2 ea 15 00 00 00 01 00 02 d3 03 15 00 00 00 01 00 02 d4 07 15 00 00 00 01 00 02 d5 03 15 00 00 00 01 00 02 d6 3c 15 00 00 00 01 00 02 d7 03 15 00 00 00 01 00 02 d8 55 15 00 00 00 01 00 02 d9 03 15 00 00 00 01 00 02 da 74 15 00 00 00 01 00 02 db 03 15 00 00 00 01 00 02 dc 7d 15 00 00 00 01 00 02 dd 03 15 00 00 00 01 00 02 de 87 15 00 00 00 01 00 02 df 03 15 00 00 00 01 00 02 e0 91 15 00 00 00 01 00 02 e1 03 15 00 00 00 01 00 02 e2 9d 15 00 00 00 01 00 02 e3 03 15 00 00 00 01 00 02 e4 a8 15 00 00 00 01 00 02 e5 03 15 00 00 00 01 00 02 e6 b2 15 00 00 00 01 00 02 e7 03 15 00 00 00 01 00 02 e8 b7 15 00 00 00 01 00 02 e9 03 15 00 00 00 01 00 02 ea fe 15 00 00 00 01 00 02 fb 01 15 01 00 00 01 00 02 ff 10];
		qcom,mdss-dsi-dispparam-papermode6-state = "dsi_hs_mode";
		qcom,mdss-dsi-dispparam-papermode7-command = [15 01 00 00 78 00 02 ff 20 15 00 00 00 01 00 02 fb 01 15 00 00 00 01 00 02 75 00 15 00 00 00 01 00 02 76 c8 15 00 00 00 01 00 02 77 00 15 00 00 00 01 00 02 78 d3 15 00 00 00 01 00 02 79 00 15 00 00 00 01 00 02 7a e7 15 00 00 00 01 00 02 7b 00 15 00 00 00 01 00 02 7c f8 15 00 00 00 01 00 02 7d 01 15 00 00 00 01 00 02 7e 08 15 00 00 00 01 00 02 7f 01 15 00 00 00 01 00 02 80 17 15 00 00 00 01 00 02 81 01 15 00 00 00 01 00 02 82 24 15 00 00 00 01 00 02 83 01 15 00 00 00 01 00 02 84 30 15 00 00 00 01 00 02 85 01 15 00 00 00 01 00 02 86 3c 15 00 00 00 01 00 02 87 01 15 00 00 00 01 00 02 88 64 15 00 00 00 01 00 02 89 01 15 00 00 00 01 00 02 8a 84 15 00 00 00 01 00 02 8b 01 15 00 00 00 01 00 02 8c b8 15 00 00 00 01 00 02 8d 01 15 00 00 00 01 00 02 8e e0 15 00 00 00 01 00 02 8f 02 15 00 00 00 01 00 02 90 1f 15 00 00 00 01 00 02 91 02 15 00 00 00 01 00 02 92 54 15 00 00 00 01 00 02 93 02 15 00 00 00 01 00 02 94 56 15 00 00 00 01 00 02 95 02 15 00 00 00 01 00 02 96 8a 15 00 00 00 01 00 02 97 02 15 00 00 00 01 00 02 98 c1 15 00 00 00 01 00 02 99 02 15 00 00 00 01 00 02 9a e1 15 00 00 00 01 00 02 9b 03 15 00 00 00 01 00 02 9c 0a 15 00 00 00 01 00 02 9d 03 15 00 00 00 01 00 02 9e 33 15 00 00 00 01 00 02 9f 03 15 00 00 00 01 00 02 a0 58 15 00 00 00 01 00 02 a2 03 15 00 00 00 01 00 02 a3 63 15 00 00 00 01 00 02 a4 03 15 00 00 00 01 00 02 a5 6f 15 00 00 00 01 00 02 a6 03 15 00 00 00 01 00 02 a7 7c 15 00 00 00 01 00 02 a9 03 15 00 00 00 01 00 02 aa 8a 15 00 00 00 01 00 02 ab 03 15 00 00 00 01 00 02 ac 9a 15 00 00 00 01 00 02 ad 03 15 00 00 00 01 00 02 ae ab 15 00 00 00 01 00 02 af 03 15 00 00 00 01 00 02 b0 b6 15 00 00 00 01 00 02 b1 03 15 00 00 00 01 00 02 b2 fe 15 00 00 00 01 00 02 b3 00 15 00 00 00 01 00 02 b4 c8 15 00 00 00 01 00 02 b5 00 15 00 00 00 01 00 02 b6 d3 15 00 00 00 01 00 02 b7 00 15 00 00 00 01 00 02 b8 e7 15 00 00 00 01 00 02 b9 00 15 00 00 00 01 00 02 ba f8 15 00 00 00 01 00 02 bb 01 15 00 00 00 01 00 02 bc 08 15 00 00 00 01 00 02 bd 01 15 00 00 00 01 00 02 be 17 15 00 00 00 01 00 02 bf 01 15 00 00 00 01 00 02 c0 24 15 00 00 00 01 00 02 c1 01 15 00 00 00 01 00 02 c2 30 15 00 00 00 01 00 02 c3 01 15 00 00 00 01 00 02 c4 3c 15 00 00 00 01 00 02 c5 01 15 00 00 00 01 00 02 c6 64 15 00 00 00 01 00 02 c7 01 15 00 00 00 01 00 02 c8 84 15 00 00 00 01 00 02 c9 01 15 00 00 00 01 00 02 ca b8 15 00 00 00 01 00 02 cb 01 15 00 00 00 01 00 02 cc e0 15 00 00 00 01 00 02 cd 02 15 00 00 00 01 00 02 ce 1f 15 00 00 00 01 00 02 cf 02 15 00 00 00 01 00 02 d0 54 15 00 00 00 01 00 02 d1 02 15 00 00 00 01 00 02 d2 56 15 00 00 00 01 00 02 d3 02 15 00 00 00 01 00 02 d4 8a 15 00 00 00 01 00 02 d5 02 15 00 00 00 01 00 02 d6 c1 15 00 00 00 01 00 02 d7 02 15 00 00 00 01 00 02 d8 e1 15 00 00 00 01 00 02 d9 03 15 00 00 00 01 00 02 da 0a 15 00 00 00 01 00 02 db 03 15 00 00 00 01 00 02 dc 33 15 00 00 00 01 00 02 dd 03 15 00 00 00 01 00 02 de 58 15 00 00 00 01 00 02 df 03 15 00 00 00 01 00 02 e0 63 15 00 00 00 01 00 02 e1 03 15 00 00 00 01 00 02 e2 6f 15 00 00 00 01 00 02 e3 03 15 00 00 00 01 00 02 e4 7c 15 00 00 00 01 00 02 e5 03 15 00 00 00 01 00 02 e6 8a 15 00 00 00 01 00 02 e7 03 15 00 00 00 01 00 02 e8 9a 15 00 00 00 01 00 02 e9 03 15 00 00 00 01 00 02 ea ab 15 00 00 00 01 00 02 eb 03 15 00 00 00 01 00 02 ec b6 15 00 00 00 01 00 02 ed 03 15 00 00 00 01 00 02 ee fe 15 00 00 00 01 00 02 ef 00 15 00 00 00 01 00 02 f0 c8 15 00 00 00 01 00 02 f1 00 15 00 00 00 01 00 02 f2 d3 15 00 00 00 01 00 02 f3 00 15 00 00 00 01 00 02 f4 e8 15 00 00 00 01 00 02 f5 00 15 00 00 00 01 00 02 f6 fa 15 00 00 00 01 00 02 f7 01 15 00 00 00 01 00 02 f8 0b 15 00 00 00 01 00 02 f9 01 15 00 00 00 01 00 02 fa 19 15 00 00 00 01 00 02 ff 21 15 00 00 00 01 00 02 fb 01 15 00 00 00 01 00 02 00 01 15 00 00 00 01 00 02 01 27 15 00 00 00 01 00 02 02 01 15 00 00 00 01 00 02 03 34 15 00 00 00 01 00 02 04 01 15 00 00 00 01 00 02 05 3f 15 00 00 00 01 00 02 06 01 15 00 00 00 01 00 02 07 67 15 00 00 00 01 00 02 08 01 15 00 00 00 01 00 02 09 88 15 00 00 00 01 00 02 0a 01 15 00 00 00 01 00 02 0b bb 15 00 00 00 01 00 02 0c 01 15 00 00 00 01 00 02 0d e3 15 00 00 00 01 00 02 0e 02 15 00 00 00 01 00 02 0f 22 15 00 00 00 01 00 02 10 02 15 00 00 00 01 00 02 11 57 15 00 00 00 01 00 02 12 02 15 00 00 00 01 00 02 13 59 15 00 00 00 01 00 02 14 02 15 00 00 00 01 00 02 15 8c 15 00 00 00 01 00 02 16 02 15 00 00 00 01 00 02 17 c3 15 00 00 00 01 00 02 18 02 15 00 00 00 01 00 02 19 e2 15 00 00 00 01 00 02 1a 03 15 00 00 00 01 00 02 1b 0c 15 00 00 00 01 00 02 1c 03 15 00 00 00 01 00 02 1d 35 15 00 00 00 01 00 02 1e 03 15 00 00 00 01 00 02 1f 5b 15 00 00 00 01 00 02 20 03 15 00 00 00 01 00 02 21 67 15 00 00 00 01 00 02 22 03 15 00 00 00 01 00 02 23 73 15 00 00 00 01 00 02 24 03 15 00 00 00 01 00 02 25 82 15 00 00 00 01 00 02 26 03 15 00 00 00 01 00 02 27 93 15 00 00 00 01 00 02 28 03 15 00 00 00 01 00 02 29 a7 15 00 00 00 01 00 02 2a 03 15 00 00 00 01 00 02 2b b8 15 00 00 00 01 00 02 2d 03 15 00 00 00 01 00 02 2f c3 15 00 00 00 01 00 02 30 03 15 00 00 00 01 00 02 31 fe 15 00 00 00 01 00 02 32 00 15 00 00 00 01 00 02 33 c8 15 00 00 00 01 00 02 34 00 15 00 00 00 01 00 02 35 d3 15 00 00 00 01 00 02 36 00 15 00 00 00 01 00 02 37 e8 15 00 00 00 01 00 02 38 00 15 00 00 00 01 00 02 39 fa 15 00 00 00 01 00 02 3a 01 15 00 00 00 01 00 02 3b 0b 15 00 00 00 01 00 02 3d 01 15 00 00 00 01 00 02 3f 19 15 00 00 00 01 00 02 40 01 15 00 00 00 01 00 02 41 27 15 00 00 00 01 00 02 42 01 15 00 00 00 01 00 02 43 34 15 00 00 00 01 00 02 44 01 15 00 00 00 01 00 02 45 3f 15 00 00 00 01 00 02 46 01 15 00 00 00 01 00 02 47 67 15 00 00 00 01 00 02 48 01 15 00 00 00 01 00 02 49 88 15 00 00 00 01 00 02 4a 01 15 00 00 00 01 00 02 4b bb 15 00 00 00 01 00 02 4c 01 15 00 00 00 01 00 02 4d e3 15 00 00 00 01 00 02 4e 02 15 00 00 00 01 00 02 4f 22 15 00 00 00 01 00 02 50 02 15 00 00 00 01 00 02 51 57 15 00 00 00 01 00 02 52 02 15 00 00 00 01 00 02 53 59 15 00 00 00 01 00 02 54 02 15 00 00 00 01 00 02 55 8c 15 00 00 00 01 00 02 56 02 15 00 00 00 01 00 02 58 c3 15 00 00 00 01 00 02 59 02 15 00 00 00 01 00 02 5a e2 15 00 00 00 01 00 02 5b 03 15 00 00 00 01 00 02 5c 0c 15 00 00 00 01 00 02 5d 03 15 00 00 00 01 00 02 5e 35 15 00 00 00 01 00 02 5f 03 15 00 00 00 01 00 02 60 5b 15 00 00 00 01 00 02 61 03 15 00 00 00 01 00 02 62 67 15 00 00 00 01 00 02 63 03 15 00 00 00 01 00 02 64 73 15 00 00 00 01 00 02 65 03 15 00 00 00 01 00 02 66 82 15 00 00 00 01 00 02 67 03 15 00 00 00 01 00 02 68 93 15 00 00 00 01 00 02 69 03 15 00 00 00 01 00 02 6a a7 15 00 00 00 01 00 02 6b 03 15 00 00 00 01 00 02 6c b8 15 00 00 00 01 00 02 6d 03 15 00 00 00 01 00 02 6e c3 15 00 00 00 01 00 02 6f 03 15 00 00 00 01 00 02 70 fe 15 00 00 00 01 00 02 71 02 15 00 00 00 01 00 02 72 19 15 00 00 00 01 00 02 73 02 15 00 00 00 01 00 02 74 1a 15 00 00 00 01 00 02 75 02 15 00 00 00 01 00 02 76 1c 15 00 00 00 01 00 02 77 02 15 00 00 00 01 00 02 78 1f 15 00 00 00 01 00 02 79 02 15 00 00 00 01 00 02 7a 21 15 00 00 00 01 00 02 7b 02 15 00 00 00 01 00 02 7c 23 15 00 00 00 01 00 02 7d 02 15 00 00 00 01 00 02 7e 25 15 00 00 00 01 00 02 7f 02 15 00 00 00 01 00 02 80 28 15 00 00 00 01 00 02 81 02 15 00 00 00 01 00 02 82 2a 15 00 00 00 01 00 02 83 02 15 00 00 00 01 00 02 84 32 15 00 00 00 01 00 02 85 02 15 00 00 00 01 00 02 86 3b 15 00 00 00 01 00 02 87 02 15 00 00 00 01 00 02 88 4c 15 00 00 00 01 00 02 89 02 15 00 00 00 01 00 02 8a 5c 15 00 00 00 01 00 02 8b 02 15 00 00 00 01 00 02 8c 7d 15 00 00 00 01 00 02 8d 02 15 00 00 00 01 00 02 8e 9f 15 00 00 00 01 00 02 8f 02 15 00 00 00 01 00 02 90 a0 15 00 00 00 01 00 02 91 02 15 00 00 00 01 00 02 92 c5 15 00 00 00 01 00 02 93 02 15 00 00 00 01 00 02 94 f0 15 00 00 00 01 00 02 95 03 15 00 00 00 01 00 02 96 0d 15 00 00 00 01 00 02 97 03 15 00 00 00 01 00 02 98 41 15 00 00 00 01 00 02 99 03 15 00 00 00 01 00 02 9a 5a 15 00 00 00 01 00 02 9b 03 15 00 00 00 01 00 02 9c 78 15 00 00 00 01 00 02 9d 03 15 00 00 00 01 00 02 9e 80 15 00 00 00 01 00 02 9f 03 15 00 00 00 01 00 02 a0 8a 15 00 00 00 01 00 02 a2 03 15 00 00 00 01 00 02 a3 94 15 00 00 00 01 00 02 a4 03 15 00 00 00 01 00 02 a5 9f 15 00 00 00 01 00 02 a6 03 15 00 00 00 01 00 02 a7 a9 15 00 00 00 01 00 02 a9 03 15 00 00 00 01 00 02 aa b2 15 00 00 00 01 00 02 ab 03 15 00 00 00 01 00 02 ac b7 15 00 00 00 01 00 02 ad 03 15 00 00 00 01 00 02 ae fe 15 00 00 00 01 00 02 af 02 15 00 00 00 01 00 02 b0 19 15 00 00 00 01 00 02 b1 02 15 00 00 00 01 00 02 b2 1a 15 00 00 00 01 00 02 b3 02 15 00 00 00 01 00 02 b4 1c 15 00 00 00 01 00 02 b5 02 15 00 00 00 01 00 02 b6 1f 15 00 00 00 01 00 02 b7 02 15 00 00 00 01 00 02 b8 21 15 00 00 00 01 00 02 b9 02 15 00 00 00 01 00 02 ba 23 15 00 00 00 01 00 02 bb 02 15 00 00 00 01 00 02 bc 25 15 00 00 00 01 00 02 bd 02 15 00 00 00 01 00 02 be 28 15 00 00 00 01 00 02 bf 02 15 00 00 00 01 00 02 c0 2a 15 00 00 00 01 00 02 c1 02 15 00 00 00 01 00 02 c2 32 15 00 00 00 01 00 02 c3 02 15 00 00 00 01 00 02 c4 3b 15 00 00 00 01 00 02 c5 02 15 00 00 00 01 00 02 c6 4c 15 00 00 00 01 00 02 c7 02 15 00 00 00 01 00 02 c8 5c 15 00 00 00 01 00 02 c9 02 15 00 00 00 01 00 02 ca 7d 15 00 00 00 01 00 02 cb 02 15 00 00 00 01 00 02 cc 9f 15 00 00 00 01 00 02 cd 02 15 00 00 00 01 00 02 ce a0 15 00 00 00 01 00 02 cf 02 15 00 00 00 01 00 02 d0 c5 15 00 00 00 01 00 02 d1 02 15 00 00 00 01 00 02 d2 f0 15 00 00 00 01 00 02 d3 03 15 00 00 00 01 00 02 d4 0d 15 00 00 00 01 00 02 d5 03 15 00 00 00 01 00 02 d6 41 15 00 00 00 01 00 02 d7 03 15 00 00 00 01 00 02 d8 5a 15 00 00 00 01 00 02 d9 03 15 00 00 00 01 00 02 da 78 15 00 00 00 01 00 02 db 03 15 00 00 00 01 00 02 dc 80 15 00 00 00 01 00 02 dd 03 15 00 00 00 01 00 02 de 8a 15 00 00 00 01 00 02 df 03 15 00 00 00 01 00 02 e0 94 15 00 00 00 01 00 02 e1 03 15 00 00 00 01 00 02 e2 9f 15 00 00 00 01 00 02 e3 03 15 00 00 00 01 00 02 e4 a9 15 00 00 00 01 00 02 e5 03 15 00 00 00 01 00 02 e6 b2 15 00 00 00 01 00 02 e7 03 15 00 00 00 01 00 02 e8 b7 15 00 00 00 01 00 02 e9 03 15 00 00 00 01 00 02 ea fe 15 00 00 00 01 00 02 fb 01 15 01 00 00 01 00 02 ff 10];
		qcom,mdss-dsi-dispparam-papermode7-state = "dsi_hs_mode";
		qcom,cont-splash-enabled;
	};
};
