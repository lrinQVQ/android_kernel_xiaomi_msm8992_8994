/* Copyright (c) 2013-2014, The Linux Foundation. All rights reserved.
 * Copyright (C) 2016 XiaoMi, Inc.
 *
 * This program is free software; you can redistribute it and/or modify
 * it under the terms of the GNU General Public License version 2 and
 * only version 2 as published by the Free Software Foundation.
 *
 * This program is distributed in the hope that it will be useful,
 * but WITHOUT ANY WARRANTY; without even the implied warranty of
 * MERCHANTABILITY or FITNESS FOR A PARTICULAR PURPOSE.  See the
 * GNU General Public License for more details.
 */

/*---------------------------------------------------------------------------
 * This file is autogenerated file using gcdb parser. Please do not edit it.
 * Update input XML file to add a new entry or update variable in this file
 * VERSION = "1.0"
 *---------------------------------------------------------------------------*/
&mdss_mdp {
	dsi_sharp_scale_wqhd_cmd: qcom,mdss_dsi_sharp_scale_wqhd_command {
		qcom,mdss-dsi-panel-name = "sharp fbc20 scale cmd mode dsi 1 panel";
		qcom,mdss-dsi-panel-id = <5>;
		qcom,mdss-dsi-panel-controller = <&mdss_dsi1>;
		qcom,mdss-dsi-panel-type = "dsi_cmd_mode";
		qcom,mdss-dsi-panel-destination = "display_2";
		qcom,mdss-dsi-panel-framerate = <60>;

		qcom,mdss-dsi-virtual-channel-id = <0>;
		qcom,mdss-dsi-stream = <0>;
		qcom,mdss-dsi-panel-width = <720>;
		qcom,mdss-dsi-panel-height = <1280>;
		qcom,mdss-dsi-h-front-porch = <120>;
		qcom,mdss-dsi-h-back-porch = <101>;
		qcom,mdss-dsi-h-pulse-width = <12>;
		qcom,mdss-dsi-h-sync-skew = <0>;
		qcom,mdss-dsi-v-back-porch = <16>;
		qcom,mdss-dsi-v-front-porch = <16>;
		qcom,mdss-dsi-v-pulse-width = <2>;
		qcom,mdss-dsi-h-left-border = <0>;
		qcom,mdss-dsi-h-right-border = <0>;
		qcom,mdss-dsi-v-top-border = <0>;
		qcom,mdss-dsi-v-bottom-border = <0>;
		qcom,mdss-dsi-bpp = <24>;
		qcom,mdss-dsi-underflow-color = <0xff>;
		qcom,mdss-dsi-border-color = <0>;
		qcom,mdss-dsi-on-command = [
			15 01 00 00 00 00 02 ff 10
			15 00 00 00 00 00 02 fb 01
			15 00 00 00 00 00 02 ba 03
			15 00 00 00 00 00 02 e5 01
			15 00 00 00 00 00 02 35 00
			15 00 00 00 00 00 02 bb 10
			15 00 00 00 00 00 02 b0 03
			39 01 00 00 00 00 06 3b 03 08 08 64 9a

			15 01 00 00 00 00 02 ff e0
			15 00 00 00 00 00 02 fb 01
			15 00 00 00 00 00 02 6b 3d
			15 00 00 00 00 00 02 6c 3d
			15 00 00 00 00 00 02 6d 3d
			15 00 00 00 00 00 02 6e 3d
			15 00 00 00 00 00 02 6f 3d
			15 00 00 00 00 00 02 35 02
			15 00 00 00 00 00 02 36 52
			15 00 00 00 00 00 02 37 10
			15 01 00 00 00 00 02 08 c0

			15 01 00 00 00 00 02 ff 24
			15 00 00 00 00 00 02 ba 83
			15 00 00 00 00 00 02 7d 10
			15 00 00 00 00 00 02 fb 01
			15 00 00 00 00 00 02 ff d0
			15 00 00 00 00 00 02 fb 01
			15 00 00 00 00 00 02 3a a0

			15 01 00 00 01 00 02 FF 20
			15 00 00 00 01 00 02 75 00
			15 00 00 00 01 00 02 76 00
			15 00 00 00 01 00 02 77 00
			15 00 00 00 01 00 02 78 41
			15 00 00 00 01 00 02 79 00
			15 00 00 00 01 00 02 7A 80
			15 00 00 00 01 00 02 7B 00
			15 00 00 00 01 00 02 7C A7
			15 00 00 00 01 00 02 7D 00
			15 00 00 00 01 00 02 7E C6
			15 00 00 00 01 00 02 7F 00
			15 00 00 00 01 00 02 80 DD
			15 00 00 00 01 00 02 81 00
			15 00 00 00 01 00 02 82 F3
			15 00 00 00 01 00 02 83 01
			15 00 00 00 01 00 02 84 06
			15 00 00 00 01 00 02 85 01
			15 00 00 00 01 00 02 86 15
			15 00 00 00 01 00 02 87 01
			15 00 00 00 01 00 02 88 4B
			15 00 00 00 01 00 02 89 01
			15 00 00 00 01 00 02 8A 74
			15 00 00 00 01 00 02 8B 01
			15 00 00 00 01 00 02 8C B1
			15 00 00 00 01 00 02 8D 01
			15 00 00 00 01 00 02 8E E2
			15 00 00 00 01 00 02 8F 02
			15 00 00 00 01 00 02 90 28
			15 00 00 00 01 00 02 91 02
			15 00 00 00 01 00 02 92 5B
			15 00 00 00 01 00 02 93 02
			15 00 00 00 01 00 02 94 5C
			15 00 00 00 01 00 02 95 02
			15 00 00 00 01 00 02 96 8E
			15 00 00 00 01 00 02 97 02
			15 00 00 00 01 00 02 98 C8
			15 00 00 00 01 00 02 99 02
			15 00 00 00 01 00 02 9A EC
			15 00 00 00 01 00 02 9B 03
			15 00 00 00 01 00 02 9C 1B
			15 00 00 00 01 00 02 9D 03
			15 00 00 00 01 00 02 9E 39
			15 00 00 00 01 00 02 9F 03
			15 00 00 00 01 00 02 A0 5F
			15 00 00 00 01 00 02 A2 03
			15 00 00 00 01 00 02 A3 6B
			15 00 00 00 01 00 02 A4 03
			15 00 00 00 01 00 02 A5 78
			15 00 00 00 01 00 02 A6 03
			15 00 00 00 01 00 02 A7 86
			15 00 00 00 01 00 02 A9 03
			15 00 00 00 01 00 02 AA 95
			15 00 00 00 01 00 02 AB 03
			15 00 00 00 01 00 02 AC A8
			15 00 00 00 01 00 02 AD 03
			15 00 00 00 01 00 02 AE BA
			15 00 00 00 01 00 02 AF 03
			15 00 00 00 01 00 02 B0 CC
			15 00 00 00 01 00 02 B1 03
			15 00 00 00 01 00 02 B2 D0
			15 00 00 00 01 00 02 B3 00
			15 00 00 00 01 00 02 B4 4C
			15 00 00 00 01 00 02 B5 00
			15 00 00 00 01 00 02 B6 8D
			15 00 00 00 01 00 02 B7 00
			15 00 00 00 01 00 02 B8 CB
			15 00 00 00 01 00 02 B9 00
			15 00 00 00 01 00 02 BA F0
			15 00 00 00 01 00 02 BB 01
			15 00 00 00 01 00 02 BC 0D
			15 00 00 00 01 00 02 BD 01
			15 00 00 00 01 00 02 BE 24
			15 00 00 00 01 00 02 BF 01
			15 00 00 00 01 00 02 C0 38
			15 00 00 00 01 00 02 C1 01
			15 00 00 00 01 00 02 C2 49
			15 00 00 00 01 00 02 C3 01
			15 00 00 00 01 00 02 C4 58
			15 00 00 00 01 00 02 C5 01
			15 00 00 00 01 00 02 C6 88
			15 00 00 00 01 00 02 C7 01
			15 00 00 00 01 00 02 C8 AB
			15 00 00 00 01 00 02 C9 01
			15 00 00 00 01 00 02 CA DE
			15 00 00 00 01 00 02 CB 02
			15 00 00 00 01 00 02 CC 03
			15 00 00 00 01 00 02 CD 02
			15 00 00 00 01 00 02 CE 3B
			15 00 00 00 01 00 02 CF 02
			15 00 00 00 01 00 02 D0 6E
			15 00 00 00 01 00 02 D1 02
			15 00 00 00 01 00 02 D2 6F
			15 00 00 00 01 00 02 D3 02
			15 00 00 00 01 00 02 D4 A1
			15 00 00 00 01 00 02 D5 02
			15 00 00 00 01 00 02 D6 D7
			15 00 00 00 01 00 02 D7 02
			15 00 00 00 01 00 02 D8 F9
			15 00 00 00 01 00 02 D9 03
			15 00 00 00 01 00 02 DA 24
			15 00 00 00 01 00 02 DB 03
			15 00 00 00 01 00 02 DC 40
			15 00 00 00 01 00 02 DD 03
			15 00 00 00 01 00 02 DE 64
			15 00 00 00 01 00 02 DF 03
			15 00 00 00 01 00 02 E0 6F
			15 00 00 00 01 00 02 E1 03
			15 00 00 00 01 00 02 E2 7B
			15 00 00 00 01 00 02 E3 03
			15 00 00 00 01 00 02 E4 89
			15 00 00 00 01 00 02 E5 03
			15 00 00 00 01 00 02 E6 97
			15 00 00 00 01 00 02 E7 03
			15 00 00 00 01 00 02 E8 A9
			15 00 00 00 01 00 02 E9 03
			15 00 00 00 01 00 02 EA BB
			15 00 00 00 01 00 02 EB 03
			15 00 00 00 01 00 02 EC CD
			15 00 00 00 01 00 02 ED 03
			15 00 00 00 01 00 02 EE D0
			15 00 00 00 01 00 02 EF 00
			15 00 00 00 01 00 02 F0 00
			15 00 00 00 01 00 02 F1 00
			15 00 00 00 01 00 02 F2 41
			15 00 00 00 01 00 02 F3 00
			15 00 00 00 01 00 02 F4 80
			15 00 00 00 01 00 02 F5 00
			15 00 00 00 01 00 02 F6 A7
			15 00 00 00 01 00 02 F7 00
			15 00 00 00 01 00 02 F8 C6
			15 00 00 00 01 00 02 F9 00
			15 01 00 00 01 00 02 FA DD
			15 00 00 00 01 00 02 FF 21
			15 00 00 00 01 00 02 00 00
			15 00 00 00 01 00 02 01 F3
			15 00 00 00 01 00 02 02 01
			15 00 00 00 01 00 02 03 06
			15 00 00 00 01 00 02 04 01
			15 00 00 00 01 00 02 05 15
			15 00 00 00 01 00 02 06 01
			15 00 00 00 01 00 02 07 4B
			15 00 00 00 01 00 02 08 01
			15 00 00 00 01 00 02 09 74
			15 00 00 00 01 00 02 0A 01
			15 00 00 00 01 00 02 0B B1
			15 00 00 00 01 00 02 0C 01
			15 00 00 00 01 00 02 0D E2
			15 00 00 00 01 00 02 0E 02
			15 00 00 00 01 00 02 0F 28
			15 00 00 00 01 00 02 10 02
			15 00 00 00 01 00 02 11 5B
			15 00 00 00 01 00 02 12 02
			15 00 00 00 01 00 02 13 5C
			15 00 00 00 01 00 02 14 02
			15 00 00 00 01 00 02 15 8E
			15 00 00 00 01 00 02 16 02
			15 00 00 00 01 00 02 17 C8
			15 00 00 00 01 00 02 18 02
			15 00 00 00 01 00 02 19 EC
			15 00 00 00 01 00 02 1A 03
			15 00 00 00 01 00 02 1B 1B
			15 00 00 00 01 00 02 1C 03
			15 00 00 00 01 00 02 1D 39
			15 00 00 00 01 00 02 1E 03
			15 00 00 00 01 00 02 1F 5F
			15 00 00 00 01 00 02 20 03
			15 00 00 00 01 00 02 21 6B
			15 00 00 00 01 00 02 22 03
			15 00 00 00 01 00 02 23 78
			15 00 00 00 01 00 02 24 03
			15 00 00 00 01 00 02 25 86
			15 00 00 00 01 00 02 26 03
			15 00 00 00 01 00 02 27 95
			15 00 00 00 01 00 02 28 03
			15 00 00 00 01 00 02 29 A8
			15 00 00 00 01 00 02 2A 03
			15 00 00 00 01 00 02 2B BA
			15 00 00 00 01 00 02 2D 03
			15 00 00 00 01 00 02 2F CC
			15 00 00 00 01 00 02 30 03
			15 00 00 00 01 00 02 31 D0
			15 00 00 00 01 00 02 32 00
			15 00 00 00 01 00 02 33 4C
			15 00 00 00 01 00 02 34 00
			15 00 00 00 01 00 02 35 8D
			15 00 00 00 01 00 02 36 00
			15 00 00 00 01 00 02 37 CB
			15 00 00 00 01 00 02 38 00
			15 00 00 00 01 00 02 39 F0
			15 00 00 00 01 00 02 3A 01
			15 00 00 00 01 00 02 3B 0D
			15 00 00 00 01 00 02 3D 01
			15 00 00 00 01 00 02 3F 24
			15 00 00 00 01 00 02 40 01
			15 00 00 00 01 00 02 41 38
			15 00 00 00 01 00 02 42 01
			15 00 00 00 01 00 02 43 49
			15 00 00 00 01 00 02 44 01
			15 00 00 00 01 00 02 45 58
			15 00 00 00 01 00 02 46 01
			15 00 00 00 01 00 02 47 88
			15 00 00 00 01 00 02 48 01
			15 00 00 00 01 00 02 49 AB
			15 00 00 00 01 00 02 4A 01
			15 00 00 00 01 00 02 4B DE
			15 00 00 00 01 00 02 4C 02
			15 00 00 00 01 00 02 4D 03
			15 00 00 00 01 00 02 4E 02
			15 00 00 00 01 00 02 4F 3B
			15 00 00 00 01 00 02 50 02
			15 00 00 00 01 00 02 51 6E
			15 00 00 00 01 00 02 52 02
			15 00 00 00 01 00 02 53 6F
			15 00 00 00 01 00 02 54 02
			15 00 00 00 01 00 02 55 A1
			15 00 00 00 01 00 02 56 02
			15 00 00 00 01 00 02 58 D7
			15 00 00 00 01 00 02 59 02
			15 00 00 00 01 00 02 5A F9
			15 00 00 00 01 00 02 5B 03
			15 00 00 00 01 00 02 5C 24
			15 00 00 00 01 00 02 5D 03
			15 00 00 00 01 00 02 5E 40
			15 00 00 00 01 00 02 5F 03
			15 00 00 00 01 00 02 60 64
			15 00 00 00 01 00 02 61 03
			15 00 00 00 01 00 02 62 6F
			15 00 00 00 01 00 02 63 03
			15 00 00 00 01 00 02 64 7B
			15 00 00 00 01 00 02 65 03
			15 00 00 00 01 00 02 66 89
			15 00 00 00 01 00 02 67 03
			15 00 00 00 01 00 02 68 97
			15 00 00 00 01 00 02 69 03
			15 00 00 00 01 00 02 6A A9
			15 00 00 00 01 00 02 6B 03
			15 00 00 00 01 00 02 6C BB
			15 00 00 00 01 00 02 6D 03
			15 00 00 00 01 00 02 6E CD
			15 00 00 00 01 00 02 6F 03
			15 00 00 00 01 00 02 70 D0
			15 00 00 00 01 00 02 71 00
			15 00 00 00 01 00 02 72 00
			15 00 00 00 01 00 02 73 00
			15 00 00 00 01 00 02 74 56
			15 00 00 00 01 00 02 75 00
			15 00 00 00 01 00 02 76 94
			15 00 00 00 01 00 02 77 00
			15 00 00 00 01 00 02 78 BB
			15 00 00 00 01 00 02 79 00
			15 00 00 00 01 00 02 7A DA
			15 00 00 00 01 00 02 7B 00
			15 00 00 00 01 00 02 7C F1
			15 00 00 00 01 00 02 7D 01
			15 00 00 00 01 00 02 7E 07
			15 00 00 00 01 00 02 7F 01
			15 00 00 00 01 00 02 80 1A
			15 00 00 00 01 00 02 81 01
			15 00 00 00 01 00 02 82 29
			15 00 00 00 01 00 02 83 01
			15 00 00 00 01 00 02 84 5F
			15 00 00 00 01 00 02 85 01
			15 00 00 00 01 00 02 86 88
			15 00 00 00 01 00 02 87 01
			15 00 00 00 01 00 02 88 BF
			15 00 00 00 01 00 02 89 01
			15 00 00 00 01 00 02 8A EB
			15 00 00 00 01 00 02 8B 02
			15 00 00 00 01 00 02 8C 2F
			15 00 00 00 01 00 02 8D 02
			15 00 00 00 01 00 02 8E 60
			15 00 00 00 01 00 02 8F 02
			15 00 00 00 01 00 02 90 61
			15 00 00 00 01 00 02 91 02
			15 00 00 00 01 00 02 92 92
			15 00 00 00 01 00 02 93 02
			15 00 00 00 01 00 02 94 CC
			15 00 00 00 01 00 02 95 02
			15 00 00 00 01 00 02 96 EF
			15 00 00 00 01 00 02 97 03
			15 00 00 00 01 00 02 98 20
			15 00 00 00 01 00 02 99 03
			15 00 00 00 01 00 02 9A 39
			15 00 00 00 01 00 02 9B 03
			15 00 00 00 01 00 02 9C 5F
			15 00 00 00 01 00 02 9D 03
			15 00 00 00 01 00 02 9E 6B
			15 00 00 00 01 00 02 9F 03
			15 00 00 00 01 00 02 A0 78
			15 00 00 00 01 00 02 A2 03
			15 00 00 00 01 00 02 A3 86
			15 00 00 00 01 00 02 A4 03
			15 00 00 00 01 00 02 A5 95
			15 00 00 00 01 00 02 A6 03
			15 00 00 00 01 00 02 A7 A8
			15 00 00 00 01 00 02 A9 03
			15 00 00 00 01 00 02 AA BA
			15 00 00 00 01 00 02 AB 03
			15 00 00 00 01 00 02 AC CC
			15 00 00 00 01 00 02 AD 03
			15 00 00 00 01 00 02 AE D0
			15 00 00 00 01 00 02 AF 00
			15 00 00 00 01 00 02 B0 4C
			15 00 00 00 01 00 02 B1 00
			15 00 00 00 01 00 02 B2 A2
			15 00 00 00 01 00 02 B3 00
			15 00 00 00 01 00 02 B4 DF
			15 00 00 00 01 00 02 B5 01
			15 00 00 00 01 00 02 B6 04
			15 00 00 00 01 00 02 B7 01
			15 00 00 00 01 00 02 B8 21
			15 00 00 00 01 00 02 B9 01
			15 00 00 00 01 00 02 BA 38
			15 00 00 00 01 00 02 BB 01
			15 00 00 00 01 00 02 BC 4C
			15 00 00 00 01 00 02 BD 01
			15 00 00 00 01 00 02 BE 5D
			15 00 00 00 01 00 02 BF 01
			15 00 00 00 01 00 02 C0 6C
			15 00 00 00 01 00 02 C1 01
			15 00 00 00 01 00 02 C2 9C
			15 00 00 00 01 00 02 C3 01
			15 00 00 00 01 00 02 C4 BF
			15 00 00 00 01 00 02 C5 01
			15 00 00 00 01 00 02 C6 EC
			15 00 00 00 01 00 02 C7 02
			15 00 00 00 01 00 02 C8 0D
			15 00 00 00 01 00 02 C9 02
			15 00 00 00 01 00 02 CA 42
			15 00 00 00 01 00 02 CB 02
			15 00 00 00 01 00 02 CC 73
			15 00 00 00 01 00 02 CD 02
			15 00 00 00 01 00 02 CE 74
			15 00 00 00 01 00 02 CF 02
			15 00 00 00 01 00 02 D0 A5
			15 00 00 00 01 00 02 D1 02
			15 00 00 00 01 00 02 D2 DB
			15 00 00 00 01 00 02 D3 02
			15 00 00 00 01 00 02 D4 FC
			15 00 00 00 01 00 02 D5 03
			15 00 00 00 01 00 02 D6 29
			15 00 00 00 01 00 02 D7 03
			15 00 00 00 01 00 02 D8 40
			15 00 00 00 01 00 02 D9 03
			15 00 00 00 01 00 02 DA 64
			15 00 00 00 01 00 02 DB 03
			15 00 00 00 01 00 02 DC 6F
			15 00 00 00 01 00 02 DD 03
			15 00 00 00 01 00 02 DE 7B
			15 00 00 00 01 00 02 DF 03
			15 00 00 00 01 00 02 E0 89
			15 00 00 00 01 00 02 E1 03
			15 00 00 00 01 00 02 E2 97
			15 00 00 00 01 00 02 E3 03
			15 00 00 00 01 00 02 E4 A9
			15 00 00 00 01 00 02 E5 03
			15 00 00 00 01 00 02 E6 BB
			15 00 00 00 01 00 02 E7 03
			15 00 00 00 01 00 02 E8 CD
			15 00 00 00 01 00 02 E9 03
			15 01 00 00 01 00 02 EA D0

			15 00 00 00 00 00 02 ff 23
			15 00 00 00 00 00 02 fb 01
			15 00 00 00 00 00 02 05 24

			15 00 00 00 00 00 02 ff 10
			15 00 00 00 00 00 02 51 ff
			15 00 00 00 00 00 02 53 2c
			15 00 00 00 00 00 02 55 00
			15 00 00 00 00 00 02 58 01

			05 01 00 00 78 00 02 11 00
			05 01 00 00 14 00 02 29 00
			];

		qcom,mdss-dsi-off-command = [
			05 01 00 00 02 00 02 28 00
			05 01 00 00 79 00 02 10 00
			];
		qcom,mdss-dsi-on-command-state = "dsi_lp_mode";
		qcom,mdss-dsi-off-command-state = "dsi_hs_mode";
		qcom,mdss-dsi-h-sync-pulse = <0>;
		qcom,mdss-dsi-traffic-mode = "burst_mode";
		qcom,mdss-dsi-bllp-eof-power-mode;
		qcom,mdss-dsi-bllp-power-mode;
		qcom,mdss-dsi-lane-0-state;
		qcom,mdss-dsi-lane-1-state;
		qcom,mdss-dsi-lane-2-state;
		qcom,mdss-dsi-lane-3-state;
		qcom,mdss-dsi-panel-timings = [b3 37 1d 00 96 94 20 3b 20 03 04 00];
		qcom,mdss-dsi-t-clk-post = <0x19>;
		qcom,mdss-dsi-t-clk-pre = <0x2f>;
		qcom,mdss-brightness-max-level = <4095>;
		qcom,mdss-dsi-dma-trigger = "trigger_sw";
		qcom,mdss-dsi-mdp-trigger = "none";
		qcom,mdss-dsi-reset-sequence = <1 10>, <0 10>, <1 10>;
		qcom,mdss-pan-physical-width-dimension = <71>;
		qcom,mdss-pan-physical-height-dimension = <126>;

		qcom,mdss-dsi-te-pin-select = <1>;
		qcom,mdss-dsi-wr-mem-start = <0x2c>;
		qcom,mdss-dsi-wr-mem-continue = <0x3c>;
		qcom,mdss-dsi-te-dcs-command = <1>;
		qcom,mdss-dsi-te-check-enable;
		qcom,mdss-dsi-te-using-te-pin;
		qcom,mdss-dual-enable-gpio = <&msm_gpio 143 0>;
		qcom,dispparam-enabled;
		qcom,mdss-dsi-dispparam-ceon-command = [15 00 00 00 01 00 02 ff 10 15 01 00 00 10 00 02 55 80];
		qcom,mdss-dsi-dispparam-ceoff-command = [15 00 00 00 01 00 02 ff 10 15 01 00 00 10 00 02 55 00];
		qcom,mdss-dsi-dispparam-cabcon-command = <0x15000000 0x10002ff 0x10150000 0x10002 0x51ff1500 0x100 0x2532c15 0x1000001 0x25502>;
		qcom,mdss-dsi-dispparam-cabcguion-command = [15 00 00 00 01 00 02 ff 10 15 01 00 00 01 00 02 55 01];
		qcom,mdss-dsi-dispparam-cabcstillon-command = [15 00 00 00 01 00 02 ff 10 15 01 00 00 01 00 02 55 02];
		qcom,mdss-dsi-dispparam-cabcmovieon-command = [15 00 00 00 01 00 02 ff 10 15 01 00 00 01 00 02 55 03];
		qcom,mdss-dsi-dispparam-cabcoff-command = [15 00 00 00 01 00 02 ff 10 15 01 00 00 01 00 02 55 00];
		qcom,mdss-dsi-dispparam-warm-command = [15 00 00 00 01 00 02 ff 20 15 00 00 00 01 00 02 75 00 15 00 00 00 01 00 02 76 00 15 00 00 00 01 00 02 77 00 15 00 00 00 01 00 02 78 41 15 00 00 00 01 00 02 79 00 15 00 00 00 01 00 02 7a 80 15 00 00 00 01 00 02 7b 00 15 00 00 00 01 00 02 7c a7 15 00 00 00 01 00 02 7d 00 15 00 00 00 01 00 02 7e c6 15 00 00 00 01 00 02 7f 00 15 00 00 00 01 00 02 80 dd 15 00 00 00 01 00 02 81 00 15 00 00 00 01 00 02 82 f3 15 00 00 00 01 00 02 83 01 15 00 00 00 01 00 02 84 06 15 00 00 00 01 00 02 85 01 15 00 00 00 01 00 02 86 15 15 00 00 00 01 00 02 87 01 15 00 00 00 01 00 02 88 4b 15 00 00 00 01 00 02 89 01 15 00 00 00 01 00 02 8a 74 15 00 00 00 01 00 02 8b 01 15 00 00 00 01 00 02 8c b1 15 00 00 00 01 00 02 8d 01 15 00 00 00 01 00 02 8e e2 15 00 00 00 01 00 02 8f 02 15 00 00 00 01 00 02 90 28 15 00 00 00 01 00 02 91 02 15 00 00 00 01 00 02 92 5b 15 00 00 00 01 00 02 93 02 15 00 00 00 01 00 02 94 5c 15 00 00 00 01 00 02 95 02 15 00 00 00 01 00 02 96 8e 15 00 00 00 01 00 02 97 02 15 00 00 00 01 00 02 98 c8 15 00 00 00 01 00 02 99 02 15 00 00 00 01 00 02 9a ec 15 00 00 00 01 00 02 9b 03 15 00 00 00 01 00 02 9c 1b 15 00 00 00 01 00 02 9d 03 15 00 00 00 01 00 02 9e 39 15 00 00 00 01 00 02 9f 03 15 00 00 00 01 00 02 a0 5f 15 00 00 00 01 00 02 a2 03 15 00 00 00 01 00 02 a3 6b 15 00 00 00 01 00 02 a4 03 15 00 00 00 01 00 02 a5 78 15 00 00 00 01 00 02 a6 03 15 00 00 00 01 00 02 a7 86 15 00 00 00 01 00 02 a9 03 15 00 00 00 01 00 02 aa 95 15 00 00 00 01 00 02 ab 03 15 00 00 00 01 00 02 ac a8 15 00 00 00 01 00 02 ad 03 15 00 00 00 01 00 02 ae ba 15 00 00 00 01 00 02 af 03 15 00 00 00 01 00 02 b0 cc 15 00 00 00 01 00 02 b1 03 15 00 00 00 01 00 02 b2 d0 15 00 00 00 01 00 02 b3 00 15 00 00 00 01 00 02 b4 4c 15 00 00 00 01 00 02 b5 00 15 00 00 00 01 00 02 b6 8d 15 00 00 00 01 00 02 b7 00 15 00 00 00 01 00 02 b8 cb 15 00 00 00 01 00 02 b9 00 15 00 00 00 01 00 02 ba f0 15 00 00 00 01 00 02 bb 01 15 00 00 00 01 00 02 bc 0d 15 00 00 00 01 00 02 bd 01 15 00 00 00 01 00 02 be 24 15 00 00 00 01 00 02 bf 01 15 00 00 00 01 00 02 c0 38 15 00 00 00 01 00 02 c1 01 15 00 00 00 01 00 02 c2 49 15 00 00 00 01 00 02 c3 01 15 00 00 00 01 00 02 c4 58 15 00 00 00 01 00 02 c5 01 15 00 00 00 01 00 02 c6 88 15 00 00 00 01 00 02 c7 01 15 00 00 00 01 00 02 c8 ab 15 00 00 00 01 00 02 c9 01 15 00 00 00 01 00 02 ca de 15 00 00 00 01 00 02 cb 02 15 00 00 00 01 00 02 cc 03 15 00 00 00 01 00 02 cd 02 15 00 00 00 01 00 02 ce 3b 15 00 00 00 01 00 02 cf 02 15 00 00 00 01 00 02 d0 6e 15 00 00 00 01 00 02 d1 02 15 00 00 00 01 00 02 d2 6f 15 00 00 00 01 00 02 d3 02 15 00 00 00 01 00 02 d4 a1 15 00 00 00 01 00 02 d5 02 15 00 00 00 01 00 02 d6 d7 15 00 00 00 01 00 02 d7 02 15 00 00 00 01 00 02 d8 f9 15 00 00 00 01 00 02 d9 03 15 00 00 00 01 00 02 da 24 15 00 00 00 01 00 02 db 03 15 00 00 00 01 00 02 dc 40 15 00 00 00 01 00 02 dd 03 15 00 00 00 01 00 02 de 64 15 00 00 00 01 00 02 df 03 15 00 00 00 01 00 02 e0 6f 15 00 00 00 01 00 02 e1 03 15 00 00 00 01 00 02 e2 7b 15 00 00 00 01 00 02 e3 03 15 00 00 00 01 00 02 e4 89 15 00 00 00 01 00 02 e5 03 15 00 00 00 01 00 02 e6 97 15 00 00 00 01 00 02 e7 03 15 00 00 00 01 00 02 e8 a9 15 00 00 00 01 00 02 e9 03 15 00 00 00 01 00 02 ea bb 15 00 00 00 01 00 02 eb 03 15 00 00 00 01 00 02 ec cd 15 00 00 00 01 00 02 ed 03 15 00 00 00 01 00 02 ee d0 15 00 00 00 01 00 02 ef 00 15 00 00 00 01 00 02 f0 83 15 00 00 00 01 00 02 f1 00 15 00 00 00 01 00 02 f2 96 15 00 00 00 01 00 02 f3 00 15 00 00 00 01 00 02 f4 b9 15 00 00 00 01 00 02 f5 00 15 00 00 00 01 00 02 f6 d4 15 00 00 00 01 00 02 f7 00 15 00 00 00 01 00 02 f8 ea 15 00 00 00 01 00 02 f9 00 15 01 00 00 01 00 02 fa fe 15 00 00 00 01 00 02 ff 21 15 00 00 00 01 00 02 00 01 15 00 00 00 01 00 02 01 0f 15 00 00 00 01 00 02 02 01 15 00 00 00 01 00 02 03 1f 15 00 00 00 01 00 02 04 01 15 00 00 00 01 00 02 05 2e 15 00 00 00 01 00 02 06 01 15 00 00 00 01 00 02 07 5c 15 00 00 00 01 00 02 08 01 15 00 00 00 01 00 02 09 80 15 00 00 00 01 00 02 0a 01 15 00 00 00 01 00 02 0b bb 15 00 00 00 01 00 02 0c 01 15 00 00 00 01 00 02 0d e7 15 00 00 00 01 00 02 0e 02 15 00 00 00 01 00 02 0f 2b 15 00 00 00 01 00 02 10 02 15 00 00 00 01 00 02 11 5d 15 00 00 00 01 00 02 12 02 15 00 00 00 01 00 02 13 5e 15 00 00 00 01 00 02 14 02 15 00 00 00 01 00 02 15 8e 15 00 00 00 01 00 02 16 02 15 00 00 00 01 00 02 17 c9 15 00 00 00 01 00 02 18 02 15 00 00 00 01 00 02 19 ee 15 00 00 00 01 00 02 1a 03 15 00 00 00 01 00 02 1b 1c 15 00 00 00 01 00 02 1c 03 15 00 00 00 01 00 02 1d 3b 15 00 00 00 01 00 02 1e 03 15 00 00 00 01 00 02 1f 61 15 00 00 00 01 00 02 20 03 15 00 00 00 01 00 02 21 6c 15 00 00 00 01 00 02 22 03 15 00 00 00 01 00 02 23 79 15 00 00 00 01 00 02 24 03 15 00 00 00 01 00 02 25 87 15 00 00 00 01 00 02 26 03 15 00 00 00 01 00 02 27 97 15 00 00 00 01 00 02 28 03 15 00 00 00 01 00 02 29 a9 15 00 00 00 01 00 02 2a 03 15 00 00 00 01 00 02 2b bb 15 00 00 00 01 00 02 2d 03 15 00 00 00 01 00 02 2f cc 15 00 00 00 01 00 02 30 03 15 00 00 00 01 00 02 31 d0 15 00 00 00 01 00 02 32 00 15 00 00 00 01 00 02 33 c8 15 00 00 00 01 00 02 34 00 15 00 00 00 01 00 02 35 db 15 00 00 00 01 00 02 36 00 15 00 00 00 01 00 02 37 fc 15 00 00 00 01 00 02 38 01 15 00 00 00 01 00 02 39 16 15 00 00 00 01 00 02 3a 01 15 00 00 00 01 00 02 3b 2b 15 00 00 00 01 00 02 3d 01 15 00 00 00 01 00 02 3f 3d 15 00 00 00 01 00 02 40 01 15 00 00 00 01 00 02 41 4e 15 00 00 00 01 00 02 42 01 15 00 00 00 01 00 02 43 5c 15 00 00 00 01 00 02 44 01 15 00 00 00 01 00 02 45 6a 15 00 00 00 01 00 02 46 01 15 00 00 00 01 00 02 47 93 15 00 00 00 01 00 02 48 01 15 00 00 00 01 00 02 49 b3 15 00 00 00 01 00 02 4a 01 15 00 00 00 01 00 02 4b e4 15 00 00 00 01 00 02 4c 02 15 00 00 00 01 00 02 4d 06 15 00 00 00 01 00 02 4e 02 15 00 00 00 01 00 02 4f 3e 15 00 00 00 01 00 02 50 02 15 00 00 00 01 00 02 51 70 15 00 00 00 01 00 02 52 02 15 00 00 00 01 00 02 53 71 15 00 00 00 01 00 02 54 02 15 00 00 00 01 00 02 55 a1 15 00 00 00 01 00 02 56 02 15 00 00 00 01 00 02 58 d8 15 00 00 00 01 00 02 59 02 15 00 00 00 01 00 02 5a fb 15 00 00 00 01 00 02 5b 03 15 00 00 00 01 00 02 5c 25 15 00 00 00 01 00 02 5d 03 15 00 00 00 01 00 02 5e 42 15 00 00 00 01 00 02 5f 03 15 00 00 00 01 00 02 60 66 15 00 00 00 01 00 02 61 03 15 00 00 00 01 00 02 62 70 15 00 00 00 01 00 02 63 03 15 00 00 00 01 00 02 64 7c 15 00 00 00 01 00 02 65 03 15 00 00 00 01 00 02 66 8a 15 00 00 00 01 00 02 67 03 15 00 00 00 01 00 02 68 99 15 00 00 00 01 00 02 69 03 15 00 00 00 01 00 02 6a aa 15 00 00 00 01 00 02 6b 03 15 00 00 00 01 00 02 6c bc 15 00 00 00 01 00 02 6d 03 15 00 00 00 01 00 02 6e cd 15 00 00 00 01 00 02 6f 03 15 00 00 00 01 00 02 70 d0 15 00 00 00 01 00 02 71 01 15 00 00 00 01 00 02 72 60 15 00 00 00 01 00 02 73 01 15 00 00 00 01 00 02 74 69 15 00 00 00 01 00 02 75 01 15 00 00 00 01 00 02 76 71 15 00 00 00 01 00 02 77 01 15 00 00 00 01 00 02 78 79 15 00 00 00 01 00 02 79 01 15 00 00 00 01 00 02 7a 81 15 00 00 00 01 00 02 7b 01 15 00 00 00 01 00 02 7c 88 15 00 00 00 01 00 02 7d 01 15 00 00 00 01 00 02 7e 90 15 00 00 00 01 00 02 7f 01 15 00 00 00 01 00 02 80 97 15 00 00 00 01 00 02 81 01 15 00 00 00 01 00 02 82 9e 15 00 00 00 01 00 02 83 01 15 00 00 00 01 00 02 84 b6 15 00 00 00 01 00 02 85 01 15 00 00 00 01 00 02 86 cc 15 00 00 00 01 00 02 87 01 15 00 00 00 01 00 02 88 f1 15 00 00 00 01 00 02 89 02 15 00 00 00 01 00 02 8a 11 15 00 00 00 01 00 02 8b 02 15 00 00 00 01 00 02 8c 46 15 00 00 00 01 00 02 8d 02 15 00 00 00 01 00 02 8e 72 15 00 00 00 01 00 02 8f 02 15 00 00 00 01 00 02 90 73 15 00 00 00 01 00 02 91 02 15 00 00 00 01 00 02 92 a0 15 00 00 00 01 00 02 93 02 15 00 00 00 01 00 02 94 d7 15 00 00 00 01 00 02 95 02 15 00 00 00 01 00 02 96 fb 15 00 00 00 01 00 02 97 03 15 00 00 00 01 00 02 98 2b 15 00 00 00 01 00 02 99 03 15 00 00 00 01 00 02 9a 44 15 00 00 00 01 00 02 9b 03 15 00 00 00 01 00 02 9c 68 15 00 00 00 01 00 02 9d 03 15 00 00 00 01 00 02 9e 74 15 00 00 00 01 00 02 9f 03 15 00 00 00 01 00 02 a0 80 15 00 00 00 01 00 02 a2 03 15 00 00 00 01 00 02 a3 8d 15 00 00 00 01 00 02 a4 03 15 00 00 00 01 00 02 a5 9b 15 00 00 00 01 00 02 a6 03 15 00 00 00 01 00 02 a7 ac 15 00 00 00 01 00 02 a9 03 15 00 00 00 01 00 02 aa be 15 00 00 00 01 00 02 ab 03 15 00 00 00 01 00 02 ac cc 15 00 00 00 01 00 02 ad 03 15 00 00 00 01 00 02 ae d0 15 00 00 00 01 00 02 af 01 15 00 00 00 01 00 02 b0 92 15 00 00 00 01 00 02 b1 01 15 00 00 00 01 00 02 b2 9b 15 00 00 00 01 00 02 b3 01 15 00 00 00 01 00 02 b4 a2 15 00 00 00 01 00 02 b5 01 15 00 00 00 01 00 02 b6 aa 15 00 00 00 01 00 02 b7 01 15 00 00 00 01 00 02 b8 b0 15 00 00 00 01 00 02 b9 01 15 00 00 00 01 00 02 ba b7 15 00 00 00 01 00 02 bb 01 15 00 00 00 01 00 02 bc bf 15 00 00 00 01 00 02 bd 01 15 00 00 00 01 00 02 be c4 15 00 00 00 01 00 02 bf 01 15 00 00 00 01 00 02 c0 cb 15 00 00 00 01 00 02 c1 01 15 00 00 00 01 00 02 c2 e0 15 00 00 00 01 00 02 c3 01 15 00 00 00 01 00 02 c4 f3 15 00 00 00 01 00 02 c5 02 15 00 00 00 01 00 02 c6 12 15 00 00 00 01 00 02 c7 02 15 00 00 00 01 00 02 c8 2c 15 00 00 00 01 00 02 c9 02 15 00 00 00 01 00 02 ca 59 15 00 00 00 01 00 02 cb 02 15 00 00 00 01 00 02 cc 85 15 00 00 00 01 00 02 cd 02 15 00 00 00 01 00 02 ce 86 15 00 00 00 01 00 02 cf 02 15 00 00 00 01 00 02 d0 b3 15 00 00 00 01 00 02 d1 02 15 00 00 00 01 00 02 d2 e6 15 00 00 00 01 00 02 d3 03 15 00 00 00 01 00 02 d4 08 15 00 00 00 01 00 02 d5 03 15 00 00 00 01 00 02 d6 34 15 00 00 00 01 00 02 d7 03 15 00 00 00 01 00 02 d8 4b 15 00 00 00 01 00 02 d9 03 15 00 00 00 01 00 02 da 6d 15 00 00 00 01 00 02 db 03 15 00 00 00 01 00 02 dc 78 15 00 00 00 01 00 02 dd 03 15 00 00 00 01 00 02 de 83 15 00 00 00 01 00 02 df 03 15 00 00 00 01 00 02 e0 90 15 00 00 00 01 00 02 e1 03 15 00 00 00 01 00 02 e2 9e 15 00 00 00 01 00 02 e3 03 15 00 00 00 01 00 02 e4 ad 15 00 00 00 01 00 02 e5 03 15 00 00 00 01 00 02 e6 bf 15 00 00 00 01 00 02 e7 03 15 00 00 00 01 00 02 e8 cd 15 00 00 00 01 00 02 e9 03 15 01 00 00 01 00 02 ea d0];
		qcom,mdss-dsi-dispparam-warm-command-state = "dsi_hs_mode";
		qcom,mdss-dsi-dispparam-default-command = [15 01 00 00 01 00 02 ff 20 15 00 00 00 01 00 02 75 00 15 00 00 00 01 00 02 76 00 15 00 00 00 01 00 02 77 00 15 00 00 00 01 00 02 78 41 15 00 00 00 01 00 02 79 00 15 00 00 00 01 00 02 7a 80 15 00 00 00 01 00 02 7b 00 15 00 00 00 01 00 02 7c a7 15 00 00 00 01 00 02 7d 00 15 00 00 00 01 00 02 7e c6 15 00 00 00 01 00 02 7f 00 15 00 00 00 01 00 02 80 dd 15 00 00 00 01 00 02 81 00 15 00 00 00 01 00 02 82 f3 15 00 00 00 01 00 02 83 01 15 00 00 00 01 00 02 84 06 15 00 00 00 01 00 02 85 01 15 00 00 00 01 00 02 86 15 15 00 00 00 01 00 02 87 01 15 00 00 00 01 00 02 88 4b 15 00 00 00 01 00 02 89 01 15 00 00 00 01 00 02 8a 74 15 00 00 00 01 00 02 8b 01 15 00 00 00 01 00 02 8c b1 15 00 00 00 01 00 02 8d 01 15 00 00 00 01 00 02 8e e2 15 00 00 00 01 00 02 8f 02 15 00 00 00 01 00 02 90 28 15 00 00 00 01 00 02 91 02 15 00 00 00 01 00 02 92 5b 15 00 00 00 01 00 02 93 02 15 00 00 00 01 00 02 94 5c 15 00 00 00 01 00 02 95 02 15 00 00 00 01 00 02 96 8e 15 00 00 00 01 00 02 97 02 15 00 00 00 01 00 02 98 c8 15 00 00 00 01 00 02 99 02 15 00 00 00 01 00 02 9a ec 15 00 00 00 01 00 02 9b 03 15 00 00 00 01 00 02 9c 1b 15 00 00 00 01 00 02 9d 03 15 00 00 00 01 00 02 9e 39 15 00 00 00 01 00 02 9f 03 15 00 00 00 01 00 02 a0 5f 15 00 00 00 01 00 02 a2 03 15 00 00 00 01 00 02 a3 6b 15 00 00 00 01 00 02 a4 03 15 00 00 00 01 00 02 a5 78 15 00 00 00 01 00 02 a6 03 15 00 00 00 01 00 02 a7 86 15 00 00 00 01 00 02 a9 03 15 00 00 00 01 00 02 aa 95 15 00 00 00 01 00 02 ab 03 15 00 00 00 01 00 02 ac a8 15 00 00 00 01 00 02 ad 03 15 00 00 00 01 00 02 ae ba 15 00 00 00 01 00 02 af 03 15 00 00 00 01 00 02 b0 cc 15 00 00 00 01 00 02 b1 03 15 00 00 00 01 00 02 b2 d0 15 00 00 00 01 00 02 b3 00 15 00 00 00 01 00 02 b4 4c 15 00 00 00 01 00 02 b5 00 15 00 00 00 01 00 02 b6 8d 15 00 00 00 01 00 02 b7 00 15 00 00 00 01 00 02 b8 cb 15 00 00 00 01 00 02 b9 00 15 00 00 00 01 00 02 ba f0 15 00 00 00 01 00 02 bb 01 15 00 00 00 01 00 02 bc 0d 15 00 00 00 01 00 02 bd 01 15 00 00 00 01 00 02 be 24 15 00 00 00 01 00 02 bf 01 15 00 00 00 01 00 02 c0 38 15 00 00 00 01 00 02 c1 01 15 00 00 00 01 00 02 c2 49 15 00 00 00 01 00 02 c3 01 15 00 00 00 01 00 02 c4 58 15 00 00 00 01 00 02 c5 01 15 00 00 00 01 00 02 c6 88 15 00 00 00 01 00 02 c7 01 15 00 00 00 01 00 02 c8 ab 15 00 00 00 01 00 02 c9 01 15 00 00 00 01 00 02 ca de 15 00 00 00 01 00 02 cb 02 15 00 00 00 01 00 02 cc 03 15 00 00 00 01 00 02 cd 02 15 00 00 00 01 00 02 ce 3b 15 00 00 00 01 00 02 cf 02 15 00 00 00 01 00 02 d0 6e 15 00 00 00 01 00 02 d1 02 15 00 00 00 01 00 02 d2 6f 15 00 00 00 01 00 02 d3 02 15 00 00 00 01 00 02 d4 a1 15 00 00 00 01 00 02 d5 02 15 00 00 00 01 00 02 d6 d7 15 00 00 00 01 00 02 d7 02 15 00 00 00 01 00 02 d8 f9 15 00 00 00 01 00 02 d9 03 15 00 00 00 01 00 02 da 24 15 00 00 00 01 00 02 db 03 15 00 00 00 01 00 02 dc 40 15 00 00 00 01 00 02 dd 03 15 00 00 00 01 00 02 de 64 15 00 00 00 01 00 02 df 03 15 00 00 00 01 00 02 e0 6f 15 00 00 00 01 00 02 e1 03 15 00 00 00 01 00 02 e2 7b 15 00 00 00 01 00 02 e3 03 15 00 00 00 01 00 02 e4 89 15 00 00 00 01 00 02 e5 03 15 00 00 00 01 00 02 e6 97 15 00 00 00 01 00 02 e7 03 15 00 00 00 01 00 02 e8 a9 15 00 00 00 01 00 02 e9 03 15 00 00 00 01 00 02 ea bb 15 00 00 00 01 00 02 eb 03 15 00 00 00 01 00 02 ec cd 15 00 00 00 01 00 02 ed 03 15 00 00 00 01 00 02 ee d0 15 00 00 00 01 00 02 ef 00 15 00 00 00 01 00 02 f0 00 15 00 00 00 01 00 02 f1 00 15 00 00 00 01 00 02 f2 41 15 00 00 00 01 00 02 f3 00 15 00 00 00 01 00 02 f4 80 15 00 00 00 01 00 02 f5 00 15 00 00 00 01 00 02 f6 a7 15 00 00 00 01 00 02 f7 00 15 00 00 00 01 00 02 f8 c6 15 00 00 00 01 00 02 f9 00 15 01 00 00 01 00 02 fa dd 15 00 00 00 01 00 02 ff 21 15 00 00 00 01 00 02 00 00 15 00 00 00 01 00 02 01 f3 15 00 00 00 01 00 02 02 01 15 00 00 00 01 00 02 03 06 15 00 00 00 01 00 02 04 01 15 00 00 00 01 00 02 05 15 15 00 00 00 01 00 02 06 01 15 00 00 00 01 00 02 07 4b 15 00 00 00 01 00 02 08 01 15 00 00 00 01 00 02 09 74 15 00 00 00 01 00 02 0a 01 15 00 00 00 01 00 02 0b b1 15 00 00 00 01 00 02 0c 01 15 00 00 00 01 00 02 0d e2 15 00 00 00 01 00 02 0e 02 15 00 00 00 01 00 02 0f 28 15 00 00 00 01 00 02 10 02 15 00 00 00 01 00 02 11 5b 15 00 00 00 01 00 02 12 02 15 00 00 00 01 00 02 13 5c 15 00 00 00 01 00 02 14 02 15 00 00 00 01 00 02 15 8e 15 00 00 00 01 00 02 16 02 15 00 00 00 01 00 02 17 c8 15 00 00 00 01 00 02 18 02 15 00 00 00 01 00 02 19 ec 15 00 00 00 01 00 02 1a 03 15 00 00 00 01 00 02 1b 1b 15 00 00 00 01 00 02 1c 03 15 00 00 00 01 00 02 1d 39 15 00 00 00 01 00 02 1e 03 15 00 00 00 01 00 02 1f 5f 15 00 00 00 01 00 02 20 03 15 00 00 00 01 00 02 21 6b 15 00 00 00 01 00 02 22 03 15 00 00 00 01 00 02 23 78 15 00 00 00 01 00 02 24 03 15 00 00 00 01 00 02 25 86 15 00 00 00 01 00 02 26 03 15 00 00 00 01 00 02 27 95 15 00 00 00 01 00 02 28 03 15 00 00 00 01 00 02 29 a8 15 00 00 00 01 00 02 2a 03 15 00 00 00 01 00 02 2b ba 15 00 00 00 01 00 02 2d 03 15 00 00 00 01 00 02 2f cc 15 00 00 00 01 00 02 30 03 15 00 00 00 01 00 02 31 d0 15 00 00 00 01 00 02 32 00 15 00 00 00 01 00 02 33 4c 15 00 00 00 01 00 02 34 00 15 00 00 00 01 00 02 35 8d 15 00 00 00 01 00 02 36 00 15 00 00 00 01 00 02 37 cb 15 00 00 00 01 00 02 38 00 15 00 00 00 01 00 02 39 f0 15 00 00 00 01 00 02 3a 01 15 00 00 00 01 00 02 3b 0d 15 00 00 00 01 00 02 3d 01 15 00 00 00 01 00 02 3f 24 15 00 00 00 01 00 02 40 01 15 00 00 00 01 00 02 41 38 15 00 00 00 01 00 02 42 01 15 00 00 00 01 00 02 43 49 15 00 00 00 01 00 02 44 01 15 00 00 00 01 00 02 45 58 15 00 00 00 01 00 02 46 01 15 00 00 00 01 00 02 47 88 15 00 00 00 01 00 02 48 01 15 00 00 00 01 00 02 49 ab 15 00 00 00 01 00 02 4a 01 15 00 00 00 01 00 02 4b de 15 00 00 00 01 00 02 4c 02 15 00 00 00 01 00 02 4d 03 15 00 00 00 01 00 02 4e 02 15 00 00 00 01 00 02 4f 3b 15 00 00 00 01 00 02 50 02 15 00 00 00 01 00 02 51 6e 15 00 00 00 01 00 02 52 02 15 00 00 00 01 00 02 53 6f 15 00 00 00 01 00 02 54 02 15 00 00 00 01 00 02 55 a1 15 00 00 00 01 00 02 56 02 15 00 00 00 01 00 02 58 d7 15 00 00 00 01 00 02 59 02 15 00 00 00 01 00 02 5a f9 15 00 00 00 01 00 02 5b 03 15 00 00 00 01 00 02 5c 24 15 00 00 00 01 00 02 5d 03 15 00 00 00 01 00 02 5e 40 15 00 00 00 01 00 02 5f 03 15 00 00 00 01 00 02 60 64 15 00 00 00 01 00 02 61 03 15 00 00 00 01 00 02 62 6f 15 00 00 00 01 00 02 63 03 15 00 00 00 01 00 02 64 7b 15 00 00 00 01 00 02 65 03 15 00 00 00 01 00 02 66 89 15 00 00 00 01 00 02 67 03 15 00 00 00 01 00 02 68 97 15 00 00 00 01 00 02 69 03 15 00 00 00 01 00 02 6a a9 15 00 00 00 01 00 02 6b 03 15 00 00 00 01 00 02 6c bb 15 00 00 00 01 00 02 6d 03 15 00 00 00 01 00 02 6e cd 15 00 00 00 01 00 02 6f 03 15 00 00 00 01 00 02 70 d0 15 00 00 00 01 00 02 71 00 15 00 00 00 01 00 02 72 00 15 00 00 00 01 00 02 73 00 15 00 00 00 01 00 02 74 56 15 00 00 00 01 00 02 75 00 15 00 00 00 01 00 02 76 94 15 00 00 00 01 00 02 77 00 15 00 00 00 01 00 02 78 bb 15 00 00 00 01 00 02 79 00 15 00 00 00 01 00 02 7a da 15 00 00 00 01 00 02 7b 00 15 00 00 00 01 00 02 7c f1 15 00 00 00 01 00 02 7d 01 15 00 00 00 01 00 02 7e 07 15 00 00 00 01 00 02 7f 01 15 00 00 00 01 00 02 80 1a 15 00 00 00 01 00 02 81 01 15 00 00 00 01 00 02 82 29 15 00 00 00 01 00 02 83 01 15 00 00 00 01 00 02 84 5f 15 00 00 00 01 00 02 85 01 15 00 00 00 01 00 02 86 88 15 00 00 00 01 00 02 87 01 15 00 00 00 01 00 02 88 bf 15 00 00 00 01 00 02 89 01 15 00 00 00 01 00 02 8a eb 15 00 00 00 01 00 02 8b 02 15 00 00 00 01 00 02 8c 2f 15 00 00 00 01 00 02 8d 02 15 00 00 00 01 00 02 8e 60 15 00 00 00 01 00 02 8f 02 15 00 00 00 01 00 02 90 61 15 00 00 00 01 00 02 91 02 15 00 00 00 01 00 02 92 92 15 00 00 00 01 00 02 93 02 15 00 00 00 01 00 02 94 cc 15 00 00 00 01 00 02 95 02 15 00 00 00 01 00 02 96 ef 15 00 00 00 01 00 02 97 03 15 00 00 00 01 00 02 98 20 15 00 00 00 01 00 02 99 03 15 00 00 00 01 00 02 9a 39 15 00 00 00 01 00 02 9b 03 15 00 00 00 01 00 02 9c 5f 15 00 00 00 01 00 02 9d 03 15 00 00 00 01 00 02 9e 6b 15 00 00 00 01 00 02 9f 03 15 00 00 00 01 00 02 a0 78 15 00 00 00 01 00 02 a2 03 15 00 00 00 01 00 02 a3 86 15 00 00 00 01 00 02 a4 03 15 00 00 00 01 00 02 a5 95 15 00 00 00 01 00 02 a6 03 15 00 00 00 01 00 02 a7 a8 15 00 00 00 01 00 02 a9 03 15 00 00 00 01 00 02 aa ba 15 00 00 00 01 00 02 ab 03 15 00 00 00 01 00 02 ac cc 15 00 00 00 01 00 02 ad 03 15 00 00 00 01 00 02 ae d0 15 00 00 00 01 00 02 af 00 15 00 00 00 01 00 02 b0 4c 15 00 00 00 01 00 02 b1 00 15 00 00 00 01 00 02 b2 a2 15 00 00 00 01 00 02 b3 00 15 00 00 00 01 00 02 b4 df 15 00 00 00 01 00 02 b5 01 15 00 00 00 01 00 02 b6 04 15 00 00 00 01 00 02 b7 01 15 00 00 00 01 00 02 b8 21 15 00 00 00 01 00 02 b9 01 15 00 00 00 01 00 02 ba 38 15 00 00 00 01 00 02 bb 01 15 00 00 00 01 00 02 bc 4c 15 00 00 00 01 00 02 bd 01 15 00 00 00 01 00 02 be 5d 15 00 00 00 01 00 02 bf 01 15 00 00 00 01 00 02 c0 6c 15 00 00 00 01 00 02 c1 01 15 00 00 00 01 00 02 c2 9c 15 00 00 00 01 00 02 c3 01 15 00 00 00 01 00 02 c4 bf 15 00 00 00 01 00 02 c5 01 15 00 00 00 01 00 02 c6 ec 15 00 00 00 01 00 02 c7 02 15 00 00 00 01 00 02 c8 0d 15 00 00 00 01 00 02 c9 02 15 00 00 00 01 00 02 ca 42 15 00 00 00 01 00 02 cb 02 15 00 00 00 01 00 02 cc 73 15 00 00 00 01 00 02 cd 02 15 00 00 00 01 00 02 ce 74 15 00 00 00 01 00 02 cf 02 15 00 00 00 01 00 02 d0 a5 15 00 00 00 01 00 02 d1 02 15 00 00 00 01 00 02 d2 db 15 00 00 00 01 00 02 d3 02 15 00 00 00 01 00 02 d4 fc 15 00 00 00 01 00 02 d5 03 15 00 00 00 01 00 02 d6 29 15 00 00 00 01 00 02 d7 03 15 00 00 00 01 00 02 d8 40 15 00 00 00 01 00 02 d9 03 15 00 00 00 01 00 02 da 64 15 00 00 00 01 00 02 db 03 15 00 00 00 01 00 02 dc 6f 15 00 00 00 01 00 02 dd 03 15 00 00 00 01 00 02 de 7b 15 00 00 00 01 00 02 df 03 15 00 00 00 01 00 02 e0 89 15 00 00 00 01 00 02 e1 03 15 00 00 00 01 00 02 e2 97 15 00 00 00 01 00 02 e3 03 15 00 00 00 01 00 02 e4 a9 15 00 00 00 01 00 02 e5 03 15 00 00 00 01 00 02 e6 bb 15 00 00 00 01 00 02 e7 03 15 00 00 00 01 00 02 e8 cd 15 00 00 00 01 00 02 e9 03 15 01 00 00 01 00 02 ea d0];
		qcom,mdss-dsi-dispparam-default-command-state = "dsi_hs_mode";
		qcom,mdss-dsi-dispparam-cold-command = [15 00 00 00 00 00 02 ff 20 15 00 00 00 00 00 02 75 00 15 00 00 00 00 00 02 76 da 15 00 00 00 00 00 02 77 00 15 00 00 00 00 00 02 78 e5 15 00 00 00 00 00 02 79 00 15 00 00 00 00 00 02 7a f8 15 00 00 00 00 00 02 7b 01 15 00 00 00 00 00 02 7c 09 15 00 00 00 00 00 02 7d 01 15 00 00 00 00 00 02 7e 19 15 00 00 00 00 00 02 7f 01 15 00 00 00 00 00 02 80 28 15 00 00 00 00 00 02 81 01 15 00 00 00 00 00 02 82 35 15 00 00 00 00 00 02 83 01 15 00 00 00 00 00 02 84 42 15 00 00 00 00 00 02 85 01 15 00 00 00 00 00 02 86 4d 15 00 00 00 00 00 02 87 01 15 00 00 00 00 00 02 88 72 15 00 00 00 00 00 02 89 01 15 00 00 00 00 00 02 8a 92 15 00 00 00 00 00 02 8b 01 15 00 00 00 00 00 02 8c c6 15 00 00 00 00 00 02 8d 01 15 00 00 00 00 00 02 8e ef 15 00 00 00 00 00 02 8f 02 15 00 00 00 00 00 02 90 2f 15 00 00 00 00 00 02 91 02 15 00 00 00 00 00 02 92 60 15 00 00 00 00 00 02 93 02 15 00 00 00 00 00 02 94 62 15 00 00 00 00 00 02 95 02 15 00 00 00 00 00 02 96 91 15 00 00 00 00 00 02 97 02 15 00 00 00 00 00 02 98 cb 15 00 00 00 00 00 02 99 02 15 00 00 00 00 00 02 9a f0 15 00 00 00 00 00 02 9b 03 15 00 00 00 00 00 02 9c 1e 15 00 00 00 00 00 02 9d 03 15 00 00 00 00 00 02 9e 3d 15 00 00 00 00 00 02 9f 03 15 00 00 00 00 00 02 a0 63 15 00 00 00 00 00 02 a2 03 15 00 00 00 00 00 02 a3 6e 15 00 00 00 00 00 02 a4 03 15 00 00 00 00 00 02 a5 7a 15 00 00 00 00 00 02 a6 03 15 00 00 00 00 00 02 a7 88 15 00 00 00 00 00 02 a9 03 15 00 00 00 00 00 02 aa 97 15 00 00 00 00 00 02 ab 03 15 00 00 00 00 00 02 ac a8 15 00 00 00 00 00 02 ad 03 15 00 00 00 00 00 02 ae bb 15 00 00 00 00 00 02 af 03 15 00 00 00 00 00 02 b0 cb 15 00 00 00 00 00 02 b1 03 15 00 00 00 00 00 02 b2 d0 15 00 00 00 00 00 02 b3 01 15 00 00 00 00 00 02 b4 19 15 00 00 00 00 00 02 b5 01 15 00 00 00 00 00 02 b6 22 15 00 00 00 00 00 02 b7 01 15 00 00 00 00 00 02 b8 35 15 00 00 00 00 00 02 b9 01 15 00 00 00 00 00 02 ba 45 15 00 00 00 00 00 02 bb 01 15 00 00 00 00 00 02 bc 54 15 00 00 00 00 00 02 bd 01 15 00 00 00 00 00 02 be 61 15 00 00 00 00 00 02 bf 01 15 00 00 00 00 00 02 c0 6e 15 00 00 00 00 00 02 c1 01 15 00 00 00 00 00 02 c2 79 15 00 00 00 00 00 02 c3 01 15 00 00 00 00 00 02 c4 84 15 00 00 00 00 00 02 c5 01 15 00 00 00 00 00 02 c6 a5 15 00 00 00 00 00 02 c7 01 15 00 00 00 00 00 02 c8 c1 15 00 00 00 00 00 02 c9 01 15 00 00 00 00 00 02 ca ed 15 00 00 00 00 00 02 cb 02 15 00 00 00 00 00 02 cc 0e 15 00 00 00 00 00 02 cd 02 15 00 00 00 00 00 02 ce 42 15 00 00 00 00 00 02 cf 02 15 00 00 00 00 00 02 d0 73 15 00 00 00 00 00 02 d1 02 15 00 00 00 00 00 02 d2 75 15 00 00 00 00 00 02 d3 02 15 00 00 00 00 00 02 d4 a4 15 00 00 00 00 00 02 d5 02 15 00 00 00 00 00 02 d6 da 15 00 00 00 00 00 02 d7 02 15 00 00 00 00 00 02 d8 fd 15 00 00 00 00 00 02 d9 03 15 00 00 00 00 00 02 da 27 15 00 00 00 00 00 02 db 03 15 00 00 00 00 00 02 dc 44 15 00 00 00 00 00 02 dd 03 15 00 00 00 00 00 02 de 68 15 00 00 00 00 00 02 df 03 15 00 00 00 00 00 02 e0 72 15 00 00 00 00 00 02 e1 03 15 00 00 00 00 00 02 e2 7d 15 00 00 00 00 00 02 e3 03 15 00 00 00 00 00 02 e4 8b 15 00 00 00 00 00 02 e5 03 15 00 00 00 00 00 02 e6 9a 15 00 00 00 00 00 02 e7 03 15 00 00 00 00 00 02 e8 a9 15 00 00 00 00 00 02 e9 03 15 00 00 00 00 00 02 ea bc 15 00 00 00 00 00 02 eb 03 15 00 00 00 00 00 02 ec cc 15 00 00 00 00 00 02 ed 03 15 00 00 00 00 00 02 ee d0 15 00 00 00 00 00 02 ef 00 15 00 00 00 00 00 02 f0 a4 15 00 00 00 00 00 02 f1 00 15 00 00 00 00 00 02 f2 b4 15 00 00 00 00 00 02 f3 00 15 00 00 00 00 00 02 f4 cf 15 00 00 00 00 00 02 f5 00 15 00 00 00 00 00 02 f6 e8 15 00 00 00 00 00 02 f7 00 15 00 00 00 00 00 02 f8 fa 15 00 00 00 00 00 02 f9 01 15 01 00 00 00 00 02 fa 0c 15 00 00 00 00 00 02 ff 21 15 00 00 00 00 00 02 00 01 15 00 00 00 00 00 02 01 1b 15 00 00 00 00 00 02 02 01 15 00 00 00 00 00 02 03 2b 15 00 00 00 00 00 02 04 01 15 00 00 00 00 00 02 05 37 15 00 00 00 00 00 02 06 01 15 00 00 00 00 00 02 07 64 15 00 00 00 00 00 02 08 01 15 00 00 00 00 00 02 09 86 15 00 00 00 00 00 02 0a 01 15 00 00 00 00 00 02 0b be 15 00 00 00 00 00 02 0c 01 15 00 00 00 00 00 02 0d ea 15 00 00 00 00 00 02 0e 02 15 00 00 00 00 00 02 0f 2c 15 00 00 00 00 00 02 10 02 15 00 00 00 00 00 02 11 5e 15 00 00 00 00 00 02 12 02 15 00 00 00 00 00 02 13 60 15 00 00 00 00 00 02 14 02 15 00 00 00 00 00 02 15 8f 15 00 00 00 00 00 02 16 02 15 00 00 00 00 00 02 17 ca 15 00 00 00 00 00 02 18 02 15 00 00 00 00 00 02 19 ee 15 00 00 00 00 00 02 1a 03 15 00 00 00 00 00 02 1b 1d 15 00 00 00 00 00 02 1c 03 15 00 00 00 00 00 02 1d 3c 15 00 00 00 00 00 02 1e 03 15 00 00 00 00 00 02 1f 62 15 00 00 00 00 00 02 20 03 15 00 00 00 00 00 02 21 6e 15 00 00 00 00 00 02 22 03 15 00 00 00 00 00 02 23 7a 15 00 00 00 00 00 02 24 03 15 00 00 00 00 00 02 25 88 15 00 00 00 00 00 02 26 03 15 00 00 00 00 00 02 27 97 15 00 00 00 00 00 02 28 03 15 00 00 00 00 00 02 29 a8 15 00 00 00 00 00 02 2a 03 15 00 00 00 00 00 02 2b bb 15 00 00 00 00 00 02 2d 03 15 00 00 00 00 00 02 2f cc 15 00 00 00 00 00 02 30 03 15 00 00 00 00 00 02 31 d0 15 00 00 00 00 00 02 32 00 15 00 00 00 00 00 02 33 e7 15 00 00 00 00 00 02 34 00 15 00 00 00 00 00 02 35 f6 15 00 00 00 00 00 02 36 01 15 00 00 00 00 00 02 37 10 15 00 00 00 00 00 02 38 01 15 00 00 00 00 00 02 39 27 15 00 00 00 00 00 02 3a 01 15 00 00 00 00 00 02 3b 39 15 00 00 00 00 00 02 3d 01 15 00 00 00 00 00 02 3f 49 15 00 00 00 00 00 02 40 01 15 00 00 00 00 00 02 41 58 15 00 00 00 00 00 02 42 01 15 00 00 00 00 00 02 43 66 15 00 00 00 00 00 02 44 01 15 00 00 00 00 00 02 45 72 15 00 00 00 00 00 02 46 01 15 00 00 00 00 00 02 47 99 15 00 00 00 00 00 02 48 01 15 00 00 00 00 00 02 49 b7 15 00 00 00 00 00 02 4a 01 15 00 00 00 00 00 02 4b e7 15 00 00 00 00 00 02 4c 02 15 00 00 00 00 00 02 4d 09 15 00 00 00 00 00 02 4e 02 15 00 00 00 00 00 02 4f 3f 15 00 00 00 00 00 02 50 02 15 00 00 00 00 00 02 51 71 15 00 00 00 00 00 02 52 02 15 00 00 00 00 00 02 53 73 15 00 00 00 00 00 02 54 02 15 00 00 00 00 00 02 55 a2 15 00 00 00 00 00 02 56 02 15 00 00 00 00 00 02 58 d9 15 00 00 00 00 00 02 59 02 15 00 00 00 00 00 02 5a fb 15 00 00 00 00 00 02 5b 03 15 00 00 00 00 00 02 5c 26 15 00 00 00 00 00 02 5d 03 15 00 00 00 00 00 02 5e 43 15 00 00 00 00 00 02 5f 03 15 00 00 00 00 00 02 60 67 15 00 00 00 00 00 02 61 03 15 00 00 00 00 00 02 62 72 15 00 00 00 00 00 02 63 03 15 00 00 00 00 00 02 64 7d 15 00 00 00 00 00 02 65 03 15 00 00 00 00 00 02 66 8b 15 00 00 00 00 00 02 67 03 15 00 00 00 00 00 02 68 9a 15 00 00 00 00 00 02 69 03 15 00 00 00 00 00 02 6a a9 15 00 00 00 00 00 02 6b 03 15 00 00 00 00 00 02 6c bc 15 00 00 00 00 00 02 6d 03 15 00 00 00 00 00 02 6e cd 15 00 00 00 00 00 02 6f 03 15 00 00 00 00 00 02 70 d0 15 00 00 00 00 00 02 71 00 15 00 00 00 00 00 02 72 00 15 00 00 00 00 00 02 73 00 15 00 00 00 00 00 02 74 50 15 00 00 00 00 00 02 75 00 15 00 00 00 00 00 02 76 8e 15 00 00 00 00 00 02 77 00 15 00 00 00 00 00 02 78 b5 15 00 00 00 00 00 02 79 00 15 00 00 00 00 00 02 7a d4 15 00 00 00 00 00 02 7b 00 15 00 00 00 00 00 02 7c eb 15 00 00 00 00 00 02 7d 01 15 00 00 00 00 00 02 7e 01 15 00 00 00 00 00 02 7f 01 15 00 00 00 00 00 02 80 14 15 00 00 00 00 00 02 81 01 15 00 00 00 00 00 02 82 23 15 00 00 00 00 00 02 83 01 15 00 00 00 00 00 02 84 59 15 00 00 00 00 00 02 85 01 15 00 00 00 00 00 02 86 80 15 00 00 00 00 00 02 87 01 15 00 00 00 00 00 02 88 bd 15 00 00 00 00 00 02 89 01 15 00 00 00 00 00 02 8a e9 15 00 00 00 00 00 02 8b 02 15 00 00 00 00 00 02 8c 2d 15 00 00 00 00 00 02 8d 02 15 00 00 00 00 00 02 8e 5e 15 00 00 00 00 00 02 8f 02 15 00 00 00 00 00 02 90 60 15 00 00 00 00 00 02 91 02 15 00 00 00 00 00 02 92 90 15 00 00 00 00 00 02 93 02 15 00 00 00 00 00 02 94 ca 15 00 00 00 00 00 02 95 02 15 00 00 00 00 00 02 96 ef 15 00 00 00 00 00 02 97 03 15 00 00 00 00 00 02 98 1f 15 00 00 00 00 00 02 99 03 15 00 00 00 00 00 02 9a 39 15 00 00 00 00 00 02 9b 03 15 00 00 00 00 00 02 9c 5f 15 00 00 00 00 00 02 9d 03 15 00 00 00 00 00 02 9e 6b 15 00 00 00 00 00 02 9f 03 15 00 00 00 00 00 02 a0 78 15 00 00 00 00 00 02 a2 03 15 00 00 00 00 00 02 a3 86 15 00 00 00 00 00 02 a4 03 15 00 00 00 00 00 02 a5 95 15 00 00 00 00 00 02 a6 03 15 00 00 00 00 00 02 a7 a8 15 00 00 00 00 00 02 a9 03 15 00 00 00 00 00 02 aa ba 15 00 00 00 00 00 02 ab 03 15 00 00 00 00 00 02 ac cc 15 00 00 00 00 00 02 ad 03 15 00 00 00 00 00 02 ae d0 15 00 00 00 00 00 02 af 00 15 00 00 00 00 00 02 b0 4c 15 00 00 00 00 00 02 b1 00 15 00 00 00 00 00 02 b2 9c 15 00 00 00 00 00 02 b3 00 15 00 00 00 00 00 02 b4 d9 15 00 00 00 00 00 02 b5 00 15 00 00 00 00 00 02 b6 fe 15 00 00 00 00 00 02 b7 01 15 00 00 00 00 00 02 b8 1b 15 00 00 00 00 00 02 b9 01 15 00 00 00 00 00 02 ba 32 15 00 00 00 00 00 02 bb 01 15 00 00 00 00 00 02 bc 46 15 00 00 00 00 00 02 bd 01 15 00 00 00 00 00 02 be 57 15 00 00 00 00 00 02 bf 01 15 00 00 00 00 00 02 c0 66 15 00 00 00 00 00 02 c1 01 15 00 00 00 00 00 02 c2 96 15 00 00 00 00 00 02 c3 01 15 00 00 00 00 00 02 c4 b7 15 00 00 00 00 00 02 c5 01 15 00 00 00 00 00 02 c6 ea 15 00 00 00 00 00 02 c7 02 15 00 00 00 00 00 02 c8 0b 15 00 00 00 00 00 02 c9 02 15 00 00 00 00 00 02 ca 40 15 00 00 00 00 00 02 cb 02 15 00 00 00 00 00 02 cc 71 15 00 00 00 00 00 02 cd 02 15 00 00 00 00 00 02 ce 73 15 00 00 00 00 00 02 cf 02 15 00 00 00 00 00 02 d0 a3 15 00 00 00 00 00 02 d1 02 15 00 00 00 00 00 02 d2 d9 15 00 00 00 00 00 02 d3 02 15 00 00 00 00 00 02 d4 fc 15 00 00 00 00 00 02 d5 03 15 00 00 00 00 00 02 d6 28 15 00 00 00 00 00 02 d7 03 15 00 00 00 00 00 02 d8 40 15 00 00 00 00 00 02 d9 03 15 00 00 00 00 00 02 da 64 15 00 00 00 00 00 02 db 03 15 00 00 00 00 00 02 dc 6f 15 00 00 00 00 00 02 dd 03 15 00 00 00 00 00 02 de 7b 15 00 00 00 00 00 02 df 03 15 00 00 00 00 00 02 e0 89 15 00 00 00 00 00 02 e1 03 15 00 00 00 00 00 02 e2 97 15 00 00 00 00 00 02 e3 03 15 00 00 00 00 00 02 e4 a9 15 00 00 00 00 00 02 e5 03 15 00 00 00 00 00 02 e6 bb 15 00 00 00 00 00 02 e7 03 15 00 00 00 00 00 02 e8 cd 15 00 00 00 00 00 02 e9 03 15 01 00 00 00 00 02 ea d0];
		qcom,mdss-dsi-dispparam-cold-command-state = "dsi_hs_mode";
		qcom,mdss-dsi-dispparam-papermode-command = [15 01 00 00 01 00 02 ff 20 15 00 00 00 01 00 02 fb 01 15 00 00 00 01 00 02 75 00 15 00 00 00 01 00 02 76 00 15 00 00 00 01 00 02 77 00 15 00 00 00 01 00 02 78 41 15 00 00 00 01 00 02 79 00 15 00 00 00 01 00 02 7a 80 15 00 00 00 01 00 02 7b 00 15 00 00 00 01 00 02 7c a7 15 00 00 00 01 00 02 7d 00 15 00 00 00 01 00 02 7e c6 15 00 00 00 01 00 02 7f 00 15 00 00 00 01 00 02 80 dd 15 00 00 00 01 00 02 81 00 15 00 00 00 01 00 02 82 f3 15 00 00 00 01 00 02 83 01 15 00 00 00 01 00 02 84 06 15 00 00 00 01 00 02 85 01 15 00 00 00 01 00 02 86 15 15 00 00 00 01 00 02 87 01 15 00 00 00 01 00 02 88 4b 15 00 00 00 01 00 02 89 01 15 00 00 00 01 00 02 8a 74 15 00 00 00 01 00 02 8b 01 15 00 00 00 01 00 02 8c b1 15 00 00 00 01 00 02 8d 01 15 00 00 00 01 00 02 8e e2 15 00 00 00 01 00 02 8f 02 15 00 00 00 01 00 02 90 28 15 00 00 00 01 00 02 91 02 15 00 00 00 01 00 02 92 5b 15 00 00 00 01 00 02 93 02 15 00 00 00 01 00 02 94 5c 15 00 00 00 01 00 02 95 02 15 00 00 00 01 00 02 96 8e 15 00 00 00 01 00 02 97 02 15 00 00 00 01 00 02 98 c8 15 00 00 00 01 00 02 99 02 15 00 00 00 01 00 02 9a ec 15 00 00 00 01 00 02 9b 03 15 00 00 00 01 00 02 9c 1b 15 00 00 00 01 00 02 9d 03 15 00 00 00 01 00 02 9e 39 15 00 00 00 01 00 02 9f 03 15 00 00 00 01 00 02 a0 5f 15 00 00 00 01 00 02 a2 03 15 00 00 00 01 00 02 a3 6b 15 00 00 00 01 00 02 a4 03 15 00 00 00 01 00 02 a5 78 15 00 00 00 01 00 02 a6 03 15 00 00 00 01 00 02 a7 86 15 00 00 00 01 00 02 a9 03 15 00 00 00 01 00 02 aa 95 15 00 00 00 01 00 02 ab 03 15 00 00 00 01 00 02 ac a8 15 00 00 00 01 00 02 ad 03 15 00 00 00 01 00 02 ae ba 15 00 00 00 01 00 02 af 03 15 00 00 00 01 00 02 b0 cc 15 00 00 00 01 00 02 b1 03 15 00 00 00 01 00 02 b2 d0 15 00 00 00 01 00 02 b3 00 15 00 00 00 01 00 02 b4 4c 15 00 00 00 01 00 02 b5 00 15 00 00 00 01 00 02 b6 8d 15 00 00 00 01 00 02 b7 00 15 00 00 00 01 00 02 b8 cb 15 00 00 00 01 00 02 b9 00 15 00 00 00 01 00 02 ba f0 15 00 00 00 01 00 02 bb 01 15 00 00 00 01 00 02 bc 0d 15 00 00 00 01 00 02 bd 01 15 00 00 00 01 00 02 be 24 15 00 00 00 01 00 02 bf 01 15 00 00 00 01 00 02 c0 38 15 00 00 00 01 00 02 c1 01 15 00 00 00 01 00 02 c2 49 15 00 00 00 01 00 02 c3 01 15 00 00 00 01 00 02 c4 58 15 00 00 00 01 00 02 c5 01 15 00 00 00 01 00 02 c6 88 15 00 00 00 01 00 02 c7 01 15 00 00 00 01 00 02 c8 ab 15 00 00 00 01 00 02 c9 01 15 00 00 00 01 00 02 ca de 15 00 00 00 01 00 02 cb 02 15 00 00 00 01 00 02 cc 03 15 00 00 00 01 00 02 cd 02 15 00 00 00 01 00 02 ce 3b 15 00 00 00 01 00 02 cf 02 15 00 00 00 01 00 02 d0 6e 15 00 00 00 01 00 02 d1 02 15 00 00 00 01 00 02 d2 6f 15 00 00 00 01 00 02 d3 02 15 00 00 00 01 00 02 d4 a1 15 00 00 00 01 00 02 d5 02 15 00 00 00 01 00 02 d6 d7 15 00 00 00 01 00 02 d7 02 15 00 00 00 01 00 02 d8 f9 15 00 00 00 01 00 02 d9 03 15 00 00 00 01 00 02 da 24 15 00 00 00 01 00 02 db 03 15 00 00 00 01 00 02 dc 40 15 00 00 00 01 00 02 dd 03 15 00 00 00 01 00 02 de 64 15 00 00 00 01 00 02 df 03 15 00 00 00 01 00 02 e0 6f 15 00 00 00 01 00 02 e1 03 15 00 00 00 01 00 02 e2 7b 15 00 00 00 01 00 02 e3 03 15 00 00 00 01 00 02 e4 89 15 00 00 00 01 00 02 e5 03 15 00 00 00 01 00 02 e6 97 15 00 00 00 01 00 02 e7 03 15 00 00 00 01 00 02 e8 a9 15 00 00 00 01 00 02 e9 03 15 00 00 00 01 00 02 ea bb 15 00 00 00 01 00 02 eb 03 15 00 00 00 01 00 02 ec cd 15 00 00 00 01 00 02 ed 03 15 00 00 00 01 00 02 ee d0 15 00 00 00 01 00 02 ef 00 15 00 00 00 01 00 02 f0 00 15 00 00 00 01 00 02 f1 00 15 00 00 00 01 00 02 f2 41 15 00 00 00 01 00 02 f3 00 15 00 00 00 01 00 02 f4 80 15 00 00 00 01 00 02 f5 00 15 00 00 00 01 00 02 f6 a7 15 00 00 00 01 00 02 f7 00 15 00 00 00 01 00 02 f8 c6 15 00 00 00 01 00 02 f9 00 15 01 00 00 01 00 02 fa dd 15 00 00 00 01 00 02 ff 21 15 00 00 00 01 00 02 fb 01 15 00 00 00 01 00 02 00 00 15 00 00 00 01 00 02 01 f3 15 00 00 00 01 00 02 02 01 15 00 00 00 01 00 02 03 06 15 00 00 00 01 00 02 04 01 15 00 00 00 01 00 02 05 15 15 00 00 00 01 00 02 06 01 15 00 00 00 01 00 02 07 4b 15 00 00 00 01 00 02 08 01 15 00 00 00 01 00 02 09 74 15 00 00 00 01 00 02 0a 01 15 00 00 00 01 00 02 0b b1 15 00 00 00 01 00 02 0c 01 15 00 00 00 01 00 02 0d e2 15 00 00 00 01 00 02 0e 02 15 00 00 00 01 00 02 0f 28 15 00 00 00 01 00 02 10 02 15 00 00 00 01 00 02 11 5b 15 00 00 00 01 00 02 12 02 15 00 00 00 01 00 02 13 5c 15 00 00 00 01 00 02 14 02 15 00 00 00 01 00 02 15 8e 15 00 00 00 01 00 02 16 02 15 00 00 00 01 00 02 17 c8 15 00 00 00 01 00 02 18 02 15 00 00 00 01 00 02 19 ec 15 00 00 00 01 00 02 1a 03 15 00 00 00 01 00 02 1b 1b 15 00 00 00 01 00 02 1c 03 15 00 00 00 01 00 02 1d 39 15 00 00 00 01 00 02 1e 03 15 00 00 00 01 00 02 1f 5f 15 00 00 00 01 00 02 20 03 15 00 00 00 01 00 02 21 6b 15 00 00 00 01 00 02 22 03 15 00 00 00 01 00 02 23 78 15 00 00 00 01 00 02 24 03 15 00 00 00 01 00 02 25 86 15 00 00 00 01 00 02 26 03 15 00 00 00 01 00 02 27 95 15 00 00 00 01 00 02 28 03 15 00 00 00 01 00 02 29 a8 15 00 00 00 01 00 02 2a 03 15 00 00 00 01 00 02 2b ba 15 00 00 00 01 00 02 2d 03 15 00 00 00 01 00 02 2f cc 15 00 00 00 01 00 02 30 03 15 00 00 00 01 00 02 31 d0 15 00 00 00 01 00 02 32 00 15 00 00 00 01 00 02 33 4c 15 00 00 00 01 00 02 34 00 15 00 00 00 01 00 02 35 8d 15 00 00 00 01 00 02 36 00 15 00 00 00 01 00 02 37 cb 15 00 00 00 01 00 02 38 00 15 00 00 00 01 00 02 39 f0 15 00 00 00 01 00 02 3a 01 15 00 00 00 01 00 02 3b 0d 15 00 00 00 01 00 02 3d 01 15 00 00 00 01 00 02 3f 24 15 00 00 00 01 00 02 40 01 15 00 00 00 01 00 02 41 38 15 00 00 00 01 00 02 42 01 15 00 00 00 01 00 02 43 49 15 00 00 00 01 00 02 44 01 15 00 00 00 01 00 02 45 58 15 00 00 00 01 00 02 46 01 15 00 00 00 01 00 02 47 88 15 00 00 00 01 00 02 48 01 15 00 00 00 01 00 02 49 ab 15 00 00 00 01 00 02 4a 01 15 00 00 00 01 00 02 4b de 15 00 00 00 01 00 02 4c 02 15 00 00 00 01 00 02 4d 03 15 00 00 00 01 00 02 4e 02 15 00 00 00 01 00 02 4f 3b 15 00 00 00 01 00 02 50 02 15 00 00 00 01 00 02 51 6e 15 00 00 00 01 00 02 52 02 15 00 00 00 01 00 02 53 6f 15 00 00 00 01 00 02 54 02 15 00 00 00 01 00 02 55 a1 15 00 00 00 01 00 02 56 02 15 00 00 00 01 00 02 58 d7 15 00 00 00 01 00 02 59 02 15 00 00 00 01 00 02 5a f9 15 00 00 00 01 00 02 5b 03 15 00 00 00 01 00 02 5c 24 15 00 00 00 01 00 02 5d 03 15 00 00 00 01 00 02 5e 40 15 00 00 00 01 00 02 5f 03 15 00 00 00 01 00 02 60 64 15 00 00 00 01 00 02 61 03 15 00 00 00 01 00 02 62 6f 15 00 00 00 01 00 02 63 03 15 00 00 00 01 00 02 64 7b 15 00 00 00 01 00 02 65 03 15 00 00 00 01 00 02 66 89 15 00 00 00 01 00 02 67 03 15 00 00 00 01 00 02 68 97 15 00 00 00 01 00 02 69 03 15 00 00 00 01 00 02 6a a9 15 00 00 00 01 00 02 6b 03 15 00 00 00 01 00 02 6c bb 15 00 00 00 01 00 02 6d 03 15 00 00 00 01 00 02 6e cd 15 00 00 00 01 00 02 6f 03 15 00 00 00 01 00 02 70 d0 15 00 00 00 01 00 02 71 02 15 00 00 00 01 00 02 72 18 15 00 00 00 01 00 02 73 02 15 00 00 00 01 00 02 74 19 15 00 00 00 01 00 02 75 02 15 00 00 00 01 00 02 76 1c 15 00 00 00 01 00 02 77 02 15 00 00 00 01 00 02 78 1e 15 00 00 00 01 00 02 79 02 15 00 00 00 01 00 02 7a 21 15 00 00 00 01 00 02 7b 02 15 00 00 00 01 00 02 7c 23 15 00 00 00 01 00 02 7d 02 15 00 00 00 01 00 02 7e 26 15 00 00 00 01 00 02 7f 02 15 00 00 00 01 00 02 80 28 15 00 00 00 01 00 02 81 02 15 00 00 00 01 00 02 82 2a 15 00 00 00 01 00 02 83 02 15 00 00 00 01 00 02 84 34 15 00 00 00 01 00 02 85 02 15 00 00 00 01 00 02 86 3d 15 00 00 00 01 00 02 87 02 15 00 00 00 01 00 02 88 4e 15 00 00 00 01 00 02 89 02 15 00 00 00 01 00 02 8a 60 15 00 00 00 01 00 02 8b 02 15 00 00 00 01 00 02 8c 81 15 00 00 00 01 00 02 8d 02 15 00 00 00 01 00 02 8e a3 15 00 00 00 01 00 02 8f 02 15 00 00 00 01 00 02 90 a4 15 00 00 00 01 00 02 91 02 15 00 00 00 01 00 02 92 c9 15 00 00 00 01 00 02 93 02 15 00 00 00 01 00 02 94 f4 15 00 00 00 01 00 02 95 03 15 00 00 00 01 00 02 96 12 15 00 00 00 01 00 02 97 03 15 00 00 00 01 00 02 98 45 15 00 00 00 01 00 02 99 03 15 00 00 00 01 00 02 9a 5e 15 00 00 00 01 00 02 9b 03 15 00 00 00 01 00 02 9c 7f 15 00 00 00 01 00 02 9d 03 15 00 00 00 01 00 02 9e 89 15 00 00 00 01 00 02 9f 03 15 00 00 00 01 00 02 a0 94 15 00 00 00 01 00 02 a2 03 15 00 00 00 01 00 02 a3 a1 15 00 00 00 01 00 02 a4 03 15 00 00 00 01 00 02 a5 af 15 00 00 00 01 00 02 a6 03 15 00 00 00 01 00 02 a7 bd 15 00 00 00 01 00 02 a9 03 15 00 00 00 01 00 02 aa c9 15 00 00 00 01 00 02 ab 03 15 00 00 00 01 00 02 ac cf 15 00 00 00 01 00 02 ad 03 15 00 00 00 01 00 02 ae d0 15 00 00 00 01 00 02 af 02 15 00 00 00 01 00 02 b0 64 15 00 00 00 01 00 02 b1 02 15 00 00 00 01 00 02 b2 65 15 00 00 00 01 00 02 b3 02 15 00 00 00 01 00 02 b4 66 15 00 00 00 01 00 02 b5 02 15 00 00 00 01 00 02 b6 68 15 00 00 00 01 00 02 b7 02 15 00 00 00 01 00 02 b8 69 15 00 00 00 01 00 02 b9 02 15 00 00 00 01 00 02 ba 6b 15 00 00 00 01 00 02 bb 02 15 00 00 00 01 00 02 bc 6d 15 00 00 00 01 00 02 bd 02 15 00 00 00 01 00 02 be 6e 15 00 00 00 01 00 02 bf 02 15 00 00 00 01 00 02 c0 70 15 00 00 00 01 00 02 c1 02 15 00 00 00 01 00 02 c2 76 15 00 00 00 01 00 02 c3 02 15 00 00 00 01 00 02 c4 7c 15 00 00 00 01 00 02 c5 02 15 00 00 00 01 00 02 c6 89 15 00 00 00 01 00 02 c7 02 15 00 00 00 01 00 02 c8 95 15 00 00 00 01 00 02 c9 02 15 00 00 00 01 00 02 ca af 15 00 00 00 01 00 02 cb 02 15 00 00 00 01 00 02 cc ca 15 00 00 00 01 00 02 cd 02 15 00 00 00 01 00 02 ce cb 15 00 00 00 01 00 02 cf 02 15 00 00 00 01 00 02 d0 ea 15 00 00 00 01 00 02 d1 03 15 00 00 00 01 00 02 d2 14 15 00 00 00 01 00 02 d3 03 15 00 00 00 01 00 02 d4 3a 15 00 00 00 01 00 02 d5 03 15 00 00 00 01 00 02 d6 60 15 00 00 00 01 00 02 d7 03 15 00 00 00 01 00 02 d8 79 15 00 00 00 01 00 02 d9 03 15 00 00 00 01 00 02 da 9a 15 00 00 00 01 00 02 db 03 15 00 00 00 01 00 02 dc a3 15 00 00 00 01 00 02 dd 03 15 00 00 00 01 00 02 de ad 15 00 00 00 01 00 02 df 03 15 00 00 00 01 00 02 e0 b7 15 00 00 00 01 00 02 e1 03 15 00 00 00 01 00 02 e2 c0 15 00 00 00 01 00 02 e3 03 15 00 00 00 01 00 02 e4 c8 15 00 00 00 01 00 02 e5 03 15 00 00 00 01 00 02 e6 cd 15 00 00 00 01 00 02 e7 03 15 00 00 00 01 00 02 e8 d0 15 00 00 00 01 00 02 e9 03 15 00 00 00 01 00 02 ea f7 15 00 00 00 01 00 02 fb 01 15 01 00 00 01 00 02 ff 10];
		qcom,mdss-dsi-dispparam-papermode-state = "dsi_hs_mode";
		qcom,mdss-dsi-dispparam-papermode1-command = [15 00 00 00 01 00 02 ff 20 15 00 00 00 01 00 02 fb 01 15 00 00 00 01 00 02 75 00 15 00 00 00 01 00 02 76 00 15 00 00 00 01 00 02 77 00 15 00 00 00 01 00 02 78 41 15 00 00 00 01 00 02 79 00 15 00 00 00 01 00 02 7a 80 15 00 00 00 01 00 02 7b 00 15 00 00 00 01 00 02 7c a7 15 00 00 00 01 00 02 7d 00 15 00 00 00 01 00 02 7e c6 15 00 00 00 01 00 02 7f 00 15 00 00 00 01 00 02 80 dd 15 00 00 00 01 00 02 81 00 15 00 00 00 01 00 02 82 f3 15 00 00 00 01 00 02 83 01 15 00 00 00 01 00 02 84 06 15 00 00 00 01 00 02 85 01 15 00 00 00 01 00 02 86 15 15 00 00 00 01 00 02 87 01 15 00 00 00 01 00 02 88 4b 15 00 00 00 01 00 02 89 01 15 00 00 00 01 00 02 8a 74 15 00 00 00 01 00 02 8b 01 15 00 00 00 01 00 02 8c b1 15 00 00 00 01 00 02 8d 01 15 00 00 00 01 00 02 8e e2 15 00 00 00 01 00 02 8f 02 15 00 00 00 01 00 02 90 28 15 00 00 00 01 00 02 91 02 15 00 00 00 01 00 02 92 5b 15 00 00 00 01 00 02 93 02 15 00 00 00 01 00 02 94 5c 15 00 00 00 01 00 02 95 02 15 00 00 00 01 00 02 96 8e 15 00 00 00 01 00 02 97 02 15 00 00 00 01 00 02 98 c8 15 00 00 00 01 00 02 99 02 15 00 00 00 01 00 02 9a ec 15 00 00 00 01 00 02 9b 03 15 00 00 00 01 00 02 9c 1b 15 00 00 00 01 00 02 9d 03 15 00 00 00 01 00 02 9e 39 15 00 00 00 01 00 02 9f 03 15 00 00 00 01 00 02 a0 5f 15 00 00 00 01 00 02 a2 03 15 00 00 00 01 00 02 a3 6b 15 00 00 00 01 00 02 a4 03 15 00 00 00 01 00 02 a5 78 15 00 00 00 01 00 02 a6 03 15 00 00 00 01 00 02 a7 86 15 00 00 00 01 00 02 a9 03 15 00 00 00 01 00 02 aa 95 15 00 00 00 01 00 02 ab 03 15 00 00 00 01 00 02 ac a8 15 00 00 00 01 00 02 ad 03 15 00 00 00 01 00 02 ae ba 15 00 00 00 01 00 02 af 03 15 00 00 00 01 00 02 b0 cc 15 00 00 00 01 00 02 b1 03 15 00 00 00 01 00 02 b2 d0 15 00 00 00 01 00 02 b3 00 15 00 00 00 01 00 02 b4 4c 15 00 00 00 01 00 02 b5 00 15 00 00 00 01 00 02 b6 8d 15 00 00 00 01 00 02 b7 00 15 00 00 00 01 00 02 b8 cb 15 00 00 00 01 00 02 b9 00 15 00 00 00 01 00 02 ba f0 15 00 00 00 01 00 02 bb 01 15 00 00 00 01 00 02 bc 0d 15 00 00 00 01 00 02 bd 01 15 00 00 00 01 00 02 be 24 15 00 00 00 01 00 02 bf 01 15 00 00 00 01 00 02 c0 38 15 00 00 00 01 00 02 c1 01 15 00 00 00 01 00 02 c2 49 15 00 00 00 01 00 02 c3 01 15 00 00 00 01 00 02 c4 58 15 00 00 00 01 00 02 c5 01 15 00 00 00 01 00 02 c6 88 15 00 00 00 01 00 02 c7 01 15 00 00 00 01 00 02 c8 ab 15 00 00 00 01 00 02 c9 01 15 00 00 00 01 00 02 ca de 15 00 00 00 01 00 02 cb 02 15 00 00 00 01 00 02 cc 03 15 00 00 00 01 00 02 cd 02 15 00 00 00 01 00 02 ce 3b 15 00 00 00 01 00 02 cf 02 15 00 00 00 01 00 02 d0 6e 15 00 00 00 01 00 02 d1 02 15 00 00 00 01 00 02 d2 6f 15 00 00 00 01 00 02 d3 02 15 00 00 00 01 00 02 d4 a1 15 00 00 00 01 00 02 d5 02 15 00 00 00 01 00 02 d6 d7 15 00 00 00 01 00 02 d7 02 15 00 00 00 01 00 02 d8 f9 15 00 00 00 01 00 02 d9 03 15 00 00 00 01 00 02 da 24 15 00 00 00 01 00 02 db 03 15 00 00 00 01 00 02 dc 40 15 00 00 00 01 00 02 dd 03 15 00 00 00 01 00 02 de 64 15 00 00 00 01 00 02 df 03 15 00 00 00 01 00 02 e0 6f 15 00 00 00 01 00 02 e1 03 15 00 00 00 01 00 02 e2 7b 15 00 00 00 01 00 02 e3 03 15 00 00 00 01 00 02 e4 89 15 00 00 00 01 00 02 e5 03 15 00 00 00 01 00 02 e6 97 15 00 00 00 01 00 02 e7 03 15 00 00 00 01 00 02 e8 a9 15 00 00 00 01 00 02 e9 03 15 00 00 00 01 00 02 ea bb 15 00 00 00 01 00 02 eb 03 15 00 00 00 01 00 02 ec cd 15 00 00 00 01 00 02 ed 03 15 00 00 00 01 00 02 ee d0 15 00 00 00 01 00 02 ef 00 15 00 00 00 01 00 02 f0 00 15 00 00 00 01 00 02 f1 00 15 00 00 00 01 00 02 f2 41 15 00 00 00 01 00 02 f3 00 15 00 00 00 01 00 02 f4 80 15 00 00 00 01 00 02 f5 00 15 00 00 00 01 00 02 f6 a7 15 00 00 00 01 00 02 f7 00 15 00 00 00 01 00 02 f8 c6 15 00 00 00 01 00 02 f9 00 15 01 00 00 01 00 02 fa dd 15 00 00 00 01 00 02 ff 21 15 00 00 00 01 00 02 fb 01 15 00 00 00 01 00 02 00 00 15 00 00 00 01 00 02 01 f3 15 00 00 00 01 00 02 02 01 15 00 00 00 01 00 02 03 06 15 00 00 00 01 00 02 04 01 15 00 00 00 01 00 02 05 15 15 00 00 00 01 00 02 06 01 15 00 00 00 01 00 02 07 4b 15 00 00 00 01 00 02 08 01 15 00 00 00 01 00 02 09 74 15 00 00 00 01 00 02 0a 01 15 00 00 00 01 00 02 0b b1 15 00 00 00 01 00 02 0c 01 15 00 00 00 01 00 02 0d e2 15 00 00 00 01 00 02 0e 02 15 00 00 00 01 00 02 0f 28 15 00 00 00 01 00 02 10 02 15 00 00 00 01 00 02 11 5b 15 00 00 00 01 00 02 12 02 15 00 00 00 01 00 02 13 5c 15 00 00 00 01 00 02 14 02 15 00 00 00 01 00 02 15 8e 15 00 00 00 01 00 02 16 02 15 00 00 00 01 00 02 17 c8 15 00 00 00 01 00 02 18 02 15 00 00 00 01 00 02 19 ec 15 00 00 00 01 00 02 1a 03 15 00 00 00 01 00 02 1b 1b 15 00 00 00 01 00 02 1c 03 15 00 00 00 01 00 02 1d 39 15 00 00 00 01 00 02 1e 03 15 00 00 00 01 00 02 1f 5f 15 00 00 00 01 00 02 20 03 15 00 00 00 01 00 02 21 6b 15 00 00 00 01 00 02 22 03 15 00 00 00 01 00 02 23 78 15 00 00 00 01 00 02 24 03 15 00 00 00 01 00 02 25 86 15 00 00 00 01 00 02 26 03 15 00 00 00 01 00 02 27 95 15 00 00 00 01 00 02 28 03 15 00 00 00 01 00 02 29 a8 15 00 00 00 01 00 02 2a 03 15 00 00 00 01 00 02 2b ba 15 00 00 00 01 00 02 2d 03 15 00 00 00 01 00 02 2f cc 15 00 00 00 01 00 02 30 03 15 00 00 00 01 00 02 31 d0 15 00 00 00 01 00 02 32 00 15 00 00 00 01 00 02 33 4c 15 00 00 00 01 00 02 34 00 15 00 00 00 01 00 02 35 8d 15 00 00 00 01 00 02 36 00 15 00 00 00 01 00 02 37 cb 15 00 00 00 01 00 02 38 00 15 00 00 00 01 00 02 39 f0 15 00 00 00 01 00 02 3a 01 15 00 00 00 01 00 02 3b 0d 15 00 00 00 01 00 02 3d 01 15 00 00 00 01 00 02 3f 24 15 00 00 00 01 00 02 40 01 15 00 00 00 01 00 02 41 38 15 00 00 00 01 00 02 42 01 15 00 00 00 01 00 02 43 49 15 00 00 00 01 00 02 44 01 15 00 00 00 01 00 02 45 58 15 00 00 00 01 00 02 46 01 15 00 00 00 01 00 02 47 88 15 00 00 00 01 00 02 48 01 15 00 00 00 01 00 02 49 ab 15 00 00 00 01 00 02 4a 01 15 00 00 00 01 00 02 4b de 15 00 00 00 01 00 02 4c 02 15 00 00 00 01 00 02 4d 03 15 00 00 00 01 00 02 4e 02 15 00 00 00 01 00 02 4f 3b 15 00 00 00 01 00 02 50 02 15 00 00 00 01 00 02 51 6e 15 00 00 00 01 00 02 52 02 15 00 00 00 01 00 02 53 6f 15 00 00 00 01 00 02 54 02 15 00 00 00 01 00 02 55 a1 15 00 00 00 01 00 02 56 02 15 00 00 00 01 00 02 58 d7 15 00 00 00 01 00 02 59 02 15 00 00 00 01 00 02 5a f9 15 00 00 00 01 00 02 5b 03 15 00 00 00 01 00 02 5c 24 15 00 00 00 01 00 02 5d 03 15 00 00 00 01 00 02 5e 40 15 00 00 00 01 00 02 5f 03 15 00 00 00 01 00 02 60 64 15 00 00 00 01 00 02 61 03 15 00 00 00 01 00 02 62 6f 15 00 00 00 01 00 02 63 03 15 00 00 00 01 00 02 64 7b 15 00 00 00 01 00 02 65 03 15 00 00 00 01 00 02 66 89 15 00 00 00 01 00 02 67 03 15 00 00 00 01 00 02 68 97 15 00 00 00 01 00 02 69 03 15 00 00 00 01 00 02 6a a9 15 00 00 00 01 00 02 6b 03 15 00 00 00 01 00 02 6c bb 15 00 00 00 01 00 02 6d 03 15 00 00 00 01 00 02 6e cd 15 00 00 00 01 00 02 6f 03 15 00 00 00 01 00 02 70 d0 15 00 00 00 01 00 02 71 01 15 00 00 00 01 00 02 72 00 15 00 00 00 01 00 02 73 01 15 00 00 00 01 00 02 74 0a 15 00 00 00 01 00 02 75 01 15 00 00 00 01 00 02 76 1d 15 00 00 00 01 00 02 77 01 15 00 00 00 01 00 02 78 2e 15 00 00 00 01 00 02 79 01 15 00 00 00 01 00 02 7a 3d 15 00 00 00 01 00 02 7b 01 15 00 00 00 01 00 02 7c 4a 15 00 00 00 01 00 02 7d 01 15 00 00 00 01 00 02 7e 57 15 00 00 00 01 00 02 7f 01 15 00 00 00 01 00 02 80 62 15 00 00 00 01 00 02 81 01 15 00 00 00 01 00 02 82 6d 15 00 00 00 01 00 02 83 01 15 00 00 00 01 00 02 84 92 15 00 00 00 01 00 02 85 01 15 00 00 00 01 00 02 86 b0 15 00 00 00 01 00 02 87 01 15 00 00 00 01 00 02 88 de 15 00 00 00 01 00 02 89 02 15 00 00 00 01 00 02 8a 02 15 00 00 00 01 00 02 8b 02 15 00 00 00 01 00 02 8c 3b 15 00 00 00 01 00 02 8d 02 15 00 00 00 01 00 02 8e 6c 15 00 00 00 01 00 02 8f 02 15 00 00 00 01 00 02 90 6d 15 00 00 00 01 00 02 91 02 15 00 00 00 01 00 02 92 9d 15 00 00 00 01 00 02 93 02 15 00 00 00 01 00 02 94 d1 15 00 00 00 01 00 02 95 02 15 00 00 00 01 00 02 96 ef 15 00 00 00 01 00 02 97 03 15 00 00 00 01 00 02 98 23 15 00 00 00 01 00 02 99 03 15 00 00 00 01 00 02 9a 41 15 00 00 00 01 00 02 9b 03 15 00 00 00 01 00 02 9c 65 15 00 00 00 01 00 02 9d 03 15 00 00 00 01 00 02 9e 70 15 00 00 00 01 00 02 9f 03 15 00 00 00 01 00 02 a0 7d 15 00 00 00 01 00 02 a2 03 15 00 00 00 01 00 02 a3 8b 15 00 00 00 01 00 02 a4 03 15 00 00 00 01 00 02 a5 9b 15 00 00 00 01 00 02 a6 03 15 00 00 00 01 00 02 a7 af 15 00 00 00 01 00 02 a9 03 15 00 00 00 01 00 02 aa c2 15 00 00 00 01 00 02 ab 03 15 00 00 00 01 00 02 ac cf 15 00 00 00 01 00 02 ad 03 15 00 00 00 01 00 02 ae d0 15 00 00 00 01 00 02 af 01 15 00 00 00 01 00 02 b0 4c 15 00 00 00 01 00 02 b1 01 15 00 00 00 01 00 02 b2 52 15 00 00 00 01 00 02 b3 01 15 00 00 00 01 00 02 b4 5e 15 00 00 00 01 00 02 b5 01 15 00 00 00 01 00 02 b6 69 15 00 00 00 01 00 02 b7 01 15 00 00 00 01 00 02 b8 74 15 00 00 00 01 00 02 b9 01 15 00 00 00 01 00 02 ba 7d 15 00 00 00 01 00 02 bb 01 15 00 00 00 01 00 02 bc 86 15 00 00 00 01 00 02 bd 01 15 00 00 00 01 00 02 be 8f 15 00 00 00 01 00 02 bf 01 15 00 00 00 01 00 02 c0 97 15 00 00 00 01 00 02 c1 01 15 00 00 00 01 00 02 c2 b4 15 00 00 00 01 00 02 c3 01 15 00 00 00 01 00 02 c4 cc 15 00 00 00 01 00 02 c5 01 15 00 00 00 01 00 02 c6 f2 15 00 00 00 01 00 02 c7 02 15 00 00 00 01 00 02 c8 12 15 00 00 00 01 00 02 c9 02 15 00 00 00 01 00 02 ca 46 15 00 00 00 01 00 02 cb 02 15 00 00 00 01 00 02 cc 74 15 00 00 00 01 00 02 cd 02 15 00 00 00 01 00 02 ce 76 15 00 00 00 01 00 02 cf 02 15 00 00 00 01 00 02 d0 a4 15 00 00 00 01 00 02 d1 02 15 00 00 00 01 00 02 d2 d6 15 00 00 00 01 00 02 d3 02 15 00 00 00 01 00 02 d4 f4 15 00 00 00 01 00 02 d5 03 15 00 00 00 01 00 02 d6 28 15 00 00 00 01 00 02 d7 03 15 00 00 00 01 00 02 d8 45 15 00 00 00 01 00 02 d9 03 15 00 00 00 01 00 02 da 6b 15 00 00 00 01 00 02 db 03 15 00 00 00 01 00 02 dc 76 15 00 00 00 01 00 02 dd 03 15 00 00 00 01 00 02 de 84 15 00 00 00 01 00 02 df 03 15 00 00 00 01 00 02 e0 93 15 00 00 00 01 00 02 e1 03 15 00 00 00 01 00 02 e2 a4 15 00 00 00 01 00 02 e3 03 15 00 00 00 01 00 02 e4 b6 15 00 00 00 01 00 02 e5 03 15 00 00 00 01 00 02 e6 c6 15 00 00 00 01 00 02 e7 03 15 00 00 00 01 00 02 e8 cf 15 00 00 00 01 00 02 e9 03 15 00 00 00 01 00 02 ea d0 15 00 00 00 01 00 02 fb 01 15 01 00 00 01 00 02 ff 10];
		qcom,mdss-dsi-dispparam-papermode1-state = "dsi_hs_mode";
		qcom,mdss-dsi-dispparam-papermode2-command = [15 00 00 00 01 00 02 ff 20 15 00 00 00 01 00 02 fb 01 15 00 00 00 01 00 02 75 00 15 00 00 00 01 00 02 76 00 15 00 00 00 01 00 02 77 00 15 00 00 00 01 00 02 78 41 15 00 00 00 01 00 02 79 00 15 00 00 00 01 00 02 7a 80 15 00 00 00 01 00 02 7b 00 15 00 00 00 01 00 02 7c a7 15 00 00 00 01 00 02 7d 00 15 00 00 00 01 00 02 7e c6 15 00 00 00 01 00 02 7f 00 15 00 00 00 01 00 02 80 dd 15 00 00 00 01 00 02 81 00 15 00 00 00 01 00 02 82 f3 15 00 00 00 01 00 02 83 01 15 00 00 00 01 00 02 84 06 15 00 00 00 01 00 02 85 01 15 00 00 00 01 00 02 86 15 15 00 00 00 01 00 02 87 01 15 00 00 00 01 00 02 88 4b 15 00 00 00 01 00 02 89 01 15 00 00 00 01 00 02 8a 74 15 00 00 00 01 00 02 8b 01 15 00 00 00 01 00 02 8c b1 15 00 00 00 01 00 02 8d 01 15 00 00 00 01 00 02 8e e2 15 00 00 00 01 00 02 8f 02 15 00 00 00 01 00 02 90 28 15 00 00 00 01 00 02 91 02 15 00 00 00 01 00 02 92 5b 15 00 00 00 01 00 02 93 02 15 00 00 00 01 00 02 94 5c 15 00 00 00 01 00 02 95 02 15 00 00 00 01 00 02 96 8e 15 00 00 00 01 00 02 97 02 15 00 00 00 01 00 02 98 c8 15 00 00 00 01 00 02 99 02 15 00 00 00 01 00 02 9a ec 15 00 00 00 01 00 02 9b 03 15 00 00 00 01 00 02 9c 1b 15 00 00 00 01 00 02 9d 03 15 00 00 00 01 00 02 9e 39 15 00 00 00 01 00 02 9f 03 15 00 00 00 01 00 02 a0 5f 15 00 00 00 01 00 02 a2 03 15 00 00 00 01 00 02 a3 6b 15 00 00 00 01 00 02 a4 03 15 00 00 00 01 00 02 a5 78 15 00 00 00 01 00 02 a6 03 15 00 00 00 01 00 02 a7 86 15 00 00 00 01 00 02 a9 03 15 00 00 00 01 00 02 aa 95 15 00 00 00 01 00 02 ab 03 15 00 00 00 01 00 02 ac a8 15 00 00 00 01 00 02 ad 03 15 00 00 00 01 00 02 ae ba 15 00 00 00 01 00 02 af 03 15 00 00 00 01 00 02 b0 cc 15 00 00 00 01 00 02 b1 03 15 00 00 00 01 00 02 b2 d0 15 00 00 00 01 00 02 b3 00 15 00 00 00 01 00 02 b4 4c 15 00 00 00 01 00 02 b5 00 15 00 00 00 01 00 02 b6 8d 15 00 00 00 01 00 02 b7 00 15 00 00 00 01 00 02 b8 cb 15 00 00 00 01 00 02 b9 00 15 00 00 00 01 00 02 ba f0 15 00 00 00 01 00 02 bb 01 15 00 00 00 01 00 02 bc 0d 15 00 00 00 01 00 02 bd 01 15 00 00 00 01 00 02 be 24 15 00 00 00 01 00 02 bf 01 15 00 00 00 01 00 02 c0 38 15 00 00 00 01 00 02 c1 01 15 00 00 00 01 00 02 c2 49 15 00 00 00 01 00 02 c3 01 15 00 00 00 01 00 02 c4 58 15 00 00 00 01 00 02 c5 01 15 00 00 00 01 00 02 c6 88 15 00 00 00 01 00 02 c7 01 15 00 00 00 01 00 02 c8 ab 15 00 00 00 01 00 02 c9 01 15 00 00 00 01 00 02 ca de 15 00 00 00 01 00 02 cb 02 15 00 00 00 01 00 02 cc 03 15 00 00 00 01 00 02 cd 02 15 00 00 00 01 00 02 ce 3b 15 00 00 00 01 00 02 cf 02 15 00 00 00 01 00 02 d0 6e 15 00 00 00 01 00 02 d1 02 15 00 00 00 01 00 02 d2 6f 15 00 00 00 01 00 02 d3 02 15 00 00 00 01 00 02 d4 a1 15 00 00 00 01 00 02 d5 02 15 00 00 00 01 00 02 d6 d7 15 00 00 00 01 00 02 d7 02 15 00 00 00 01 00 02 d8 f9 15 00 00 00 01 00 02 d9 03 15 00 00 00 01 00 02 da 24 15 00 00 00 01 00 02 db 03 15 00 00 00 01 00 02 dc 40 15 00 00 00 01 00 02 dd 03 15 00 00 00 01 00 02 de 64 15 00 00 00 01 00 02 df 03 15 00 00 00 01 00 02 e0 6f 15 00 00 00 01 00 02 e1 03 15 00 00 00 01 00 02 e2 7b 15 00 00 00 01 00 02 e3 03 15 00 00 00 01 00 02 e4 89 15 00 00 00 01 00 02 e5 03 15 00 00 00 01 00 02 e6 97 15 00 00 00 01 00 02 e7 03 15 00 00 00 01 00 02 e8 a9 15 00 00 00 01 00 02 e9 03 15 00 00 00 01 00 02 ea bb 15 00 00 00 01 00 02 eb 03 15 00 00 00 01 00 02 ec cd 15 00 00 00 01 00 02 ed 03 15 00 00 00 01 00 02 ee d0 15 00 00 00 01 00 02 ef 00 15 00 00 00 01 00 02 f0 00 15 00 00 00 01 00 02 f1 00 15 00 00 00 01 00 02 f2 41 15 00 00 00 01 00 02 f3 00 15 00 00 00 01 00 02 f4 80 15 00 00 00 01 00 02 f5 00 15 00 00 00 01 00 02 f6 a7 15 00 00 00 01 00 02 f7 00 15 00 00 00 01 00 02 f8 c6 15 00 00 00 01 00 02 f9 00 15 01 00 00 01 00 02 fa dd 15 00 00 00 01 00 02 ff 21 15 00 00 00 01 00 02 fb 01 15 00 00 00 01 00 02 00 00 15 00 00 00 01 00 02 01 f3 15 00 00 00 01 00 02 02 01 15 00 00 00 01 00 02 03 06 15 00 00 00 01 00 02 04 01 15 00 00 00 01 00 02 05 15 15 00 00 00 01 00 02 06 01 15 00 00 00 01 00 02 07 4b 15 00 00 00 01 00 02 08 01 15 00 00 00 01 00 02 09 74 15 00 00 00 01 00 02 0a 01 15 00 00 00 01 00 02 0b b1 15 00 00 00 01 00 02 0c 01 15 00 00 00 01 00 02 0d e2 15 00 00 00 01 00 02 0e 02 15 00 00 00 01 00 02 0f 28 15 00 00 00 01 00 02 10 02 15 00 00 00 01 00 02 11 5b 15 00 00 00 01 00 02 12 02 15 00 00 00 01 00 02 13 5c 15 00 00 00 01 00 02 14 02 15 00 00 00 01 00 02 15 8e 15 00 00 00 01 00 02 16 02 15 00 00 00 01 00 02 17 c8 15 00 00 00 01 00 02 18 02 15 00 00 00 01 00 02 19 ec 15 00 00 00 01 00 02 1a 03 15 00 00 00 01 00 02 1b 1b 15 00 00 00 01 00 02 1c 03 15 00 00 00 01 00 02 1d 39 15 00 00 00 01 00 02 1e 03 15 00 00 00 01 00 02 1f 5f 15 00 00 00 01 00 02 20 03 15 00 00 00 01 00 02 21 6b 15 00 00 00 01 00 02 22 03 15 00 00 00 01 00 02 23 78 15 00 00 00 01 00 02 24 03 15 00 00 00 01 00 02 25 86 15 00 00 00 01 00 02 26 03 15 00 00 00 01 00 02 27 95 15 00 00 00 01 00 02 28 03 15 00 00 00 01 00 02 29 a8 15 00 00 00 01 00 02 2a 03 15 00 00 00 01 00 02 2b ba 15 00 00 00 01 00 02 2d 03 15 00 00 00 01 00 02 2f cc 15 00 00 00 01 00 02 30 03 15 00 00 00 01 00 02 31 d0 15 00 00 00 01 00 02 32 00 15 00 00 00 01 00 02 33 4c 15 00 00 00 01 00 02 34 00 15 00 00 00 01 00 02 35 8d 15 00 00 00 01 00 02 36 00 15 00 00 00 01 00 02 37 cb 15 00 00 00 01 00 02 38 00 15 00 00 00 01 00 02 39 f0 15 00 00 00 01 00 02 3a 01 15 00 00 00 01 00 02 3b 0d 15 00 00 00 01 00 02 3d 01 15 00 00 00 01 00 02 3f 24 15 00 00 00 01 00 02 40 01 15 00 00 00 01 00 02 41 38 15 00 00 00 01 00 02 42 01 15 00 00 00 01 00 02 43 49 15 00 00 00 01 00 02 44 01 15 00 00 00 01 00 02 45 58 15 00 00 00 01 00 02 46 01 15 00 00 00 01 00 02 47 88 15 00 00 00 01 00 02 48 01 15 00 00 00 01 00 02 49 ab 15 00 00 00 01 00 02 4a 01 15 00 00 00 01 00 02 4b de 15 00 00 00 01 00 02 4c 02 15 00 00 00 01 00 02 4d 03 15 00 00 00 01 00 02 4e 02 15 00 00 00 01 00 02 4f 3b 15 00 00 00 01 00 02 50 02 15 00 00 00 01 00 02 51 6e 15 00 00 00 01 00 02 52 02 15 00 00 00 01 00 02 53 6f 15 00 00 00 01 00 02 54 02 15 00 00 00 01 00 02 55 a1 15 00 00 00 01 00 02 56 02 15 00 00 00 01 00 02 58 d7 15 00 00 00 01 00 02 59 02 15 00 00 00 01 00 02 5a f9 15 00 00 00 01 00 02 5b 03 15 00 00 00 01 00 02 5c 24 15 00 00 00 01 00 02 5d 03 15 00 00 00 01 00 02 5e 40 15 00 00 00 01 00 02 5f 03 15 00 00 00 01 00 02 60 64 15 00 00 00 01 00 02 61 03 15 00 00 00 01 00 02 62 6f 15 00 00 00 01 00 02 63 03 15 00 00 00 01 00 02 64 7b 15 00 00 00 01 00 02 65 03 15 00 00 00 01 00 02 66 89 15 00 00 00 01 00 02 67 03 15 00 00 00 01 00 02 68 97 15 00 00 00 01 00 02 69 03 15 00 00 00 01 00 02 6a a9 15 00 00 00 01 00 02 6b 03 15 00 00 00 01 00 02 6c bb 15 00 00 00 01 00 02 6d 03 15 00 00 00 01 00 02 6e cd 15 00 00 00 01 00 02 6f 03 15 00 00 00 01 00 02 70 d0 15 00 00 00 01 00 02 71 01 15 00 00 00 01 00 02 72 54 15 00 00 00 01 00 02 73 01 15 00 00 00 01 00 02 74 5a 15 00 00 00 01 00 02 75 01 15 00 00 00 01 00 02 76 65 15 00 00 00 01 00 02 77 01 15 00 00 00 01 00 02 78 6f 15 00 00 00 01 00 02 79 01 15 00 00 00 01 00 02 7a 78 15 00 00 00 01 00 02 7b 01 15 00 00 00 01 00 02 7c 81 15 00 00 00 01 00 02 7d 01 15 00 00 00 01 00 02 7e 8a 15 00 00 00 01 00 02 7f 01 15 00 00 00 01 00 02 80 92 15 00 00 00 01 00 02 81 01 15 00 00 00 01 00 02 82 9a 15 00 00 00 01 00 02 83 01 15 00 00 00 01 00 02 84 b5 15 00 00 00 01 00 02 85 01 15 00 00 00 01 00 02 86 cc 15 00 00 00 01 00 02 87 01 15 00 00 00 01 00 02 88 f2 15 00 00 00 01 00 02 89 02 15 00 00 00 01 00 02 8a 12 15 00 00 00 01 00 02 8b 02 15 00 00 00 01 00 02 8c 45 15 00 00 00 01 00 02 8d 02 15 00 00 00 01 00 02 8e 73 15 00 00 00 01 00 02 8f 02 15 00 00 00 01 00 02 90 75 15 00 00 00 01 00 02 91 02 15 00 00 00 01 00 02 92 a3 15 00 00 00 01 00 02 93 02 15 00 00 00 01 00 02 94 d5 15 00 00 00 01 00 02 95 02 15 00 00 00 01 00 02 96 f3 15 00 00 00 01 00 02 97 03 15 00 00 00 01 00 02 98 1f 15 00 00 00 01 00 02 99 03 15 00 00 00 01 00 02 9a 44 15 00 00 00 01 00 02 9b 03 15 00 00 00 01 00 02 9c 68 15 00 00 00 01 00 02 9d 03 15 00 00 00 01 00 02 9e 73 15 00 00 00 01 00 02 9f 03 15 00 00 00 01 00 02 a0 80 15 00 00 00 01 00 02 a2 03 15 00 00 00 01 00 02 a3 8e 15 00 00 00 01 00 02 a4 03 15 00 00 00 01 00 02 a5 9e 15 00 00 00 01 00 02 a6 03 15 00 00 00 01 00 02 a7 b1 15 00 00 00 01 00 02 a9 03 15 00 00 00 01 00 02 aa c3 15 00 00 00 01 00 02 ab 03 15 00 00 00 01 00 02 ac cf 15 00 00 00 01 00 02 ad 03 15 00 00 00 01 00 02 ae d0 15 00 00 00 01 00 02 af 01 15 00 00 00 01 00 02 b0 a0 15 00 00 00 01 00 02 b1 01 15 00 00 00 01 00 02 b2 a3 15 00 00 00 01 00 02 b3 01 15 00 00 00 01 00 02 b4 aa 15 00 00 00 01 00 02 b5 01 15 00 00 00 01 00 02 b6 b0 15 00 00 00 01 00 02 b7 01 15 00 00 00 01 00 02 b8 b6 15 00 00 00 01 00 02 b9 01 15 00 00 00 01 00 02 ba bc 15 00 00 00 01 00 02 bb 01 15 00 00 00 01 00 02 bc c2 15 00 00 00 01 00 02 bd 01 15 00 00 00 01 00 02 be c7 15 00 00 00 01 00 02 bf 01 15 00 00 00 01 00 02 c0 cd 15 00 00 00 01 00 02 c1 01 15 00 00 00 01 00 02 c2 e0 15 00 00 00 01 00 02 c3 01 15 00 00 00 01 00 02 c4 f0 15 00 00 00 01 00 02 c5 02 15 00 00 00 01 00 02 c6 0f 15 00 00 00 01 00 02 c7 02 15 00 00 00 01 00 02 c8 29 15 00 00 00 01 00 02 c9 02 15 00 00 00 01 00 02 ca 56 15 00 00 00 01 00 02 cb 02 15 00 00 00 01 00 02 cc 81 15 00 00 00 01 00 02 cd 02 15 00 00 00 01 00 02 ce 82 15 00 00 00 01 00 02 cf 02 15 00 00 00 01 00 02 d0 ad 15 00 00 00 01 00 02 d1 02 15 00 00 00 01 00 02 d2 de 15 00 00 00 01 00 02 d3 02 15 00 00 00 01 00 02 d4 fb 15 00 00 00 01 00 02 d5 03 15 00 00 00 01 00 02 d6 2f 15 00 00 00 01 00 02 d7 03 15 00 00 00 01 00 02 d8 4b 15 00 00 00 01 00 02 d9 03 15 00 00 00 01 00 02 da 70 15 00 00 00 01 00 02 db 03 15 00 00 00 01 00 02 dc 7c 15 00 00 00 01 00 02 dd 03 15 00 00 00 01 00 02 de 89 15 00 00 00 01 00 02 df 03 15 00 00 00 01 00 02 e0 98 15 00 00 00 01 00 02 e1 03 15 00 00 00 01 00 02 e2 a9 15 00 00 00 01 00 02 e3 03 15 00 00 00 01 00 02 e4 b9 15 00 00 00 01 00 02 e5 03 15 00 00 00 01 00 02 e6 c7 15 00 00 00 01 00 02 e7 03 15 00 00 00 01 00 02 e8 cf 15 00 00 00 01 00 02 e9 03 15 00 00 00 01 00 02 ea d0 15 00 00 00 01 00 02 fb 01 15 01 00 00 01 00 02 ff 10];
		qcom,mdss-dsi-dispparam-papermode2-state = "dsi_hs_mode";
		qcom,mdss-dsi-dispparam-papermode3-command = [15 00 00 00 01 00 02 ff 20 15 00 00 00 01 00 02 fb 01 15 00 00 00 01 00 02 75 00 15 00 00 00 01 00 02 76 00 15 00 00 00 01 00 02 77 00 15 00 00 00 01 00 02 78 41 15 00 00 00 01 00 02 79 00 15 00 00 00 01 00 02 7a 80 15 00 00 00 01 00 02 7b 00 15 00 00 00 01 00 02 7c a7 15 00 00 00 01 00 02 7d 00 15 00 00 00 01 00 02 7e c6 15 00 00 00 01 00 02 7f 00 15 00 00 00 01 00 02 80 dd 15 00 00 00 01 00 02 81 00 15 00 00 00 01 00 02 82 f3 15 00 00 00 01 00 02 83 01 15 00 00 00 01 00 02 84 06 15 00 00 00 01 00 02 85 01 15 00 00 00 01 00 02 86 15 15 00 00 00 01 00 02 87 01 15 00 00 00 01 00 02 88 4b 15 00 00 00 01 00 02 89 01 15 00 00 00 01 00 02 8a 74 15 00 00 00 01 00 02 8b 01 15 00 00 00 01 00 02 8c b1 15 00 00 00 01 00 02 8d 01 15 00 00 00 01 00 02 8e e2 15 00 00 00 01 00 02 8f 02 15 00 00 00 01 00 02 90 28 15 00 00 00 01 00 02 91 02 15 00 00 00 01 00 02 92 5b 15 00 00 00 01 00 02 93 02 15 00 00 00 01 00 02 94 5c 15 00 00 00 01 00 02 95 02 15 00 00 00 01 00 02 96 8e 15 00 00 00 01 00 02 97 02 15 00 00 00 01 00 02 98 c8 15 00 00 00 01 00 02 99 02 15 00 00 00 01 00 02 9a ec 15 00 00 00 01 00 02 9b 03 15 00 00 00 01 00 02 9c 1b 15 00 00 00 01 00 02 9d 03 15 00 00 00 01 00 02 9e 39 15 00 00 00 01 00 02 9f 03 15 00 00 00 01 00 02 a0 5f 15 00 00 00 01 00 02 a2 03 15 00 00 00 01 00 02 a3 6b 15 00 00 00 01 00 02 a4 03 15 00 00 00 01 00 02 a5 78 15 00 00 00 01 00 02 a6 03 15 00 00 00 01 00 02 a7 86 15 00 00 00 01 00 02 a9 03 15 00 00 00 01 00 02 aa 95 15 00 00 00 01 00 02 ab 03 15 00 00 00 01 00 02 ac a8 15 00 00 00 01 00 02 ad 03 15 00 00 00 01 00 02 ae ba 15 00 00 00 01 00 02 af 03 15 00 00 00 01 00 02 b0 cc 15 00 00 00 01 00 02 b1 03 15 00 00 00 01 00 02 b2 d0 15 00 00 00 01 00 02 b3 00 15 00 00 00 01 00 02 b4 4c 15 00 00 00 01 00 02 b5 00 15 00 00 00 01 00 02 b6 8d 15 00 00 00 01 00 02 b7 00 15 00 00 00 01 00 02 b8 cb 15 00 00 00 01 00 02 b9 00 15 00 00 00 01 00 02 ba f0 15 00 00 00 01 00 02 bb 01 15 00 00 00 01 00 02 bc 0d 15 00 00 00 01 00 02 bd 01 15 00 00 00 01 00 02 be 24 15 00 00 00 01 00 02 bf 01 15 00 00 00 01 00 02 c0 38 15 00 00 00 01 00 02 c1 01 15 00 00 00 01 00 02 c2 49 15 00 00 00 01 00 02 c3 01 15 00 00 00 01 00 02 c4 58 15 00 00 00 01 00 02 c5 01 15 00 00 00 01 00 02 c6 88 15 00 00 00 01 00 02 c7 01 15 00 00 00 01 00 02 c8 ab 15 00 00 00 01 00 02 c9 01 15 00 00 00 01 00 02 ca de 15 00 00 00 01 00 02 cb 02 15 00 00 00 01 00 02 cc 03 15 00 00 00 01 00 02 cd 02 15 00 00 00 01 00 02 ce 3b 15 00 00 00 01 00 02 cf 02 15 00 00 00 01 00 02 d0 6e 15 00 00 00 01 00 02 d1 02 15 00 00 00 01 00 02 d2 6f 15 00 00 00 01 00 02 d3 02 15 00 00 00 01 00 02 d4 a1 15 00 00 00 01 00 02 d5 02 15 00 00 00 01 00 02 d6 d7 15 00 00 00 01 00 02 d7 02 15 00 00 00 01 00 02 d8 f9 15 00 00 00 01 00 02 d9 03 15 00 00 00 01 00 02 da 24 15 00 00 00 01 00 02 db 03 15 00 00 00 01 00 02 dc 40 15 00 00 00 01 00 02 dd 03 15 00 00 00 01 00 02 de 64 15 00 00 00 01 00 02 df 03 15 00 00 00 01 00 02 e0 6f 15 00 00 00 01 00 02 e1 03 15 00 00 00 01 00 02 e2 7b 15 00 00 00 01 00 02 e3 03 15 00 00 00 01 00 02 e4 89 15 00 00 00 01 00 02 e5 03 15 00 00 00 01 00 02 e6 97 15 00 00 00 01 00 02 e7 03 15 00 00 00 01 00 02 e8 a9 15 00 00 00 01 00 02 e9 03 15 00 00 00 01 00 02 ea bb 15 00 00 00 01 00 02 eb 03 15 00 00 00 01 00 02 ec cd 15 00 00 00 01 00 02 ed 03 15 00 00 00 01 00 02 ee d0 15 00 00 00 01 00 02 ef 00 15 00 00 00 01 00 02 f0 00 15 00 00 00 01 00 02 f1 00 15 00 00 00 01 00 02 f2 41 15 00 00 00 01 00 02 f3 00 15 00 00 00 01 00 02 f4 80 15 00 00 00 01 00 02 f5 00 15 00 00 00 01 00 02 f6 a7 15 00 00 00 01 00 02 f7 00 15 00 00 00 01 00 02 f8 c6 15 00 00 00 01 00 02 f9 00 15 01 00 00 01 00 02 fa dd 15 00 00 00 01 00 02 ff 21 15 00 00 00 01 00 02 fb 01 15 00 00 00 01 00 02 00 00 15 00 00 00 01 00 02 01 f3 15 00 00 00 01 00 02 02 01 15 00 00 00 01 00 02 03 06 15 00 00 00 01 00 02 04 01 15 00 00 00 01 00 02 05 15 15 00 00 00 01 00 02 06 01 15 00 00 00 01 00 02 07 4b 15 00 00 00 01 00 02 08 01 15 00 00 00 01 00 02 09 74 15 00 00 00 01 00 02 0a 01 15 00 00 00 01 00 02 0b b1 15 00 00 00 01 00 02 0c 01 15 00 00 00 01 00 02 0d e2 15 00 00 00 01 00 02 0e 02 15 00 00 00 01 00 02 0f 28 15 00 00 00 01 00 02 10 02 15 00 00 00 01 00 02 11 5b 15 00 00 00 01 00 02 12 02 15 00 00 00 01 00 02 13 5c 15 00 00 00 01 00 02 14 02 15 00 00 00 01 00 02 15 8e 15 00 00 00 01 00 02 16 02 15 00 00 00 01 00 02 17 c8 15 00 00 00 01 00 02 18 02 15 00 00 00 01 00 02 19 ec 15 00 00 00 01 00 02 1a 03 15 00 00 00 01 00 02 1b 1b 15 00 00 00 01 00 02 1c 03 15 00 00 00 01 00 02 1d 39 15 00 00 00 01 00 02 1e 03 15 00 00 00 01 00 02 1f 5f 15 00 00 00 01 00 02 20 03 15 00 00 00 01 00 02 21 6b 15 00 00 00 01 00 02 22 03 15 00 00 00 01 00 02 23 78 15 00 00 00 01 00 02 24 03 15 00 00 00 01 00 02 25 86 15 00 00 00 01 00 02 26 03 15 00 00 00 01 00 02 27 95 15 00 00 00 01 00 02 28 03 15 00 00 00 01 00 02 29 a8 15 00 00 00 01 00 02 2a 03 15 00 00 00 01 00 02 2b ba 15 00 00 00 01 00 02 2d 03 15 00 00 00 01 00 02 2f cc 15 00 00 00 01 00 02 30 03 15 00 00 00 01 00 02 31 d0 15 00 00 00 01 00 02 32 00 15 00 00 00 01 00 02 33 4c 15 00 00 00 01 00 02 34 00 15 00 00 00 01 00 02 35 8d 15 00 00 00 01 00 02 36 00 15 00 00 00 01 00 02 37 cb 15 00 00 00 01 00 02 38 00 15 00 00 00 01 00 02 39 f0 15 00 00 00 01 00 02 3a 01 15 00 00 00 01 00 02 3b 0d 15 00 00 00 01 00 02 3d 01 15 00 00 00 01 00 02 3f 24 15 00 00 00 01 00 02 40 01 15 00 00 00 01 00 02 41 38 15 00 00 00 01 00 02 42 01 15 00 00 00 01 00 02 43 49 15 00 00 00 01 00 02 44 01 15 00 00 00 01 00 02 45 58 15 00 00 00 01 00 02 46 01 15 00 00 00 01 00 02 47 88 15 00 00 00 01 00 02 48 01 15 00 00 00 01 00 02 49 ab 15 00 00 00 01 00 02 4a 01 15 00 00 00 01 00 02 4b de 15 00 00 00 01 00 02 4c 02 15 00 00 00 01 00 02 4d 03 15 00 00 00 01 00 02 4e 02 15 00 00 00 01 00 02 4f 3b 15 00 00 00 01 00 02 50 02 15 00 00 00 01 00 02 51 6e 15 00 00 00 01 00 02 52 02 15 00 00 00 01 00 02 53 6f 15 00 00 00 01 00 02 54 02 15 00 00 00 01 00 02 55 a1 15 00 00 00 01 00 02 56 02 15 00 00 00 01 00 02 58 d7 15 00 00 00 01 00 02 59 02 15 00 00 00 01 00 02 5a f9 15 00 00 00 01 00 02 5b 03 15 00 00 00 01 00 02 5c 24 15 00 00 00 01 00 02 5d 03 15 00 00 00 01 00 02 5e 40 15 00 00 00 01 00 02 5f 03 15 00 00 00 01 00 02 60 64 15 00 00 00 01 00 02 61 03 15 00 00 00 01 00 02 62 6f 15 00 00 00 01 00 02 63 03 15 00 00 00 01 00 02 64 7b 15 00 00 00 01 00 02 65 03 15 00 00 00 01 00 02 66 89 15 00 00 00 01 00 02 67 03 15 00 00 00 01 00 02 68 97 15 00 00 00 01 00 02 69 03 15 00 00 00 01 00 02 6a a9 15 00 00 00 01 00 02 6b 03 15 00 00 00 01 00 02 6c bb 15 00 00 00 01 00 02 6d 03 15 00 00 00 01 00 02 6e cd 15 00 00 00 01 00 02 6f 03 15 00 00 00 01 00 02 70 d0 15 00 00 00 01 00 02 71 01 15 00 00 00 01 00 02 72 86 15 00 00 00 01 00 02 73 01 15 00 00 00 01 00 02 74 8a 15 00 00 00 01 00 02 75 01 15 00 00 00 01 00 02 76 92 15 00 00 00 01 00 02 77 01 15 00 00 00 01 00 02 78 99 15 00 00 00 01 00 02 79 01 15 00 00 00 01 00 02 7a a0 15 00 00 00 01 00 02 7b 01 15 00 00 00 01 00 02 7c a7 15 00 00 00 01 00 02 7d 01 15 00 00 00 01 00 02 7e ad 15 00 00 00 01 00 02 7f 01 15 00 00 00 01 00 02 80 b4 15 00 00 00 01 00 02 81 01 15 00 00 00 01 00 02 82 ba 15 00 00 00 01 00 02 83 01 15 00 00 00 01 00 02 84 cf 15 00 00 00 01 00 02 85 01 15 00 00 00 01 00 02 86 e2 15 00 00 00 01 00 02 87 02 15 00 00 00 01 00 02 88 03 15 00 00 00 01 00 02 89 02 15 00 00 00 01 00 02 8a 1f 15 00 00 00 01 00 02 8b 02 15 00 00 00 01 00 02 8c 4f 15 00 00 00 01 00 02 8d 02 15 00 00 00 01 00 02 8e 7b 15 00 00 00 01 00 02 8f 02 15 00 00 00 01 00 02 90 7c 15 00 00 00 01 00 02 91 02 15 00 00 00 01 00 02 92 a8 15 00 00 00 01 00 02 93 02 15 00 00 00 01 00 02 94 d9 15 00 00 00 01 00 02 95 02 15 00 00 00 01 00 02 96 f7 15 00 00 00 01 00 02 97 03 15 00 00 00 01 00 02 98 2c 15 00 00 00 01 00 02 99 03 15 00 00 00 01 00 02 9a 48 15 00 00 00 01 00 02 9b 03 15 00 00 00 01 00 02 9c 6c 15 00 00 00 01 00 02 9d 03 15 00 00 00 01 00 02 9e 76 15 00 00 00 01 00 02 9f 03 15 00 00 00 01 00 02 a0 82 15 00 00 00 01 00 02 a2 03 15 00 00 00 01 00 02 a3 90 15 00 00 00 01 00 02 a4 03 15 00 00 00 01 00 02 a5 a0 15 00 00 00 01 00 02 a6 03 15 00 00 00 01 00 02 a7 b3 15 00 00 00 01 00 02 a9 03 15 00 00 00 01 00 02 aa c4 15 00 00 00 01 00 02 ab 03 15 00 00 00 01 00 02 ac cf 15 00 00 00 01 00 02 ad 03 15 00 00 00 01 00 02 ae d0 15 00 00 00 01 00 02 af 01 15 00 00 00 01 00 02 b0 d2 15 00 00 00 01 00 02 b1 01 15 00 00 00 01 00 02 b2 d4 15 00 00 00 01 00 02 b3 01 15 00 00 00 01 00 02 b4 d9 15 00 00 00 01 00 02 b5 01 15 00 00 00 01 00 02 b6 dd 15 00 00 00 01 00 02 b7 01 15 00 00 00 01 00 02 b8 e1 15 00 00 00 01 00 02 b9 01 15 00 00 00 01 00 02 ba e5 15 00 00 00 01 00 02 bb 01 15 00 00 00 01 00 02 bc e9 15 00 00 00 01 00 02 bd 01 15 00 00 00 01 00 02 be ed 15 00 00 00 01 00 02 bf 01 15 00 00 00 01 00 02 c0 f1 15 00 00 00 01 00 02 c1 02 15 00 00 00 01 00 02 c2 00 15 00 00 00 01 00 02 c3 02 15 00 00 00 01 00 02 c4 0d 15 00 00 00 01 00 02 c5 02 15 00 00 00 01 00 02 c6 26 15 00 00 00 01 00 02 c7 02 15 00 00 00 01 00 02 c8 3c 15 00 00 00 01 00 02 c9 02 15 00 00 00 01 00 02 ca 64 15 00 00 00 01 00 02 cb 02 15 00 00 00 01 00 02 cc 8c 15 00 00 00 01 00 02 cd 02 15 00 00 00 01 00 02 ce 8d 15 00 00 00 01 00 02 cf 02 15 00 00 00 01 00 02 d0 b7 15 00 00 00 01 00 02 d1 02 15 00 00 00 01 00 02 d2 e5 15 00 00 00 01 00 02 d3 03 15 00 00 00 01 00 02 d4 02 15 00 00 00 01 00 02 d5 03 15 00 00 00 01 00 02 d6 36 15 00 00 00 01 00 02 d7 03 15 00 00 00 01 00 02 d8 52 15 00 00 00 01 00 02 d9 03 15 00 00 00 01 00 02 da 76 15 00 00 00 01 00 02 db 03 15 00 00 00 01 00 02 dc 81 15 00 00 00 01 00 02 dd 03 15 00 00 00 01 00 02 de 8e 15 00 00 00 01 00 02 df 03 15 00 00 00 01 00 02 e0 9d 15 00 00 00 01 00 02 e1 03 15 00 00 00 01 00 02 e2 ad 15 00 00 00 01 00 02 e3 03 15 00 00 00 01 00 02 e4 bc 15 00 00 00 01 00 02 e5 03 15 00 00 00 01 00 02 e6 c8 15 00 00 00 01 00 02 e7 03 15 00 00 00 01 00 02 e8 f7 15 00 00 00 01 00 02 e9 03 15 00 00 00 01 00 02 ea f8 15 00 00 00 01 00 02 fb 01 15 01 00 00 01 00 02 ff 10];
		qcom,mdss-dsi-dispparam-papermode3-state = "dsi_hs_mode";
		qcom,mdss-dsi-dispparam-papermode4-command = [15 00 00 00 01 00 02 ff 20 15 00 00 00 01 00 02 fb 01 15 00 00 00 01 00 02 75 00 15 00 00 00 01 00 02 76 00 15 00 00 00 01 00 02 77 00 15 00 00 00 01 00 02 78 41 15 00 00 00 01 00 02 79 00 15 00 00 00 01 00 02 7a 80 15 00 00 00 01 00 02 7b 00 15 00 00 00 01 00 02 7c a7 15 00 00 00 01 00 02 7d 00 15 00 00 00 01 00 02 7e c6 15 00 00 00 01 00 02 7f 00 15 00 00 00 01 00 02 80 dd 15 00 00 00 01 00 02 81 00 15 00 00 00 01 00 02 82 f3 15 00 00 00 01 00 02 83 01 15 00 00 00 01 00 02 84 06 15 00 00 00 01 00 02 85 01 15 00 00 00 01 00 02 86 15 15 00 00 00 01 00 02 87 01 15 00 00 00 01 00 02 88 4b 15 00 00 00 01 00 02 89 01 15 00 00 00 01 00 02 8a 74 15 00 00 00 01 00 02 8b 01 15 00 00 00 01 00 02 8c b1 15 00 00 00 01 00 02 8d 01 15 00 00 00 01 00 02 8e e2 15 00 00 00 01 00 02 8f 02 15 00 00 00 01 00 02 90 28 15 00 00 00 01 00 02 91 02 15 00 00 00 01 00 02 92 5b 15 00 00 00 01 00 02 93 02 15 00 00 00 01 00 02 94 5c 15 00 00 00 01 00 02 95 02 15 00 00 00 01 00 02 96 8e 15 00 00 00 01 00 02 97 02 15 00 00 00 01 00 02 98 c8 15 00 00 00 01 00 02 99 02 15 00 00 00 01 00 02 9a ec 15 00 00 00 01 00 02 9b 03 15 00 00 00 01 00 02 9c 1b 15 00 00 00 01 00 02 9d 03 15 00 00 00 01 00 02 9e 39 15 00 00 00 01 00 02 9f 03 15 00 00 00 01 00 02 a0 5f 15 00 00 00 01 00 02 a2 03 15 00 00 00 01 00 02 a3 6b 15 00 00 00 01 00 02 a4 03 15 00 00 00 01 00 02 a5 78 15 00 00 00 01 00 02 a6 03 15 00 00 00 01 00 02 a7 86 15 00 00 00 01 00 02 a9 03 15 00 00 00 01 00 02 aa 95 15 00 00 00 01 00 02 ab 03 15 00 00 00 01 00 02 ac a8 15 00 00 00 01 00 02 ad 03 15 00 00 00 01 00 02 ae ba 15 00 00 00 01 00 02 af 03 15 00 00 00 01 00 02 b0 cc 15 00 00 00 01 00 02 b1 03 15 00 00 00 01 00 02 b2 d0 15 00 00 00 01 00 02 b3 00 15 00 00 00 01 00 02 b4 4c 15 00 00 00 01 00 02 b5 00 15 00 00 00 01 00 02 b6 8d 15 00 00 00 01 00 02 b7 00 15 00 00 00 01 00 02 b8 cb 15 00 00 00 01 00 02 b9 00 15 00 00 00 01 00 02 ba f0 15 00 00 00 01 00 02 bb 01 15 00 00 00 01 00 02 bc 0d 15 00 00 00 01 00 02 bd 01 15 00 00 00 01 00 02 be 24 15 00 00 00 01 00 02 bf 01 15 00 00 00 01 00 02 c0 38 15 00 00 00 01 00 02 c1 01 15 00 00 00 01 00 02 c2 49 15 00 00 00 01 00 02 c3 01 15 00 00 00 01 00 02 c4 58 15 00 00 00 01 00 02 c5 01 15 00 00 00 01 00 02 c6 88 15 00 00 00 01 00 02 c7 01 15 00 00 00 01 00 02 c8 ab 15 00 00 00 01 00 02 c9 01 15 00 00 00 01 00 02 ca de 15 00 00 00 01 00 02 cb 02 15 00 00 00 01 00 02 cc 03 15 00 00 00 01 00 02 cd 02 15 00 00 00 01 00 02 ce 3b 15 00 00 00 01 00 02 cf 02 15 00 00 00 01 00 02 d0 6e 15 00 00 00 01 00 02 d1 02 15 00 00 00 01 00 02 d2 6f 15 00 00 00 01 00 02 d3 02 15 00 00 00 01 00 02 d4 a1 15 00 00 00 01 00 02 d5 02 15 00 00 00 01 00 02 d6 d7 15 00 00 00 01 00 02 d7 02 15 00 00 00 01 00 02 d8 f9 15 00 00 00 01 00 02 d9 03 15 00 00 00 01 00 02 da 24 15 00 00 00 01 00 02 db 03 15 00 00 00 01 00 02 dc 40 15 00 00 00 01 00 02 dd 03 15 00 00 00 01 00 02 de 64 15 00 00 00 01 00 02 df 03 15 00 00 00 01 00 02 e0 6f 15 00 00 00 01 00 02 e1 03 15 00 00 00 01 00 02 e2 7b 15 00 00 00 01 00 02 e3 03 15 00 00 00 01 00 02 e4 89 15 00 00 00 01 00 02 e5 03 15 00 00 00 01 00 02 e6 97 15 00 00 00 01 00 02 e7 03 15 00 00 00 01 00 02 e8 a9 15 00 00 00 01 00 02 e9 03 15 00 00 00 01 00 02 ea bb 15 00 00 00 01 00 02 eb 03 15 00 00 00 01 00 02 ec cd 15 00 00 00 01 00 02 ed 03 15 00 00 00 01 00 02 ee d0 15 00 00 00 01 00 02 ef 00 15 00 00 00 01 00 02 f0 00 15 00 00 00 01 00 02 f1 00 15 00 00 00 01 00 02 f2 41 15 00 00 00 01 00 02 f3 00 15 00 00 00 01 00 02 f4 80 15 00 00 00 01 00 02 f5 00 15 00 00 00 01 00 02 f6 a7 15 00 00 00 01 00 02 f7 00 15 00 00 00 01 00 02 f8 c6 15 00 00 00 01 00 02 f9 00 15 01 00 00 01 00 02 fa dd 15 00 00 00 01 00 02 ff 21 15 00 00 00 01 00 02 fb 01 15 00 00 00 01 00 02 00 00 15 00 00 00 01 00 02 01 f3 15 00 00 00 01 00 02 02 01 15 00 00 00 01 00 02 03 06 15 00 00 00 01 00 02 04 01 15 00 00 00 01 00 02 05 15 15 00 00 00 01 00 02 06 01 15 00 00 00 01 00 02 07 4b 15 00 00 00 01 00 02 08 01 15 00 00 00 01 00 02 09 74 15 00 00 00 01 00 02 0a 01 15 00 00 00 01 00 02 0b b1 15 00 00 00 01 00 02 0c 01 15 00 00 00 01 00 02 0d e2 15 00 00 00 01 00 02 0e 02 15 00 00 00 01 00 02 0f 28 15 00 00 00 01 00 02 10 02 15 00 00 00 01 00 02 11 5b 15 00 00 00 01 00 02 12 02 15 00 00 00 01 00 02 13 5c 15 00 00 00 01 00 02 14 02 15 00 00 00 01 00 02 15 8e 15 00 00 00 01 00 02 16 02 15 00 00 00 01 00 02 17 c8 15 00 00 00 01 00 02 18 02 15 00 00 00 01 00 02 19 ec 15 00 00 00 01 00 02 1a 03 15 00 00 00 01 00 02 1b 1b 15 00 00 00 01 00 02 1c 03 15 00 00 00 01 00 02 1d 39 15 00 00 00 01 00 02 1e 03 15 00 00 00 01 00 02 1f 5f 15 00 00 00 01 00 02 20 03 15 00 00 00 01 00 02 21 6b 15 00 00 00 01 00 02 22 03 15 00 00 00 01 00 02 23 78 15 00 00 00 01 00 02 24 03 15 00 00 00 01 00 02 25 86 15 00 00 00 01 00 02 26 03 15 00 00 00 01 00 02 27 95 15 00 00 00 01 00 02 28 03 15 00 00 00 01 00 02 29 a8 15 00 00 00 01 00 02 2a 03 15 00 00 00 01 00 02 2b ba 15 00 00 00 01 00 02 2d 03 15 00 00 00 01 00 02 2f cc 15 00 00 00 01 00 02 30 03 15 00 00 00 01 00 02 31 d0 15 00 00 00 01 00 02 32 00 15 00 00 00 01 00 02 33 4c 15 00 00 00 01 00 02 34 00 15 00 00 00 01 00 02 35 8d 15 00 00 00 01 00 02 36 00 15 00 00 00 01 00 02 37 cb 15 00 00 00 01 00 02 38 00 15 00 00 00 01 00 02 39 f0 15 00 00 00 01 00 02 3a 01 15 00 00 00 01 00 02 3b 0d 15 00 00 00 01 00 02 3d 01 15 00 00 00 01 00 02 3f 24 15 00 00 00 01 00 02 40 01 15 00 00 00 01 00 02 41 38 15 00 00 00 01 00 02 42 01 15 00 00 00 01 00 02 43 49 15 00 00 00 01 00 02 44 01 15 00 00 00 01 00 02 45 58 15 00 00 00 01 00 02 46 01 15 00 00 00 01 00 02 47 88 15 00 00 00 01 00 02 48 01 15 00 00 00 01 00 02 49 ab 15 00 00 00 01 00 02 4a 01 15 00 00 00 01 00 02 4b de 15 00 00 00 01 00 02 4c 02 15 00 00 00 01 00 02 4d 03 15 00 00 00 01 00 02 4e 02 15 00 00 00 01 00 02 4f 3b 15 00 00 00 01 00 02 50 02 15 00 00 00 01 00 02 51 6e 15 00 00 00 01 00 02 52 02 15 00 00 00 01 00 02 53 6f 15 00 00 00 01 00 02 54 02 15 00 00 00 01 00 02 55 a1 15 00 00 00 01 00 02 56 02 15 00 00 00 01 00 02 58 d7 15 00 00 00 01 00 02 59 02 15 00 00 00 01 00 02 5a f9 15 00 00 00 01 00 02 5b 03 15 00 00 00 01 00 02 5c 24 15 00 00 00 01 00 02 5d 03 15 00 00 00 01 00 02 5e 40 15 00 00 00 01 00 02 5f 03 15 00 00 00 01 00 02 60 64 15 00 00 00 01 00 02 61 03 15 00 00 00 01 00 02 62 6f 15 00 00 00 01 00 02 63 03 15 00 00 00 01 00 02 64 7b 15 00 00 00 01 00 02 65 03 15 00 00 00 01 00 02 66 89 15 00 00 00 01 00 02 67 03 15 00 00 00 01 00 02 68 97 15 00 00 00 01 00 02 69 03 15 00 00 00 01 00 02 6a a9 15 00 00 00 01 00 02 6b 03 15 00 00 00 01 00 02 6c bb 15 00 00 00 01 00 02 6d 03 15 00 00 00 01 00 02 6e cd 15 00 00 00 01 00 02 6f 03 15 00 00 00 01 00 02 70 d0 15 00 00 00 01 00 02 71 01 15 00 00 00 01 00 02 72 ae 15 00 00 00 01 00 02 73 01 15 00 00 00 01 00 02 74 b1 15 00 00 00 01 00 02 75 01 15 00 00 00 01 00 02 76 b7 15 00 00 00 01 00 02 77 01 15 00 00 00 01 00 02 78 bc 15 00 00 00 01 00 02 79 01 15 00 00 00 01 00 02 7a c2 15 00 00 00 01 00 02 7b 01 15 00 00 00 01 00 02 7c c7 15 00 00 00 01 00 02 7d 01 15 00 00 00 01 00 02 7e cc 15 00 00 00 01 00 02 7f 01 15 00 00 00 01 00 02 80 d1 15 00 00 00 01 00 02 81 01 15 00 00 00 01 00 02 82 d6 15 00 00 00 01 00 02 83 01 15 00 00 00 01 00 02 84 e7 15 00 00 00 01 00 02 85 01 15 00 00 00 01 00 02 86 f7 15 00 00 00 01 00 02 87 02 15 00 00 00 01 00 02 88 14 15 00 00 00 01 00 02 89 02 15 00 00 00 01 00 02 8a 2c 15 00 00 00 01 00 02 8b 02 15 00 00 00 01 00 02 8c 58 15 00 00 00 01 00 02 8d 02 15 00 00 00 01 00 02 8e 82 15 00 00 00 01 00 02 8f 02 15 00 00 00 01 00 02 90 84 15 00 00 00 01 00 02 91 02 15 00 00 00 01 00 02 92 ae 15 00 00 00 01 00 02 93 02 15 00 00 00 01 00 02 94 de 15 00 00 00 01 00 02 95 02 15 00 00 00 01 00 02 96 fc 15 00 00 00 01 00 02 97 03 15 00 00 00 01 00 02 98 30 15 00 00 00 01 00 02 99 03 15 00 00 00 01 00 02 9a 4c 15 00 00 00 01 00 02 9b 03 15 00 00 00 01 00 02 9c 6f 15 00 00 00 01 00 02 9d 03 15 00 00 00 01 00 02 9e 7a 15 00 00 00 01 00 02 9f 03 15 00 00 00 01 00 02 a0 86 15 00 00 00 01 00 02 a2 03 15 00 00 00 01 00 02 a3 93 15 00 00 00 01 00 02 a4 03 15 00 00 00 01 00 02 a5 a3 15 00 00 00 01 00 02 a6 03 15 00 00 00 01 00 02 a7 b5 15 00 00 00 01 00 02 a9 03 15 00 00 00 01 00 02 aa c5 15 00 00 00 01 00 02 ab 03 15 00 00 00 01 00 02 ac cf 15 00 00 00 01 00 02 ad 03 15 00 00 00 01 00 02 ae d0 15 00 00 00 01 00 02 af 01 15 00 00 00 01 00 02 b0 fa 15 00 00 00 01 00 02 b1 01 15 00 00 00 01 00 02 b2 fc 15 00 00 00 01 00 02 b3 01 15 00 00 00 01 00 02 b4 ff 15 00 00 00 01 00 02 b5 02 15 00 00 00 01 00 02 b6 02 15 00 00 00 01 00 02 b7 02 15 00 00 00 01 00 02 b8 05 15 00 00 00 01 00 02 b9 02 15 00 00 00 01 00 02 ba 09 15 00 00 00 01 00 02 bb 02 15 00 00 00 01 00 02 bc 0c 15 00 00 00 01 00 02 bd 02 15 00 00 00 01 00 02 be 0f 15 00 00 00 01 00 02 bf 02 15 00 00 00 01 00 02 c0 12 15 00 00 00 01 00 02 c1 02 15 00 00 00 01 00 02 c2 1d 15 00 00 00 01 00 02 c3 02 15 00 00 00 01 00 02 c4 27 15 00 00 00 01 00 02 c5 02 15 00 00 00 01 00 02 c6 3c 15 00 00 00 01 00 02 c7 02 15 00 00 00 01 00 02 c8 4f 15 00 00 00 01 00 02 c9 02 15 00 00 00 01 00 02 ca 74 15 00 00 00 01 00 02 cb 02 15 00 00 00 01 00 02 cc 99 15 00 00 00 01 00 02 cd 02 15 00 00 00 01 00 02 ce 9a 15 00 00 00 01 00 02 cf 02 15 00 00 00 01 00 02 d0 c0 15 00 00 00 01 00 02 d1 02 15 00 00 00 01 00 02 d2 ed 15 00 00 00 01 00 02 d3 03 15 00 00 00 01 00 02 d4 0a 15 00 00 00 01 00 02 d5 03 15 00 00 00 01 00 02 d6 3e 15 00 00 00 01 00 02 d7 03 15 00 00 00 01 00 02 d8 59 15 00 00 00 01 00 02 d9 03 15 00 00 00 01 00 02 da 7d 15 00 00 00 01 00 02 db 03 15 00 00 00 01 00 02 dc 88 15 00 00 00 01 00 02 dd 03 15 00 00 00 01 00 02 de 94 15 00 00 00 01 00 02 df 03 15 00 00 00 01 00 02 e0 a2 15 00 00 00 01 00 02 e1 03 15 00 00 00 01 00 02 e2 b1 15 00 00 00 01 00 02 e3 03 15 00 00 00 01 00 02 e4 bf 15 00 00 00 01 00 02 e5 03 15 00 00 00 01 00 02 e6 ca 15 00 00 00 01 00 02 e7 03 15 00 00 00 01 00 02 e8 f7 15 00 00 00 01 00 02 e9 03 15 00 00 00 01 00 02 ea f8 15 00 00 00 01 00 02 fb 01 15 01 00 00 01 00 02 ff 10];
		qcom,mdss-dsi-dispparam-papermode4-state = "dsi_hs_mode";
		qcom,mdss-dsi-dispparam-papermode5-command = [15 00 00 00 01 00 02 ff 20 15 00 00 00 01 00 02 fb 01 15 00 00 00 01 00 02 75 00 15 00 00 00 01 00 02 76 00 15 00 00 00 01 00 02 77 00 15 00 00 00 01 00 02 78 41 15 00 00 00 01 00 02 79 00 15 00 00 00 01 00 02 7a 80 15 00 00 00 01 00 02 7b 00 15 00 00 00 01 00 02 7c a7 15 00 00 00 01 00 02 7d 00 15 00 00 00 01 00 02 7e c6 15 00 00 00 01 00 02 7f 00 15 00 00 00 01 00 02 80 dd 15 00 00 00 01 00 02 81 00 15 00 00 00 01 00 02 82 f3 15 00 00 00 01 00 02 83 01 15 00 00 00 01 00 02 84 06 15 00 00 00 01 00 02 85 01 15 00 00 00 01 00 02 86 15 15 00 00 00 01 00 02 87 01 15 00 00 00 01 00 02 88 4b 15 00 00 00 01 00 02 89 01 15 00 00 00 01 00 02 8a 74 15 00 00 00 01 00 02 8b 01 15 00 00 00 01 00 02 8c b1 15 00 00 00 01 00 02 8d 01 15 00 00 00 01 00 02 8e e2 15 00 00 00 01 00 02 8f 02 15 00 00 00 01 00 02 90 28 15 00 00 00 01 00 02 91 02 15 00 00 00 01 00 02 92 5b 15 00 00 00 01 00 02 93 02 15 00 00 00 01 00 02 94 5c 15 00 00 00 01 00 02 95 02 15 00 00 00 01 00 02 96 8e 15 00 00 00 01 00 02 97 02 15 00 00 00 01 00 02 98 c8 15 00 00 00 01 00 02 99 02 15 00 00 00 01 00 02 9a ec 15 00 00 00 01 00 02 9b 03 15 00 00 00 01 00 02 9c 1b 15 00 00 00 01 00 02 9d 03 15 00 00 00 01 00 02 9e 39 15 00 00 00 01 00 02 9f 03 15 00 00 00 01 00 02 a0 5f 15 00 00 00 01 00 02 a2 03 15 00 00 00 01 00 02 a3 6b 15 00 00 00 01 00 02 a4 03 15 00 00 00 01 00 02 a5 78 15 00 00 00 01 00 02 a6 03 15 00 00 00 01 00 02 a7 86 15 00 00 00 01 00 02 a9 03 15 00 00 00 01 00 02 aa 95 15 00 00 00 01 00 02 ab 03 15 00 00 00 01 00 02 ac a8 15 00 00 00 01 00 02 ad 03 15 00 00 00 01 00 02 ae ba 15 00 00 00 01 00 02 af 03 15 00 00 00 01 00 02 b0 cc 15 00 00 00 01 00 02 b1 03 15 00 00 00 01 00 02 b2 d0 15 00 00 00 01 00 02 b3 00 15 00 00 00 01 00 02 b4 4c 15 00 00 00 01 00 02 b5 00 15 00 00 00 01 00 02 b6 8d 15 00 00 00 01 00 02 b7 00 15 00 00 00 01 00 02 b8 cb 15 00 00 00 01 00 02 b9 00 15 00 00 00 01 00 02 ba f0 15 00 00 00 01 00 02 bb 01 15 00 00 00 01 00 02 bc 0d 15 00 00 00 01 00 02 bd 01 15 00 00 00 01 00 02 be 24 15 00 00 00 01 00 02 bf 01 15 00 00 00 01 00 02 c0 38 15 00 00 00 01 00 02 c1 01 15 00 00 00 01 00 02 c2 49 15 00 00 00 01 00 02 c3 01 15 00 00 00 01 00 02 c4 58 15 00 00 00 01 00 02 c5 01 15 00 00 00 01 00 02 c6 88 15 00 00 00 01 00 02 c7 01 15 00 00 00 01 00 02 c8 ab 15 00 00 00 01 00 02 c9 01 15 00 00 00 01 00 02 ca de 15 00 00 00 01 00 02 cb 02 15 00 00 00 01 00 02 cc 03 15 00 00 00 01 00 02 cd 02 15 00 00 00 01 00 02 ce 3b 15 00 00 00 01 00 02 cf 02 15 00 00 00 01 00 02 d0 6e 15 00 00 00 01 00 02 d1 02 15 00 00 00 01 00 02 d2 6f 15 00 00 00 01 00 02 d3 02 15 00 00 00 01 00 02 d4 a1 15 00 00 00 01 00 02 d5 02 15 00 00 00 01 00 02 d6 d7 15 00 00 00 01 00 02 d7 02 15 00 00 00 01 00 02 d8 f9 15 00 00 00 01 00 02 d9 03 15 00 00 00 01 00 02 da 24 15 00 00 00 01 00 02 db 03 15 00 00 00 01 00 02 dc 40 15 00 00 00 01 00 02 dd 03 15 00 00 00 01 00 02 de 64 15 00 00 00 01 00 02 df 03 15 00 00 00 01 00 02 e0 6f 15 00 00 00 01 00 02 e1 03 15 00 00 00 01 00 02 e2 7b 15 00 00 00 01 00 02 e3 03 15 00 00 00 01 00 02 e4 89 15 00 00 00 01 00 02 e5 03 15 00 00 00 01 00 02 e6 97 15 00 00 00 01 00 02 e7 03 15 00 00 00 01 00 02 e8 a9 15 00 00 00 01 00 02 e9 03 15 00 00 00 01 00 02 ea bb 15 00 00 00 01 00 02 eb 03 15 00 00 00 01 00 02 ec cd 15 00 00 00 01 00 02 ed 03 15 00 00 00 01 00 02 ee d0 15 00 00 00 01 00 02 ef 00 15 00 00 00 01 00 02 f0 00 15 00 00 00 01 00 02 f1 00 15 00 00 00 01 00 02 f2 41 15 00 00 00 01 00 02 f3 00 15 00 00 00 01 00 02 f4 80 15 00 00 00 01 00 02 f5 00 15 00 00 00 01 00 02 f6 a7 15 00 00 00 01 00 02 f7 00 15 00 00 00 01 00 02 f8 c6 15 00 00 00 01 00 02 f9 00 15 01 00 00 01 00 02 fa dd 15 00 00 00 01 00 02 ff 21 15 00 00 00 01 00 02 fb 01 15 00 00 00 01 00 02 00 00 15 00 00 00 01 00 02 01 f3 15 00 00 00 01 00 02 02 01 15 00 00 00 01 00 02 03 06 15 00 00 00 01 00 02 04 01 15 00 00 00 01 00 02 05 15 15 00 00 00 01 00 02 06 01 15 00 00 00 01 00 02 07 4b 15 00 00 00 01 00 02 08 01 15 00 00 00 01 00 02 09 74 15 00 00 00 01 00 02 0a 01 15 00 00 00 01 00 02 0b b1 15 00 00 00 01 00 02 0c 01 15 00 00 00 01 00 02 0d e2 15 00 00 00 01 00 02 0e 02 15 00 00 00 01 00 02 0f 28 15 00 00 00 01 00 02 10 02 15 00 00 00 01 00 02 11 5b 15 00 00 00 01 00 02 12 02 15 00 00 00 01 00 02 13 5c 15 00 00 00 01 00 02 14 02 15 00 00 00 01 00 02 15 8e 15 00 00 00 01 00 02 16 02 15 00 00 00 01 00 02 17 c8 15 00 00 00 01 00 02 18 02 15 00 00 00 01 00 02 19 ec 15 00 00 00 01 00 02 1a 03 15 00 00 00 01 00 02 1b 1b 15 00 00 00 01 00 02 1c 03 15 00 00 00 01 00 02 1d 39 15 00 00 00 01 00 02 1e 03 15 00 00 00 01 00 02 1f 5f 15 00 00 00 01 00 02 20 03 15 00 00 00 01 00 02 21 6b 15 00 00 00 01 00 02 22 03 15 00 00 00 01 00 02 23 78 15 00 00 00 01 00 02 24 03 15 00 00 00 01 00 02 25 86 15 00 00 00 01 00 02 26 03 15 00 00 00 01 00 02 27 95 15 00 00 00 01 00 02 28 03 15 00 00 00 01 00 02 29 a8 15 00 00 00 01 00 02 2a 03 15 00 00 00 01 00 02 2b ba 15 00 00 00 01 00 02 2d 03 15 00 00 00 01 00 02 2f cc 15 00 00 00 01 00 02 30 03 15 00 00 00 01 00 02 31 d0 15 00 00 00 01 00 02 32 00 15 00 00 00 01 00 02 33 4c 15 00 00 00 01 00 02 34 00 15 00 00 00 01 00 02 35 8d 15 00 00 00 01 00 02 36 00 15 00 00 00 01 00 02 37 cb 15 00 00 00 01 00 02 38 00 15 00 00 00 01 00 02 39 f0 15 00 00 00 01 00 02 3a 01 15 00 00 00 01 00 02 3b 0d 15 00 00 00 01 00 02 3d 01 15 00 00 00 01 00 02 3f 24 15 00 00 00 01 00 02 40 01 15 00 00 00 01 00 02 41 38 15 00 00 00 01 00 02 42 01 15 00 00 00 01 00 02 43 49 15 00 00 00 01 00 02 44 01 15 00 00 00 01 00 02 45 58 15 00 00 00 01 00 02 46 01 15 00 00 00 01 00 02 47 88 15 00 00 00 01 00 02 48 01 15 00 00 00 01 00 02 49 ab 15 00 00 00 01 00 02 4a 01 15 00 00 00 01 00 02 4b de 15 00 00 00 01 00 02 4c 02 15 00 00 00 01 00 02 4d 03 15 00 00 00 01 00 02 4e 02 15 00 00 00 01 00 02 4f 3b 15 00 00 00 01 00 02 50 02 15 00 00 00 01 00 02 51 6e 15 00 00 00 01 00 02 52 02 15 00 00 00 01 00 02 53 6f 15 00 00 00 01 00 02 54 02 15 00 00 00 01 00 02 55 a1 15 00 00 00 01 00 02 56 02 15 00 00 00 01 00 02 58 d7 15 00 00 00 01 00 02 59 02 15 00 00 00 01 00 02 5a f9 15 00 00 00 01 00 02 5b 03 15 00 00 00 01 00 02 5c 24 15 00 00 00 01 00 02 5d 03 15 00 00 00 01 00 02 5e 40 15 00 00 00 01 00 02 5f 03 15 00 00 00 01 00 02 60 64 15 00 00 00 01 00 02 61 03 15 00 00 00 01 00 02 62 6f 15 00 00 00 01 00 02 63 03 15 00 00 00 01 00 02 64 7b 15 00 00 00 01 00 02 65 03 15 00 00 00 01 00 02 66 89 15 00 00 00 01 00 02 67 03 15 00 00 00 01 00 02 68 97 15 00 00 00 01 00 02 69 03 15 00 00 00 01 00 02 6a a9 15 00 00 00 01 00 02 6b 03 15 00 00 00 01 00 02 6c bb 15 00 00 00 01 00 02 6d 03 15 00 00 00 01 00 02 6e cd 15 00 00 00 01 00 02 6f 03 15 00 00 00 01 00 02 70 d0 15 00 00 00 01 00 02 71 01 15 00 00 00 01 00 02 72 cd 15 00 00 00 01 00 02 73 01 15 00 00 00 01 00 02 74 cf 15 00 00 00 01 00 02 75 01 15 00 00 00 01 00 02 76 d4 15 00 00 00 01 00 02 77 01 15 00 00 00 01 00 02 78 d8 15 00 00 00 01 00 02 79 01 15 00 00 00 01 00 02 7a dd 15 00 00 00 01 00 02 7b 01 15 00 00 00 01 00 02 7c e1 15 00 00 00 01 00 02 7d 01 15 00 00 00 01 00 02 7e e5 15 00 00 00 01 00 02 7f 01 15 00 00 00 01 00 02 80 e9 15 00 00 00 01 00 02 81 01 15 00 00 00 01 00 02 82 ed 15 00 00 00 01 00 02 83 01 15 00 00 00 01 00 02 84 fc 15 00 00 00 01 00 02 85 02 15 00 00 00 01 00 02 86 0a 15 00 00 00 01 00 02 87 02 15 00 00 00 01 00 02 88 22 15 00 00 00 01 00 02 89 02 15 00 00 00 01 00 02 8a 38 15 00 00 00 01 00 02 8b 02 15 00 00 00 01 00 02 8c 62 15 00 00 00 01 00 02 8d 02 15 00 00 00 01 00 02 8e 8a 15 00 00 00 01 00 02 8f 02 15 00 00 00 01 00 02 90 8b 15 00 00 00 01 00 02 91 02 15 00 00 00 01 00 02 92 b4 15 00 00 00 01 00 02 93 02 15 00 00 00 01 00 02 94 e3 15 00 00 00 01 00 02 95 03 15 00 00 00 01 00 02 96 00 15 00 00 00 01 00 02 97 03 15 00 00 00 01 00 02 98 35 15 00 00 00 01 00 02 99 03 15 00 00 00 01 00 02 9a 50 15 00 00 00 01 00 02 9b 03 15 00 00 00 01 00 02 9c 72 15 00 00 00 01 00 02 9d 03 15 00 00 00 01 00 02 9e 7d 15 00 00 00 01 00 02 9f 03 15 00 00 00 01 00 02 a0 89 15 00 00 00 01 00 02 a2 03 15 00 00 00 01 00 02 a3 96 15 00 00 00 01 00 02 a4 03 15 00 00 00 01 00 02 a5 a6 15 00 00 00 01 00 02 a6 03 15 00 00 00 01 00 02 a7 b7 15 00 00 00 01 00 02 a9 03 15 00 00 00 01 00 02 aa c6 15 00 00 00 01 00 02 ab 03 15 00 00 00 01 00 02 ac cf 15 00 00 00 01 00 02 ad 03 15 00 00 00 01 00 02 ae d0 15 00 00 00 01 00 02 af 02 15 00 00 00 01 00 02 b0 19 15 00 00 00 01 00 02 b1 02 15 00 00 00 01 00 02 b2 1a 15 00 00 00 01 00 02 b3 02 15 00 00 00 01 00 02 b4 1d 15 00 00 00 01 00 02 b5 02 15 00 00 00 01 00 02 b6 1f 15 00 00 00 01 00 02 b7 02 15 00 00 00 01 00 02 b8 22 15 00 00 00 01 00 02 b9 02 15 00 00 00 01 00 02 ba 24 15 00 00 00 01 00 02 bb 02 15 00 00 00 01 00 02 bc 27 15 00 00 00 01 00 02 bd 02 15 00 00 00 01 00 02 be 29 15 00 00 00 01 00 02 bf 02 15 00 00 00 01 00 02 c0 2b 15 00 00 00 01 00 02 c1 02 15 00 00 00 01 00 02 c2 35 15 00 00 00 01 00 02 c3 02 15 00 00 00 01 00 02 c4 3e 15 00 00 00 01 00 02 c5 02 15 00 00 00 01 00 02 c6 50 15 00 00 00 01 00 02 c7 02 15 00 00 00 01 00 02 c8 61 15 00 00 00 01 00 02 c9 02 15 00 00 00 01 00 02 ca 82 15 00 00 00 01 00 02 cb 02 15 00 00 00 01 00 02 cc a5 15 00 00 00 01 00 02 cd 02 15 00 00 00 01 00 02 ce a6 15 00 00 00 01 00 02 cf 02 15 00 00 00 01 00 02 d0 ca 15 00 00 00 01 00 02 d1 02 15 00 00 00 01 00 02 d2 f5 15 00 00 00 01 00 02 d3 03 15 00 00 00 01 00 02 d4 13 15 00 00 00 01 00 02 d5 03 15 00 00 00 01 00 02 d6 45 15 00 00 00 01 00 02 d7 03 15 00 00 00 01 00 02 d8 60 15 00 00 00 01 00 02 d9 03 15 00 00 00 01 00 02 da 83 15 00 00 00 01 00 02 db 03 15 00 00 00 01 00 02 dc 8e 15 00 00 00 01 00 02 dd 03 15 00 00 00 01 00 02 de 9a 15 00 00 00 01 00 02 df 03 15 00 00 00 01 00 02 e0 a8 15 00 00 00 01 00 02 e1 03 15 00 00 00 01 00 02 e2 b5 15 00 00 00 01 00 02 e3 03 15 00 00 00 01 00 02 e4 c1 15 00 00 00 01 00 02 e5 03 15 00 00 00 01 00 02 e6 cb 15 00 00 00 01 00 02 e7 03 15 00 00 00 01 00 02 e8 f7 15 00 00 00 01 00 02 e9 03 15 00 00 00 01 00 02 ea f8 15 00 00 00 01 00 02 fb 01 15 01 00 00 01 00 02 ff 10];
		qcom,mdss-dsi-dispparam-papermode5-state = "dsi_hs_mode";
		qcom,mdss-dsi-dispparam-papermode6-command = [15 00 00 00 01 00 02 ff 20 15 00 00 00 01 00 02 fb 01 15 00 00 00 01 00 02 75 00 15 00 00 00 01 00 02 76 00 15 00 00 00 01 00 02 77 00 15 00 00 00 01 00 02 78 41 15 00 00 00 01 00 02 79 00 15 00 00 00 01 00 02 7a 80 15 00 00 00 01 00 02 7b 00 15 00 00 00 01 00 02 7c a7 15 00 00 00 01 00 02 7d 00 15 00 00 00 01 00 02 7e c6 15 00 00 00 01 00 02 7f 00 15 00 00 00 01 00 02 80 dd 15 00 00 00 01 00 02 81 00 15 00 00 00 01 00 02 82 f3 15 00 00 00 01 00 02 83 01 15 00 00 00 01 00 02 84 06 15 00 00 00 01 00 02 85 01 15 00 00 00 01 00 02 86 15 15 00 00 00 01 00 02 87 01 15 00 00 00 01 00 02 88 4b 15 00 00 00 01 00 02 89 01 15 00 00 00 01 00 02 8a 74 15 00 00 00 01 00 02 8b 01 15 00 00 00 01 00 02 8c b1 15 00 00 00 01 00 02 8d 01 15 00 00 00 01 00 02 8e e2 15 00 00 00 01 00 02 8f 02 15 00 00 00 01 00 02 90 28 15 00 00 00 01 00 02 91 02 15 00 00 00 01 00 02 92 5b 15 00 00 00 01 00 02 93 02 15 00 00 00 01 00 02 94 5c 15 00 00 00 01 00 02 95 02 15 00 00 00 01 00 02 96 8e 15 00 00 00 01 00 02 97 02 15 00 00 00 01 00 02 98 c8 15 00 00 00 01 00 02 99 02 15 00 00 00 01 00 02 9a ec 15 00 00 00 01 00 02 9b 03 15 00 00 00 01 00 02 9c 1b 15 00 00 00 01 00 02 9d 03 15 00 00 00 01 00 02 9e 39 15 00 00 00 01 00 02 9f 03 15 00 00 00 01 00 02 a0 5f 15 00 00 00 01 00 02 a2 03 15 00 00 00 01 00 02 a3 6b 15 00 00 00 01 00 02 a4 03 15 00 00 00 01 00 02 a5 78 15 00 00 00 01 00 02 a6 03 15 00 00 00 01 00 02 a7 86 15 00 00 00 01 00 02 a9 03 15 00 00 00 01 00 02 aa 95 15 00 00 00 01 00 02 ab 03 15 00 00 00 01 00 02 ac a8 15 00 00 00 01 00 02 ad 03 15 00 00 00 01 00 02 ae ba 15 00 00 00 01 00 02 af 03 15 00 00 00 01 00 02 b0 cc 15 00 00 00 01 00 02 b1 03 15 00 00 00 01 00 02 b2 d0 15 00 00 00 01 00 02 b3 00 15 00 00 00 01 00 02 b4 4c 15 00 00 00 01 00 02 b5 00 15 00 00 00 01 00 02 b6 8d 15 00 00 00 01 00 02 b7 00 15 00 00 00 01 00 02 b8 cb 15 00 00 00 01 00 02 b9 00 15 00 00 00 01 00 02 ba f0 15 00 00 00 01 00 02 bb 01 15 00 00 00 01 00 02 bc 0d 15 00 00 00 01 00 02 bd 01 15 00 00 00 01 00 02 be 24 15 00 00 00 01 00 02 bf 01 15 00 00 00 01 00 02 c0 38 15 00 00 00 01 00 02 c1 01 15 00 00 00 01 00 02 c2 49 15 00 00 00 01 00 02 c3 01 15 00 00 00 01 00 02 c4 58 15 00 00 00 01 00 02 c5 01 15 00 00 00 01 00 02 c6 88 15 00 00 00 01 00 02 c7 01 15 00 00 00 01 00 02 c8 ab 15 00 00 00 01 00 02 c9 01 15 00 00 00 01 00 02 ca de 15 00 00 00 01 00 02 cb 02 15 00 00 00 01 00 02 cc 03 15 00 00 00 01 00 02 cd 02 15 00 00 00 01 00 02 ce 3b 15 00 00 00 01 00 02 cf 02 15 00 00 00 01 00 02 d0 6e 15 00 00 00 01 00 02 d1 02 15 00 00 00 01 00 02 d2 6f 15 00 00 00 01 00 02 d3 02 15 00 00 00 01 00 02 d4 a1 15 00 00 00 01 00 02 d5 02 15 00 00 00 01 00 02 d6 d7 15 00 00 00 01 00 02 d7 02 15 00 00 00 01 00 02 d8 f9 15 00 00 00 01 00 02 d9 03 15 00 00 00 01 00 02 da 24 15 00 00 00 01 00 02 db 03 15 00 00 00 01 00 02 dc 40 15 00 00 00 01 00 02 dd 03 15 00 00 00 01 00 02 de 64 15 00 00 00 01 00 02 df 03 15 00 00 00 01 00 02 e0 6f 15 00 00 00 01 00 02 e1 03 15 00 00 00 01 00 02 e2 7b 15 00 00 00 01 00 02 e3 03 15 00 00 00 01 00 02 e4 89 15 00 00 00 01 00 02 e5 03 15 00 00 00 01 00 02 e6 97 15 00 00 00 01 00 02 e7 03 15 00 00 00 01 00 02 e8 a9 15 00 00 00 01 00 02 e9 03 15 00 00 00 01 00 02 ea bb 15 00 00 00 01 00 02 eb 03 15 00 00 00 01 00 02 ec cd 15 00 00 00 01 00 02 ed 03 15 00 00 00 01 00 02 ee d0 15 00 00 00 01 00 02 ef 00 15 00 00 00 01 00 02 f0 00 15 00 00 00 01 00 02 f1 00 15 00 00 00 01 00 02 f2 41 15 00 00 00 01 00 02 f3 00 15 00 00 00 01 00 02 f4 80 15 00 00 00 01 00 02 f5 00 15 00 00 00 01 00 02 f6 a7 15 00 00 00 01 00 02 f7 00 15 00 00 00 01 00 02 f8 c6 15 00 00 00 01 00 02 f9 00 15 01 00 00 01 00 02 fa dd 15 00 00 00 01 00 02 ff 21 15 00 00 00 01 00 02 fb 01 15 00 00 00 01 00 02 00 00 15 00 00 00 01 00 02 01 f3 15 00 00 00 01 00 02 02 01 15 00 00 00 01 00 02 03 06 15 00 00 00 01 00 02 04 01 15 00 00 00 01 00 02 05 15 15 00 00 00 01 00 02 06 01 15 00 00 00 01 00 02 07 4b 15 00 00 00 01 00 02 08 01 15 00 00 00 01 00 02 09 74 15 00 00 00 01 00 02 0a 01 15 00 00 00 01 00 02 0b b1 15 00 00 00 01 00 02 0c 01 15 00 00 00 01 00 02 0d e2 15 00 00 00 01 00 02 0e 02 15 00 00 00 01 00 02 0f 28 15 00 00 00 01 00 02 10 02 15 00 00 00 01 00 02 11 5b 15 00 00 00 01 00 02 12 02 15 00 00 00 01 00 02 13 5c 15 00 00 00 01 00 02 14 02 15 00 00 00 01 00 02 15 8e 15 00 00 00 01 00 02 16 02 15 00 00 00 01 00 02 17 c8 15 00 00 00 01 00 02 18 02 15 00 00 00 01 00 02 19 ec 15 00 00 00 01 00 02 1a 03 15 00 00 00 01 00 02 1b 1b 15 00 00 00 01 00 02 1c 03 15 00 00 00 01 00 02 1d 39 15 00 00 00 01 00 02 1e 03 15 00 00 00 01 00 02 1f 5f 15 00 00 00 01 00 02 20 03 15 00 00 00 01 00 02 21 6b 15 00 00 00 01 00 02 22 03 15 00 00 00 01 00 02 23 78 15 00 00 00 01 00 02 24 03 15 00 00 00 01 00 02 25 86 15 00 00 00 01 00 02 26 03 15 00 00 00 01 00 02 27 95 15 00 00 00 01 00 02 28 03 15 00 00 00 01 00 02 29 a8 15 00 00 00 01 00 02 2a 03 15 00 00 00 01 00 02 2b ba 15 00 00 00 01 00 02 2d 03 15 00 00 00 01 00 02 2f cc 15 00 00 00 01 00 02 30 03 15 00 00 00 01 00 02 31 d0 15 00 00 00 01 00 02 32 00 15 00 00 00 01 00 02 33 4c 15 00 00 00 01 00 02 34 00 15 00 00 00 01 00 02 35 8d 15 00 00 00 01 00 02 36 00 15 00 00 00 01 00 02 37 cb 15 00 00 00 01 00 02 38 00 15 00 00 00 01 00 02 39 f0 15 00 00 00 01 00 02 3a 01 15 00 00 00 01 00 02 3b 0d 15 00 00 00 01 00 02 3d 01 15 00 00 00 01 00 02 3f 24 15 00 00 00 01 00 02 40 01 15 00 00 00 01 00 02 41 38 15 00 00 00 01 00 02 42 01 15 00 00 00 01 00 02 43 49 15 00 00 00 01 00 02 44 01 15 00 00 00 01 00 02 45 58 15 00 00 00 01 00 02 46 01 15 00 00 00 01 00 02 47 88 15 00 00 00 01 00 02 48 01 15 00 00 00 01 00 02 49 ab 15 00 00 00 01 00 02 4a 01 15 00 00 00 01 00 02 4b de 15 00 00 00 01 00 02 4c 02 15 00 00 00 01 00 02 4d 03 15 00 00 00 01 00 02 4e 02 15 00 00 00 01 00 02 4f 3b 15 00 00 00 01 00 02 50 02 15 00 00 00 01 00 02 51 6e 15 00 00 00 01 00 02 52 02 15 00 00 00 01 00 02 53 6f 15 00 00 00 01 00 02 54 02 15 00 00 00 01 00 02 55 a1 15 00 00 00 01 00 02 56 02 15 00 00 00 01 00 02 58 d7 15 00 00 00 01 00 02 59 02 15 00 00 00 01 00 02 5a f9 15 00 00 00 01 00 02 5b 03 15 00 00 00 01 00 02 5c 24 15 00 00 00 01 00 02 5d 03 15 00 00 00 01 00 02 5e 40 15 00 00 00 01 00 02 5f 03 15 00 00 00 01 00 02 60 64 15 00 00 00 01 00 02 61 03 15 00 00 00 01 00 02 62 6f 15 00 00 00 01 00 02 63 03 15 00 00 00 01 00 02 64 7b 15 00 00 00 01 00 02 65 03 15 00 00 00 01 00 02 66 89 15 00 00 00 01 00 02 67 03 15 00 00 00 01 00 02 68 97 15 00 00 00 01 00 02 69 03 15 00 00 00 01 00 02 6a a9 15 00 00 00 01 00 02 6b 03 15 00 00 00 01 00 02 6c bb 15 00 00 00 01 00 02 6d 03 15 00 00 00 01 00 02 6e cd 15 00 00 00 01 00 02 6f 03 15 00 00 00 01 00 02 70 d0 15 00 00 00 01 00 02 71 01 15 00 00 00 01 00 02 72 e8 15 00 00 00 01 00 02 73 01 15 00 00 00 01 00 02 74 ea 15 00 00 00 01 00 02 75 01 15 00 00 00 01 00 02 76 ed 15 00 00 00 01 00 02 77 01 15 00 00 00 01 00 02 78 f1 15 00 00 00 01 00 02 79 01 15 00 00 00 01 00 02 7a f5 15 00 00 00 01 00 02 7b 01 15 00 00 00 01 00 02 7c f8 15 00 00 00 01 00 02 7d 01 15 00 00 00 01 00 02 7e fc 15 00 00 00 01 00 02 7f 01 15 00 00 00 01 00 02 80 ff 15 00 00 00 01 00 02 81 02 15 00 00 00 01 00 02 82 03 15 00 00 00 01 00 02 83 02 15 00 00 00 01 00 02 84 0f 15 00 00 00 01 00 02 85 02 15 00 00 00 01 00 02 86 1b 15 00 00 00 01 00 02 87 02 15 00 00 00 01 00 02 88 31 15 00 00 00 01 00 02 89 02 15 00 00 00 01 00 02 8a 45 15 00 00 00 01 00 02 8b 02 15 00 00 00 01 00 02 8c 6c 15 00 00 00 01 00 02 8d 02 15 00 00 00 01 00 02 8e 92 15 00 00 00 01 00 02 8f 02 15 00 00 00 01 00 02 90 93 15 00 00 00 01 00 02 91 02 15 00 00 00 01 00 02 92 bb 15 00 00 00 01 00 02 93 02 15 00 00 00 01 00 02 94 e8 15 00 00 00 01 00 02 95 03 15 00 00 00 01 00 02 96 05 15 00 00 00 01 00 02 97 03 15 00 00 00 01 00 02 98 39 15 00 00 00 01 00 02 99 03 15 00 00 00 01 00 02 9a 54 15 00 00 00 01 00 02 9b 03 15 00 00 00 01 00 02 9c 76 15 00 00 00 01 00 02 9d 03 15 00 00 00 01 00 02 9e 81 15 00 00 00 01 00 02 9f 03 15 00 00 00 01 00 02 a0 8c 15 00 00 00 01 00 02 a2 03 15 00 00 00 01 00 02 a3 9a 15 00 00 00 01 00 02 a4 03 15 00 00 00 01 00 02 a5 a9 15 00 00 00 01 00 02 a6 03 15 00 00 00 01 00 02 a7 b9 15 00 00 00 01 00 02 a9 03 15 00 00 00 01 00 02 aa c7 15 00 00 00 01 00 02 ab 03 15 00 00 00 01 00 02 ac cf 15 00 00 00 01 00 02 ad 03 15 00 00 00 01 00 02 ae d0 15 00 00 00 01 00 02 af 02 15 00 00 00 01 00 02 b0 34 15 00 00 00 01 00 02 b1 02 15 00 00 00 01 00 02 b2 35 15 00 00 00 01 00 02 b3 02 15 00 00 00 01 00 02 b4 37 15 00 00 00 01 00 02 b5 02 15 00 00 00 01 00 02 b6 39 15 00 00 00 01 00 02 b7 02 15 00 00 00 01 00 02 b8 3b 15 00 00 00 01 00 02 b9 02 15 00 00 00 01 00 02 ba 3d 15 00 00 00 01 00 02 bb 02 15 00 00 00 01 00 02 bc 3f 15 00 00 00 01 00 02 bd 02 15 00 00 00 01 00 02 be 41 15 00 00 00 01 00 02 bf 02 15 00 00 00 01 00 02 c0 43 15 00 00 00 01 00 02 c1 02 15 00 00 00 01 00 02 c2 4b 15 00 00 00 01 00 02 c3 02 15 00 00 00 01 00 02 c4 53 15 00 00 00 01 00 02 c5 02 15 00 00 00 01 00 02 c6 63 15 00 00 00 01 00 02 c7 02 15 00 00 00 01 00 02 c8 72 15 00 00 00 01 00 02 c9 02 15 00 00 00 01 00 02 ca 91 15 00 00 00 01 00 02 cb 02 15 00 00 00 01 00 02 cc b1 15 00 00 00 01 00 02 cd 02 15 00 00 00 01 00 02 ce b2 15 00 00 00 01 00 02 cf 02 15 00 00 00 01 00 02 d0 d4 15 00 00 00 01 00 02 d1 02 15 00 00 00 01 00 02 d2 fe 15 00 00 00 01 00 02 d3 03 15 00 00 00 01 00 02 d4 1d 15 00 00 00 01 00 02 d5 03 15 00 00 00 01 00 02 d6 4e 15 00 00 00 01 00 02 d7 03 15 00 00 00 01 00 02 d8 68 15 00 00 00 01 00 02 d9 03 15 00 00 00 01 00 02 da 8a 15 00 00 00 01 00 02 db 03 15 00 00 00 01 00 02 dc 95 15 00 00 00 01 00 02 dd 03 15 00 00 00 01 00 02 de a1 15 00 00 00 01 00 02 df 03 15 00 00 00 01 00 02 e0 ad 15 00 00 00 01 00 02 e1 03 15 00 00 00 01 00 02 e2 b9 15 00 00 00 01 00 02 e3 03 15 00 00 00 01 00 02 e4 c3 15 00 00 00 01 00 02 e5 03 15 00 00 00 01 00 02 e6 cb 15 00 00 00 01 00 02 e7 03 15 00 00 00 01 00 02 e8 f7 15 00 00 00 01 00 02 e9 03 15 00 00 00 01 00 02 ea f8 15 00 00 00 01 00 02 fb 01 15 01 00 00 01 00 02 ff 10];
		qcom,mdss-dsi-dispparam-papermode6-state = "dsi_hs_mode";
		qcom,mdss-dsi-dispparam-papermode7-command = [15 00 00 00 01 00 02 ff 20 15 00 00 00 01 00 02 fb 01 15 00 00 00 01 00 02 75 00 15 00 00 00 01 00 02 76 00 15 00 00 00 01 00 02 77 00 15 00 00 00 01 00 02 78 41 15 00 00 00 01 00 02 79 00 15 00 00 00 01 00 02 7a 80 15 00 00 00 01 00 02 7b 00 15 00 00 00 01 00 02 7c a7 15 00 00 00 01 00 02 7d 00 15 00 00 00 01 00 02 7e c6 15 00 00 00 01 00 02 7f 00 15 00 00 00 01 00 02 80 dd 15 00 00 00 01 00 02 81 00 15 00 00 00 01 00 02 82 f3 15 00 00 00 01 00 02 83 01 15 00 00 00 01 00 02 84 06 15 00 00 00 01 00 02 85 01 15 00 00 00 01 00 02 86 15 15 00 00 00 01 00 02 87 01 15 00 00 00 01 00 02 88 4b 15 00 00 00 01 00 02 89 01 15 00 00 00 01 00 02 8a 74 15 00 00 00 01 00 02 8b 01 15 00 00 00 01 00 02 8c b1 15 00 00 00 01 00 02 8d 01 15 00 00 00 01 00 02 8e e2 15 00 00 00 01 00 02 8f 02 15 00 00 00 01 00 02 90 28 15 00 00 00 01 00 02 91 02 15 00 00 00 01 00 02 92 5b 15 00 00 00 01 00 02 93 02 15 00 00 00 01 00 02 94 5c 15 00 00 00 01 00 02 95 02 15 00 00 00 01 00 02 96 8e 15 00 00 00 01 00 02 97 02 15 00 00 00 01 00 02 98 c8 15 00 00 00 01 00 02 99 02 15 00 00 00 01 00 02 9a ec 15 00 00 00 01 00 02 9b 03 15 00 00 00 01 00 02 9c 1b 15 00 00 00 01 00 02 9d 03 15 00 00 00 01 00 02 9e 39 15 00 00 00 01 00 02 9f 03 15 00 00 00 01 00 02 a0 5f 15 00 00 00 01 00 02 a2 03 15 00 00 00 01 00 02 a3 6b 15 00 00 00 01 00 02 a4 03 15 00 00 00 01 00 02 a5 78 15 00 00 00 01 00 02 a6 03 15 00 00 00 01 00 02 a7 86 15 00 00 00 01 00 02 a9 03 15 00 00 00 01 00 02 aa 95 15 00 00 00 01 00 02 ab 03 15 00 00 00 01 00 02 ac a8 15 00 00 00 01 00 02 ad 03 15 00 00 00 01 00 02 ae ba 15 00 00 00 01 00 02 af 03 15 00 00 00 01 00 02 b0 cc 15 00 00 00 01 00 02 b1 03 15 00 00 00 01 00 02 b2 d0 15 00 00 00 01 00 02 b3 00 15 00 00 00 01 00 02 b4 4c 15 00 00 00 01 00 02 b5 00 15 00 00 00 01 00 02 b6 8d 15 00 00 00 01 00 02 b7 00 15 00 00 00 01 00 02 b8 cb 15 00 00 00 01 00 02 b9 00 15 00 00 00 01 00 02 ba f0 15 00 00 00 01 00 02 bb 01 15 00 00 00 01 00 02 bc 0d 15 00 00 00 01 00 02 bd 01 15 00 00 00 01 00 02 be 24 15 00 00 00 01 00 02 bf 01 15 00 00 00 01 00 02 c0 38 15 00 00 00 01 00 02 c1 01 15 00 00 00 01 00 02 c2 49 15 00 00 00 01 00 02 c3 01 15 00 00 00 01 00 02 c4 58 15 00 00 00 01 00 02 c5 01 15 00 00 00 01 00 02 c6 88 15 00 00 00 01 00 02 c7 01 15 00 00 00 01 00 02 c8 ab 15 00 00 00 01 00 02 c9 01 15 00 00 00 01 00 02 ca de 15 00 00 00 01 00 02 cb 02 15 00 00 00 01 00 02 cc 03 15 00 00 00 01 00 02 cd 02 15 00 00 00 01 00 02 ce 3b 15 00 00 00 01 00 02 cf 02 15 00 00 00 01 00 02 d0 6e 15 00 00 00 01 00 02 d1 02 15 00 00 00 01 00 02 d2 6f 15 00 00 00 01 00 02 d3 02 15 00 00 00 01 00 02 d4 a1 15 00 00 00 01 00 02 d5 02 15 00 00 00 01 00 02 d6 d7 15 00 00 00 01 00 02 d7 02 15 00 00 00 01 00 02 d8 f9 15 00 00 00 01 00 02 d9 03 15 00 00 00 01 00 02 da 24 15 00 00 00 01 00 02 db 03 15 00 00 00 01 00 02 dc 40 15 00 00 00 01 00 02 dd 03 15 00 00 00 01 00 02 de 64 15 00 00 00 01 00 02 df 03 15 00 00 00 01 00 02 e0 6f 15 00 00 00 01 00 02 e1 03 15 00 00 00 01 00 02 e2 7b 15 00 00 00 01 00 02 e3 03 15 00 00 00 01 00 02 e4 89 15 00 00 00 01 00 02 e5 03 15 00 00 00 01 00 02 e6 97 15 00 00 00 01 00 02 e7 03 15 00 00 00 01 00 02 e8 a9 15 00 00 00 01 00 02 e9 03 15 00 00 00 01 00 02 ea bb 15 00 00 00 01 00 02 eb 03 15 00 00 00 01 00 02 ec cd 15 00 00 00 01 00 02 ed 03 15 00 00 00 01 00 02 ee d0 15 00 00 00 01 00 02 ef 00 15 00 00 00 01 00 02 f0 00 15 00 00 00 01 00 02 f1 00 15 00 00 00 01 00 02 f2 41 15 00 00 00 01 00 02 f3 00 15 00 00 00 01 00 02 f4 80 15 00 00 00 01 00 02 f5 00 15 00 00 00 01 00 02 f6 a7 15 00 00 00 01 00 02 f7 00 15 00 00 00 01 00 02 f8 c6 15 00 00 00 01 00 02 f9 00 15 01 00 00 01 00 02 fa dd 15 00 00 00 01 00 02 ff 21 15 00 00 00 01 00 02 fb 01 15 00 00 00 01 00 02 00 00 15 00 00 00 01 00 02 01 f3 15 00 00 00 01 00 02 02 01 15 00 00 00 01 00 02 03 06 15 00 00 00 01 00 02 04 01 15 00 00 00 01 00 02 05 15 15 00 00 00 01 00 02 06 01 15 00 00 00 01 00 02 07 4b 15 00 00 00 01 00 02 08 01 15 00 00 00 01 00 02 09 74 15 00 00 00 01 00 02 0a 01 15 00 00 00 01 00 02 0b b1 15 00 00 00 01 00 02 0c 01 15 00 00 00 01 00 02 0d e2 15 00 00 00 01 00 02 0e 02 15 00 00 00 01 00 02 0f 28 15 00 00 00 01 00 02 10 02 15 00 00 00 01 00 02 11 5b 15 00 00 00 01 00 02 12 02 15 00 00 00 01 00 02 13 5c 15 00 00 00 01 00 02 14 02 15 00 00 00 01 00 02 15 8e 15 00 00 00 01 00 02 16 02 15 00 00 00 01 00 02 17 c8 15 00 00 00 01 00 02 18 02 15 00 00 00 01 00 02 19 ec 15 00 00 00 01 00 02 1a 03 15 00 00 00 01 00 02 1b 1b 15 00 00 00 01 00 02 1c 03 15 00 00 00 01 00 02 1d 39 15 00 00 00 01 00 02 1e 03 15 00 00 00 01 00 02 1f 5f 15 00 00 00 01 00 02 20 03 15 00 00 00 01 00 02 21 6b 15 00 00 00 01 00 02 22 03 15 00 00 00 01 00 02 23 78 15 00 00 00 01 00 02 24 03 15 00 00 00 01 00 02 25 86 15 00 00 00 01 00 02 26 03 15 00 00 00 01 00 02 27 95 15 00 00 00 01 00 02 28 03 15 00 00 00 01 00 02 29 a8 15 00 00 00 01 00 02 2a 03 15 00 00 00 01 00 02 2b ba 15 00 00 00 01 00 02 2d 03 15 00 00 00 01 00 02 2f cc 15 00 00 00 01 00 02 30 03 15 00 00 00 01 00 02 31 d0 15 00 00 00 01 00 02 32 00 15 00 00 00 01 00 02 33 4c 15 00 00 00 01 00 02 34 00 15 00 00 00 01 00 02 35 8d 15 00 00 00 01 00 02 36 00 15 00 00 00 01 00 02 37 cb 15 00 00 00 01 00 02 38 00 15 00 00 00 01 00 02 39 f0 15 00 00 00 01 00 02 3a 01 15 00 00 00 01 00 02 3b 0d 15 00 00 00 01 00 02 3d 01 15 00 00 00 01 00 02 3f 24 15 00 00 00 01 00 02 40 01 15 00 00 00 01 00 02 41 38 15 00 00 00 01 00 02 42 01 15 00 00 00 01 00 02 43 49 15 00 00 00 01 00 02 44 01 15 00 00 00 01 00 02 45 58 15 00 00 00 01 00 02 46 01 15 00 00 00 01 00 02 47 88 15 00 00 00 01 00 02 48 01 15 00 00 00 01 00 02 49 ab 15 00 00 00 01 00 02 4a 01 15 00 00 00 01 00 02 4b de 15 00 00 00 01 00 02 4c 02 15 00 00 00 01 00 02 4d 03 15 00 00 00 01 00 02 4e 02 15 00 00 00 01 00 02 4f 3b 15 00 00 00 01 00 02 50 02 15 00 00 00 01 00 02 51 6e 15 00 00 00 01 00 02 52 02 15 00 00 00 01 00 02 53 6f 15 00 00 00 01 00 02 54 02 15 00 00 00 01 00 02 55 a1 15 00 00 00 01 00 02 56 02 15 00 00 00 01 00 02 58 d7 15 00 00 00 01 00 02 59 02 15 00 00 00 01 00 02 5a f9 15 00 00 00 01 00 02 5b 03 15 00 00 00 01 00 02 5c 24 15 00 00 00 01 00 02 5d 03 15 00 00 00 01 00 02 5e 40 15 00 00 00 01 00 02 5f 03 15 00 00 00 01 00 02 60 64 15 00 00 00 01 00 02 61 03 15 00 00 00 01 00 02 62 6f 15 00 00 00 01 00 02 63 03 15 00 00 00 01 00 02 64 7b 15 00 00 00 01 00 02 65 03 15 00 00 00 01 00 02 66 89 15 00 00 00 01 00 02 67 03 15 00 00 00 01 00 02 68 97 15 00 00 00 01 00 02 69 03 15 00 00 00 01 00 02 6a a9 15 00 00 00 01 00 02 6b 03 15 00 00 00 01 00 02 6c bb 15 00 00 00 01 00 02 6d 03 15 00 00 00 01 00 02 6e cd 15 00 00 00 01 00 02 6f 03 15 00 00 00 01 00 02 70 d0 15 00 00 00 01 00 02 71 02 15 00 00 00 01 00 02 72 00 15 00 00 00 01 00 02 73 02 15 00 00 00 01 00 02 74 02 15 00 00 00 01 00 02 75 02 15 00 00 00 01 00 02 76 05 15 00 00 00 01 00 02 77 02 15 00 00 00 01 00 02 78 08 15 00 00 00 01 00 02 79 02 15 00 00 00 01 00 02 7a 0b 15 00 00 00 01 00 02 7b 02 15 00 00 00 01 00 02 7c 0e 15 00 00 00 01 00 02 7d 02 15 00 00 00 01 00 02 7e 10 15 00 00 00 01 00 02 7f 02 15 00 00 00 01 00 02 80 13 15 00 00 00 01 00 02 81 02 15 00 00 00 01 00 02 82 16 15 00 00 00 01 00 02 83 02 15 00 00 00 01 00 02 84 21 15 00 00 00 01 00 02 85 02 15 00 00 00 01 00 02 86 2b 15 00 00 00 01 00 02 87 02 15 00 00 00 01 00 02 88 3f 15 00 00 00 01 00 02 89 02 15 00 00 00 01 00 02 8a 51 15 00 00 00 01 00 02 8b 02 15 00 00 00 01 00 02 8c 76 15 00 00 00 01 00 02 8d 02 15 00 00 00 01 00 02 8e 9a 15 00 00 00 01 00 02 8f 02 15 00 00 00 01 00 02 90 9b 15 00 00 00 01 00 02 91 02 15 00 00 00 01 00 02 92 c1 15 00 00 00 01 00 02 93 02 15 00 00 00 01 00 02 94 ed 15 00 00 00 01 00 02 95 03 15 00 00 00 01 00 02 96 0b 15 00 00 00 01 00 02 97 03 15 00 00 00 01 00 02 98 3f 15 00 00 00 01 00 02 99 03 15 00 00 00 01 00 02 9a 59 15 00 00 00 01 00 02 9b 03 15 00 00 00 01 00 02 9c 7a 15 00 00 00 01 00 02 9d 03 15 00 00 00 01 00 02 9e 84 15 00 00 00 01 00 02 9f 03 15 00 00 00 01 00 02 a0 90 15 00 00 00 01 00 02 a2 03 15 00 00 00 01 00 02 a3 9d 15 00 00 00 01 00 02 a4 03 15 00 00 00 01 00 02 a5 ac 15 00 00 00 01 00 02 a6 03 15 00 00 00 01 00 02 a7 bb 15 00 00 00 01 00 02 a9 03 15 00 00 00 01 00 02 aa c8 15 00 00 00 01 00 02 ab 03 15 00 00 00 01 00 02 ac cf 15 00 00 00 01 00 02 ad 03 15 00 00 00 01 00 02 ae d0 15 00 00 00 01 00 02 af 02 15 00 00 00 01 00 02 b0 4c 15 00 00 00 01 00 02 b1 02 15 00 00 00 01 00 02 b2 4d 15 00 00 00 01 00 02 b3 02 15 00 00 00 01 00 02 b4 4f 15 00 00 00 01 00 02 b5 02 15 00 00 00 01 00 02 b6 50 15 00 00 00 01 00 02 b7 02 15 00 00 00 01 00 02 b8 52 15 00 00 00 01 00 02 b9 02 15 00 00 00 01 00 02 ba 54 15 00 00 00 01 00 02 bb 02 15 00 00 00 01 00 02 bc 56 15 00 00 00 01 00 02 bd 02 15 00 00 00 01 00 02 be 58 15 00 00 00 01 00 02 bf 02 15 00 00 00 01 00 02 c0 59 15 00 00 00 01 00 02 c1 02 15 00 00 00 01 00 02 c2 60 15 00 00 00 01 00 02 c3 02 15 00 00 00 01 00 02 c4 67 15 00 00 00 01 00 02 c5 02 15 00 00 00 01 00 02 c6 75 15 00 00 00 01 00 02 c7 02 15 00 00 00 01 00 02 c8 83 15 00 00 00 01 00 02 c9 02 15 00 00 00 01 00 02 ca a0 15 00 00 00 01 00 02 cb 02 15 00 00 00 01 00 02 cc bd 15 00 00 00 01 00 02 cd 02 15 00 00 00 01 00 02 ce be 15 00 00 00 01 00 02 cf 02 15 00 00 00 01 00 02 d0 df 15 00 00 00 01 00 02 d1 03 15 00 00 00 01 00 02 d2 08 15 00 00 00 01 00 02 d3 03 15 00 00 00 01 00 02 d4 2f 15 00 00 00 01 00 02 d5 03 15 00 00 00 01 00 02 d6 57 15 00 00 00 01 00 02 d7 03 15 00 00 00 01 00 02 d8 70 15 00 00 00 01 00 02 d9 03 15 00 00 00 01 00 02 da 91 15 00 00 00 01 00 02 db 03 15 00 00 00 01 00 02 dc 9c 15 00 00 00 01 00 02 dd 03 15 00 00 00 01 00 02 de a7 15 00 00 00 01 00 02 df 03 15 00 00 00 01 00 02 e0 b2 15 00 00 00 01 00 02 e1 03 15 00 00 00 01 00 02 e2 bd 15 00 00 00 01 00 02 e3 03 15 00 00 00 01 00 02 e4 c6 15 00 00 00 01 00 02 e5 03 15 00 00 00 01 00 02 e6 f9 15 00 00 00 01 00 02 e7 03 15 00 00 00 01 00 02 e8 fa 15 00 00 00 01 00 02 e9 03 15 00 00 00 01 00 02 ea fb 15 00 00 00 01 00 02 fb 01 15 01 00 00 01 00 02 ff 10];
		qcom,mdss-dsi-dispparam-papermode7-state = "dsi_hs_mode";
	};
};
